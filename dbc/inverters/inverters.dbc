VERSION ""

NS_ :

BS_:

BU_: Vector__XXX

BO_ 513 Inverter_L_Send: 5 Vector__XXX
 SG_ ReduceLosses m90 : 39|1@1+ (1,0) [0|1] "" Vector__XXX
 SG_ DC_1Q3P m90 : 38|1@1+ (1,0) [0|1] "" Vector__XXX
 SG_ DC_1QMV m90 : 37|1@1+ (1,0) [0|1] "" Vector__XXX
 SG_ block m90 : 36|1@1+ (1,0) [0|1] "" Vector__XXX
 SG_ DEAD_2 m90 : 35|1@1+ (1,0) [0|1] "" Vector__XXX
 SG_ DC_field m90 : 34|1@1+ (1,0) [0|1] "" Vector__XXX
 SG_ DC_1QdirVolt m90 : 33|1@1+ (1,0) [0|1] "" Vector__XXX
 SG_ CMC__Bit31_24__free m205 : 32|8@1+ (1,0) [0|255] "" Vector__XXX
 SG_ delta m90 : 32|1@1+ (1,0) [0|1] "" Vector__XXX
 SG_ CMC__Bit23__TC_nCmdRestOption m205 : 31|1@1+ (1,0) [0|1] "" Vector__XXX
 SG_ NTC m90 : 31|1@1+ (1,0) [0|1] "" Vector__XXX
 SG_ DUP__Bit31_22__free m220 : 30|10@1+ (1,0) [0|1023] "" Vector__XXX
 SG_ DUP__Bit21__InitWith_FRG_OFF m220 : 29|1@1+ (1,0) [0|1] "" Vector__XXX
 SG_ CMC__Bit22_21__TC_MinSpeed_conf m205 : 29|2@1+ (1,0) [0|3] "" Vector__XXX
 SG_ DUP__Bit20__HAL_Extmr_Acv m220 : 28|1@1+ (1,0) [0|1] "" Vector__XXX
 SG_ PWM_Freq m90 : 28|3@1+ (1,0) [0|7] "" Vector__XXX
 SG_ CMC__Bit20_19__TC_DeltaTime_conf m205 : 27|2@1+ (1,0) [0|3] "" Vector__XXX
 SG_ AC_DC m90 : 27|1@1+ (1,0) [0|1] "" Vector__XXX
 SG_ CMC__Bit18__TractionControl_Ena m205 : 26|1@1+ (1,0) [0|1] "" Vector__XXX
 SG_ MotBrake m90 : 26|1@1+ (1,0) [0|1] "" Vector__XXX
 SG_ DUP__Bit19_17__ECODE_ReDefine m220 : 25|3@1+ (1,0) [0|7] "" Vector__XXX
 SG_ Ramp4 m90 : 25|1@1+ (1,0) [0|1] "" Vector__XXX
 SG_ M_R_Dec m237 : 24|16@1+ (1,0) [0|4000] "ms" Vector__XXX
 SG_ DUP__Bit16__Bamobil3_2_OffCrct m220 : 24|1@1+ (1,0) [0|1] "" Vector__XXX
 SG_ Ain_in_2_ScaleVal m215 : 24|16@1- (0.000244140625,0) [-8|7.999755859375] "" Vector__XXX
 SG_ CMC__Bit17_16__CheckIPeak_config m205 : 24|2@1+ (1,0) [0|3] "" Vector__XXX
 SG_ PID_I__Kf__Id m203 : 24|16@1+ (1,0) [0|200] "" Vector__XXX
 SG_ Bat_Opr_Limit__Gen m202 : 24|16@1+ (0.1,0) [0|6553.5] "A or W" Vector__XXX
 SG_ PID_I__xKp__Id m201 : 24|16@1+ (1,0) [0|200] "%" Vector__XXX
 SG_ M_R_Rcp m199 : 24|16@1+ (1,0) [0|4000] "ms" Vector__XXX
 SG_ DC_Bus_Max_Lim m165 : 24|16@1+ (1,0) [0|65535] "" Vector__XXX
 SG_ Regen_R m101 : 24|16@1+ (1,0) [0|65535] "Ohm" Vector__XXX
 SG_ SRamp m90 : 24|1@1+ (1,0) [0|1] "" Vector__XXX
 SG_ M_R_Acc m53 : 24|16@1+ (1,0) [0|4000] "ms" Vector__XXX
 SG_ Ain_in_1_ScaleVal m47 : 24|16@1- (0.000244140625,0) [-7.999|7.999] "" Vector__XXX
 SG_ PID_I__TiM__Id m43 : 24|16@1+ (1,0) [0|500] "" Vector__XXX
 SG_ PID_I__Ti__Id m29 : 24|16@1+ (1,0) [300|20000] "" Vector__XXX
 SG_ PID_I__Kp__Id m28 : 24|16@1+ (1,0) [0|200] "" Vector__XXX
 SG_ F_corner__Stop m13 : 24|16@1- (0.1,0) [-3276.8|3276.7] "Hz" Vector__XXX
 SG_ V_corner__Stop m12 : 24|16@1- (0.1,0) [-3276.8|3276.7] "%" Vector__XXX
 SG_ F_min__Stop m11 : 24|16@1- (0.1,0) [-3276.8|3276.7] "Hz" Vector__XXX
 SG_ V_min__Stop m10 : 24|16@1- (0.1,0) [-3276.8|3276.7] "%" Vector__XXX
 SG_ Special__Stop m9 : 24|16@1- (1,0) [-32768|32767] "" Vector__XXX
 SG_ V_dc__Stop m8 : 24|16@1- (0.1,0) [-3276.8|3276.7] "%" Vector__XXX
 SG_ T_dc__Stop m7 : 24|16@1+ (1,0) [0|65535] "ms" Vector__XXX
 SG_ DUP__Bit15__CANopen_Acv m220 : 23|1@1+ (1,0) [0|1] "" Vector__XXX
 SG_ CMC__Bit15__Dig_E_Brake_Act m205 : 23|1@1+ (1,0) [0|1] "" Vector__XXX
 SG_ Active193 m193 : 23|1@1+ (1,0) [0|1] "" Vector__XXX
 SG_ Active192 m192 : 23|1@1+ (1,0) [0|1] "" Vector__XXX
 SG_ Active191 m191 : 23|1@1+ (1,0) [0|1] "" Vector__XXX
 SG_ Active190 m190 : 23|1@1+ (1,0) [0|1] "" Vector__XXX
 SG_ MO_sc2_inv m164 : 23|1@1+ (1,0) [0|1] "" Vector__XXX
 SG_ LowBd m90 : 23|1@1+ (1,0) [0|1] "" Vector__XXX
 SG_ KM_DEBUG_TEST m81 : 23|1@1+ (1,0) [0|1] "" Vector__XXX
 SG_ CS_Ain_1__N_Limit m54 : 23|1@1+ (1,0) [0|1] "" Vector__XXX
 SG_ DUP__Bit14__MTPA_reluct_enab m220 : 22|1@1+ (1,0) [0|1] "" Vector__XXX
 SG_ CMC__Bit14__Idc_Limit_Ena_V2 m205 : 22|1@1+ (1,0) [0|1] "" Vector__XXX
 SG_ Ana_0up m90 : 22|1@1+ (1,0) [0|1] "" Vector__XXX
 SG_ KM_PSEUDO_ENABLE m81 : 22|1@1+ (1,0) [0|1] "" Vector__XXX
 SG_ CS_Ain_2__I_Limit m54 : 22|1@1+ (1,0) [0|1] "" Vector__XXX
 SG_ DUP__Bit13__Gen_AutoIacLimit m220 : 21|1@1+ (1,0) [0|1] "" Vector__XXX
 SG_ KM_rsvd_13 m81 : 21|1@1+ (1,0) [0|1] "" Vector__XXX
 SG_ DUP__Bit12__Boat_Pedal m220 : 20|1@1+ (1,0) [0|1] "" Vector__XXX
 SG_ MO_sc2_reso m164 : 20|3@1+ (1,0) [0|7] "" Vector__XXX
 SG_ MotorType m90 : 20|2@1+ (1,0) [0|3] "" Vector__XXX
 SG_ KM_rsvd_12 m81 : 20|1@1+ (1,0) [0|1] "" Vector__XXX
 SG_ CS_CMD_Type m54 : 20|2@1+ (1,0) [0|3] "" Vector__XXX
 SG_ DUP__Bit11__DCBus_Volts m220 : 19|1@1+ (1,0) [0|1] "" Vector__XXX
 SG_ MO_sc1_comp m164 : 19|1@1+ (1,0) [0|1] "" Vector__XXX
 SG_ OL_comp m90 : 19|1@1+ (1,0) [0|1] "" Vector__XXX
 SG_ KM_rsvd_11 m81 : 19|1@1+ (1,0) [0|1] "" Vector__XXX
 SG_ CS_oora2 m54 : 19|1@1+ (1,0) [0|1] "" Vector__XXX
 SG_ DUP__Bit10__PARK_RMS m220 : 18|1@1+ (1,0) [0|1] "" Vector__XXX
 SG_ H2inv m90 : 18|1@1+ (1,0) [0|1] "" Vector__XXX
 SG_ KM_PHASING_EXTEND m81 : 18|1@1+ (1,0) [0|1] "" Vector__XXX
 SG_ DUP__Bit9__GENERATOR m220 : 17|1@1+ (1,0) [0|1] "" Vector__XXX
 SG_ Hxinv m90 : 17|1@1+ (1,0) [0|1] "" Vector__XXX
 SG_ KM_HANDWHEEL m81 : 17|1@1+ (1,0) [0|1] "" Vector__XXX
 SG_ DUP__Bit8__CAN_EXTENDED_0 m220 : 16|1@1+ (1,0) [0|1] "" Vector__XXX
 SG_ Source_ID219 m219 : 16|8@1+ (1,0) [0|255] "" Vector__XXX
 SG_ Source_ID218 m218 : 16|8@1+ (1,0) [0|255] "" Vector__XXX
 SG_ Source_ID195 m195 : 16|8@1+ (1,0) [0|255] "" Vector__XXX
 SG_ Source_ID194 m194 : 16|8@1+ (1,0) [0|255] "" Vector__XXX
 SG_ MO_sc1_reso m164 : 16|3@1+ (1,0) [0|7] "" Vector__XXX
 SG_ Ain_in_2_Filter m96 : 16|8@1+ (0.5,0) [0|127.5] "ms" Vector__XXX
 SG_ I1_Adc_Ena m90 : 16|1@1+ (1,0) [0|1] "" Vector__XXX
 SG_ KM_ALLOW_SYNC m81 : 16|1@1+ (1,0) [0|1] "" Vector__XXX
 SG_ Ret_Interval m61 : 16|8@1+ (1,0) [0|255] "ms" Vector__XXX
 SG_ CS_Ain_2_Mode m54 : 16|3@1+ (1,0) [0|7] "" Vector__XXX
 SG_ CMC__Bit13_7__free m205 : 15|7@1+ (1,0) [0|127] "" Vector__XXX
 SG_ Vdc_Ana m90 : 15|1@1+ (1,0) [0|1] "" Vector__XXX
 SG_ KM_MIX_ANA_ON m81 : 15|1@1+ (1,0) [0|1] "" Vector__XXX
 SG_ CS_oora1 m54 : 15|1@1+ (1,0) [0|1] "" Vector__XXX
 SG_ CMC__Bit6__TorqueTimeOut_100ms_E m205 : 14|1@1+ (1,0) [0|1] "" Vector__XXX
 SG_ No_UESP_BTB m90 : 14|1@1+ (1,0) [0|1] "" Vector__XXX
 SG_ KM_N_CLIP m81 : 14|1@1+ (1,0) [0|1] "" Vector__XXX
 SG_ CMC__Bit5__Reset_NRamp_AtNZero m205 : 13|1@1+ (1,0) [0|1] "" Vector__XXX
 SG_ MO_Feedback_2 m164 : 13|3@1+ (1,0) [0|7] "" Vector__XXX
 SG_ REFSOFT m90 : 13|1@1+ (1,0) [0|1] "" Vector__XXX
 SG_ KM_I_LIMIT m81 : 13|1@1+ (1,0) [0|1] "" Vector__XXX
 SG_ CMC__Bit4__Dig_M_RcpRamp_Ena m205 : 12|1@1+ (1,0) [0|1] "" Vector__XXX
 SG_ Compare_Var219 m219 : 12|3@1+ (1,0) [0|7] "" Vector__XXX
 SG_ Compare_Var218 m218 : 12|3@1+ (1,0) [0|7] "" Vector__XXX
 SG_ Compare_Var195 m195 : 12|3@1+ (1,0) [0|7] "" Vector__XXX
 SG_ Compare_Var194 m194 : 12|3@1+ (1,0) [0|7] "" Vector__XXX
 SG_ I_ist_Inverse m90 : 12|1@1+ (1,0) [0|1] "" Vector__XXX
 SG_ KM_TX_TOG_STAT m81 : 12|1@1+ (1,0) [0|1] "" Vector__XXX
 SG_ CS_Ain_1_Mode m54 : 12|3@1+ (1,0) [0|7] "" Vector__XXX
 SG_ CMC__Bit3__TorqueVal_Init_Ena m205 : 11|1@1+ (1,0) [0|1] "" Vector__XXX
 SG_ CoastStop m90 : 11|1@1+ (1,0) [0|1] "" Vector__XXX
 SG_ KM_CAL_OFF m81 : 11|1@1+ (1,0) [0|1] "" Vector__XXX
 SG_ CMC__Bit2__Pdc_Limit_Usage m205 : 10|1@1+ (1,0) [0|1] "" Vector__XXX
 SG_ FB_Special m90 : 10|1@1+ (1,0) [0|1] "" Vector__XXX
 SG_ KM_FRG_OFF m81 : 10|1@1+ (1,0) [0|1] "" Vector__XXX
 SG_ CS_Ain_2_Format m54 : 10|2@1+ (1,0) [0|3] "" Vector__XXX
 SG_ CMC__Bit1__Idc_Limit_Ena m205 : 9|1@1+ (1,0) [0|1] "" Vector__XXX
 SG_ Ballast_Ext m90 : 9|1@1+ (1,0) [0|1] "" Vector__XXX
 SG_ KM_SPEED_0 m81 : 9|1@1+ (1,0) [0|1] "" Vector__XXX
 SG_ Axis m248 : 15|32@0+ (1,0) [0|0] "" Vector__XXX
 SG_ Brake_Delay m241 : 8|16@1+ (1,0) [0|65535] "ms" Vector__XXX
 SG_ T_peak m240 : 8|16@1+ (1,0) [0|65535] "s" Vector__XXX
 SG_ V_Shunt m238 : 8|16@1+ (1,0) [0|65535] "mV" Vector__XXX
 SG_ N_R_Dec m237 : 8|16@1+ (1,0) [0|30000] "ms" Vector__XXX
 SG_ DUP__Bit7_0__DAC_Source_Channel m220 : 8|8@1+ (1,0) [0|255] "" Vector__XXX
 SG_ Ain_in_2_OffsetVal m215 : 8|16@1- (1,0) [-32768|32767] "" Vector__XXX
 SG_ Var_4 m212 : 8|32@1- (1,0) [-2147483648|2147483647] "" Vector__XXX
 SG_ Var_3 m211 : 8|32@1- (1,0) [-2147483648|2147483647] "" Vector__XXX
 SG_ Var_2 m210 : 8|32@1- (1,0) [-2147483648|2147483647] "" Vector__XXX
 SG_ Var_1 m209 : 8|32@1- (1,0) [-2147483648|2147483647] "" Vector__XXX
 SG_ Can_RxTimeout m208 : 8|16@1- (1,0) [0|32767] "ms" Vector__XXX
 SG_ CMC__Bit0__DC_Current_Sens_Ena m205 : 8|1@1+ (1,0) [0|1] "" Vector__XXX
 SG_ PID_I__Kf__Iq m203 : 8|16@1+ (1,0) [0|200] "" Vector__XXX
 SG_ Bat_Opr_Limit__Mot m202 : 8|16@1+ (0.1,0) [0|6553.5] "A or W" Vector__XXX
 SG_ PID_I__xKp__Iq m201 : 8|16@1+ (1,0) [0|200] "%" Vector__XXX
 SG_ Nmax100perc m200 : 8|16@1- (1,0) [-32768|32767] "rpm" Vector__XXX
 SG_ N_R_Lim m199 : 8|16@1+ (1,0) [0|1000] "ms" Vector__XXX
 SG_ I_device m198 : 8|16@1+ (0.1,0) [0|6553.5] "A" Vector__XXX
 SG_ I_con_eff m197 : 8|16@1+ (0.00610388818,0) [0|100] "%" Vector__XXX
 SG_ I_max_pk m196 : 8|16@1+ (0.00610388818,0) [0|100] "%" Vector__XXX
 SG_ Operand219 m219 : 8|4@1+ (1,0) [0|15] "" Vector__XXX
 SG_ Operand218 m218 : 8|4@1+ (1,0) [0|15] "" Vector__XXX
 SG_ Operand195 m195 : 8|4@1+ (1,0) [0|15] "" Vector__XXX
 SG_ Operand194 m194 : 8|4@1+ (1,0) [0|15] "" Vector__XXX
 SG_ def_DIN_2 m193 : 8|15@1+ (1,0) [0|32767] "" Vector__XXX
 SG_ def_DIN_1 m192 : 8|15@1+ (1,0) [0|32767] "" Vector__XXX
 SG_ def_END_2 m191 : 8|15@1+ (1,0) [0|32767] "" Vector__XXX
 SG_ def_END_1 m190 : 8|15@1+ (1,0) [0|32767] "" Vector__XXX
 SG_ Motor_Ts m189 : 8|16@1- (0.001,0) [-32.768|32.767] "ms" Vector__XXX
 SG_ Motor_Rs m188 : 8|16@1+ (1,0) [0|65535] "mOhm" Vector__XXX
 SG_ Motor_Lsd m187 : 8|16@1+ (0.001,0) [0|65.535] "mH" Vector__XXX
 SG_ Motor_Tr m182 : 8|16@1- (1,0) [-32768|32767] "ms" Vector__XXX
 SG_ Id_Min m181 : 8|16@1- (1,0) [0|100] "%" Vector__XXX
 SG_ Motor_Rr m180 : 8|16@1+ (1,0) [0|65535] "mOhm" Vector__XXX
 SG_ Motor_Lm m179 : 8|16@1+ (0.01,0) [0|655.35] "mH" Vector__XXX
 SG_ Id_Nom m178 : 8|16@1- (1,0) [-32768|32767] "%" Vector__XXX
 SG_ Motor_Lsq m177 : 8|16@1+ (0.001,0) [0|65.535] "mH" Vector__XXX
 SG_ FB_Pole m167 : 8|16@1+ (1,0) [0|65535] "" Vector__XXX
 SG_ FB_Incr_Mot m166 : 8|16@1+ (1,0) [0|65535] "Inc/Rev" Vector__XXX
 SG_ DC_Bus_Min_Lim m165 : 8|16@1+ (1,0) [0|65535] "" Vector__XXX
 SG_ MO_Feedback_1 m164 : 8|5@1+ (1,0) [0|31] "" Vector__XXX
 SG_ M_Temp m163 : 8|16@1+ (1,0) [0|32767] "Num" Vector__XXX
 SG_ I_red_TM m162 : 8|16@1+ (1,0) [0|32767] "" Vector__XXX
 SG_ M_setdig__Iq m144 : 8|16@1- (1,0) [-32768|32767] "" Vector__XXX
 SG_ Clear_Errors m142 : 8|16@1+ (1,0) [1|1] "" Vector__XXX
 SG_ V_Ti m141 : 8|16@1+ (1,0) [0|65535] "ms" Vector__XXX
 SG_ V_Kp m140 : 8|16@1+ (1,0) [0|65535] "" Vector__XXX
 SG_ V_Ref m139 : 8|16@1- (1,0) [-32768|32767] "%" Vector__XXX
 SG_ CAN_ID_2_Tx m137 : 8|32@1+ (1,0) [0|4294967295] "" Vector__XXX
 SG_ CAN_ID_2_Rx m136 : 8|32@1+ (1,0) [0|4294967295] "" Vector__XXX
 SG_ Fun_Special m133 : 8|16@1+ (1,0) [0|65535] "" Vector__XXX
 SG_ Eprom132 m132 : 8|8@1+ (1,0) [0|2] "" Vector__XXX
 SG_ Eprom131 m131 : 8|8@1+ (1,0) [0|2] "" Vector__XXX
 SG_ Pos_Diff_Slack m128 : 8|16@1- (1,0) [-32768|32767] "" Vector__XXX
 SG_ Pos_Offset_Slack m127 : 8|32@1- (1,0) [-2147483648|2147483647] "" Vector__XXX
 SG_ FB2_Scale_Ext m126 : 8|32@1- (1,0) [-2147483648|2147483647] "" Vector__XXX
 SG_ Pos_ND_Offset m125 : 8|32@1- (1,0) [-2147483648|2147483647] "" Vector__XXX
 SG_ Pos_ND_Scale m124 : 8|32@1- (1,0) [-2147483648|2147483647] "" Vector__XXX
 SG_ Pos_Preset_Val m122 : 8|32@1- (1,0) [-2147483648|2147483647] "" Vector__XXX
 SG_ Pos_Tol_Win m121 : 8|16@1- (1,0) [-32768|32767] "" Vector__XXX
 SG_ Speed_2 m119 : 8|16@1- (1,0) [-32768|32767] "" Vector__XXX
 SG_ Speed_1 m118 : 8|16@1- (1,0) [-32768|32767] "" Vector__XXX
 SG_ Ref_Reso_Edge m117 : 8|16@1+ (1,0) [0|65535] "" Vector__XXX
 SG_ CAN_NBT m115 : 8|16@1+ (1,0) [0|65535] "" Vector__XXX
 SG_ Pos_OffsRef m114 : 8|32@1- (1,0) [-2147483648|2147483647] "" Vector__XXX
 SG_ Pos_TiM m113 : 8|16@1+ (1,0) [0|100] "" Vector__XXX
 SG_ Pos_Dest m110 : 8|32@1- (1,0) [-2147483648|2147483647] "" Vector__XXX
 SG_ Pos_Td m108 : 8|16@1+ (1,0) [0|65535] "ms" Vector__XXX
 SG_ Pos_Ti m107 : 8|16@1+ (1,0) [0|10000] "ms" Vector__XXX
 SG_ Pos_Kp m106 : 8|16@1+ (1,0) [0|500] "" Vector__XXX
 SG_ CAN_ID_Tx m105 : 8|16@1+ (1,0) [0|65530] "" Vector__XXX
 SG_ CAN_ID_Rx m104 : 8|16@1+ (1,0) [0|65530] "" Vector__XXX
 SG_ DeviceType m103 : 8|8@1+ (1,0) [0|255] "" Vector__XXX
 SG_ Regen_P m101 : 8|16@1+ (1,0) [25|10000] "W" Vector__XXX
 SG_ Device_Mains m100 : 8|16@1+ (1,0) [0|1000] "V" Vector__XXX
 SG_ SNr m98 : 8|32@1+ (1,0) [0|4294967295] "" Vector__XXX
 SG_ Ain_in_1_Filter m96 : 8|8@1+ (0.5,0) [0|127.5] "ms" Vector__XXX
 SG_ Speed_Filter m94 : 8|16@1+ (1,0) [0|15] "" Vector__XXX
 SG_ PID_n__Kacc m91 : 8|16@1- (1,0) [0|100] "%" Vector__XXX
 SG_ DC_BUS_comp m90 : 8|1@1+ (1,0) [0|1] "" Vector__XXX
 SG_ n_Nom m89 : 8|16@1+ (1,0) [60|65000] "rpm" Vector__XXX
 SG_ I_red_TD m88 : 8|16@1+ (1,0) [0|32767] "" Vector__XXX
 SG_ Ain_in_2_Cutoff m83 : 8|16@1- (1,0) [-32768|32767] "" Vector__XXX
 SG_ KM_rsvd_0 m81 : 8|1@1+ (1,0) [0|1] "" Vector__XXX
 SG_ Ain_in_1_Cutoff m80 : 8|16@1- (1,0) [0|32767] "" Vector__XXX
 SG_ Motor_Pole m79 : 8|16@1+ (1,0) [2|96] "" Vector__XXX
 SG_ I_nom_eff m78 : 8|16@1+ (0.1,0) [0|6553.5] "0,1" Vector__XXX
 SG_ I_max_eff m77 : 8|16@1+ (0.1,0) [0|3276.7] "Arms" Vector__XXX
 SG_ I_red_TE m76 : 8|16@1+ (1,0) [0|32767] "" Vector__XXX
 SG_ I_lim_dig m70 : 8|16@1- (0.003051851,0) [0|100] "%" Vector__XXX
 SG_ Read_ID m61 : 8|8@1+ (1,0) [0|255] "" Vector__XXX
 SG_ FB_Offset m68 : 8|16@1- (0.1,0) [-360|360] "" Vector__XXX
 SG_ N_Lim_plus m63 : 8|16@1- (0.003051851,0) [0|100] "%" Vector__XXX
 SG_ N_Lim_minus m62 : 8|16@1- (0.003051851,0) [-100|0] "%" Vector__XXX
 SG_ I_red_N m60 : 8|16@1+ (0.003051851,0) [0|100] "%" Vector__XXX
 SG_ PID_n__TiM m59 : 8|16@1+ (1,0) [0|100] "%" Vector__XXX
 SG_ CS_Ain_1_Format m54 : 8|2@1+ (1,0) [0|3] "" Vector__XXX
 SG_ N_R_Acc m53 : 8|16@1+ (1,0) [0|30000] "ms" Vector__XXX
 SG_ N_Lim m52 : 8|16@1- (0.003051851,0) [-100|100] "%" Vector__XXX
 SG_ N_setdig m49 : 8|16@1- (0.2166814173,0) [-7100|7100] "Num" Vector__XXX
 SG_ Ain_in_1_OffsetVal m47 : 8|16@1- (1,0) [-32768|32767] "" Vector__XXX
 SG_ PID_n__Td m46 : 8|16@1+ (1,0) [0|10000] "ms" Vector__XXX
 SG_ PID_n__Ti m45 : 8|16@1+ (1,0) [0|10000] "ms" Vector__XXX
 SG_ PID_n__Kp m44 : 8|16@1+ (1,0) [0|200] "" Vector__XXX
 SG_ PID_I__TiM__Iq m43 : 8|16@1+ (1,0) [0|500] "" Vector__XXX
 SG_ I_Delta_Ramp m37 : 8|16@1- (1,0) [-32768|32767] "" Vector__XXX
 SG_ ID_setdig__Id m33 : 8|16@1- (0.37383776,0) [-12249.91571968|12249.54188192] "Arms" Vector__XXX
 SG_ Cutoffdig m30 : 8|16@1+ (1,0) [0|65535] "" Vector__XXX
 SG_ PID_I__Ti__Iq m29 : 8|16@1+ (1,0) [300|20000] "" Vector__XXX
 SG_ PID_I__Kp__Iq m28 : 8|16@1+ (1,0) [0|200] "" Vector__XXX
 SG_ Calib_Ref_Value m26 : 8|16@1+ (0.1,0) [0|6553.5] "" Vector__XXX
 SG_ Oszi_Run_cmd m24 : 8|16@1+ (1,0) [0|65535] "" Vector__XXX
 SG_ Oszi_Read_cmd m23 : 8|16@1+ (1,0) [0|65535] "" Vector__XXX
 SG_ Oszi_Skip m22 : 8|16@1+ (1,0) [0|65535] "" Vector__XXX
 SG_ Oszi_Source m21 : 8|16@1+ (1,0) [0|65535] "" Vector__XXX
 SG_ Trig_Source m20 : 8|16@1+ (1,0) [0|65535] "" Vector__XXX
 SG_ Trig_Edge m19 : 8|16@1- (1,0) [-32768|32767] "" Vector__XXX
 SG_ Trig_Level m18 : 8|16@1- (1,0) [-32768|32767] "" Vector__XXX
 SG_ Capture_Channel m16 : 8|16@1- (1,0) [-32768|32767] "" Vector__XXX
 SG_ Extra__Start m15 : 8|16@1- (1,0) [-32768|32767] "" Vector__XXX
 SG_ Cos_Phi m14 : 8|16@1+ (1,0) [0|65535] "" Vector__XXX
 SG_ F_corner__Start m13 : 8|16@1- (0.1,0) [-3276.8|3276.7] "Hz" Vector__XXX
 SG_ V_corner__Start m12 : 8|16@1- (0.1,0) [-3276.8|3276.7] "%" Vector__XXX
 SG_ F_min__Start m11 : 8|16@1- (0.1,0) [-3276.8|3276.7] "Hz" Vector__XXX
 SG_ V_min__Start m10 : 8|16@1- (0.1,0) [-3276.8|3276.7] "%" Vector__XXX
 SG_ Special__Start m9 : 8|16@1- (1,0) [-32768|32767] "" Vector__XXX
 SG_ V_dc__Start m8 : 8|16@1- (0.1,0) [-3276.8|3276.7] "%" Vector__XXX
 SG_ T_dc__Start m7 : 8|16@1+ (1,0) [0|65535] "ms" Vector__XXX
 SG_ Motor_F_N m5 : 8|16@1+ (0.1,0) [0|6553.5] "Hz" Vector__XXX
 SG_ Send_Mux M : 0|8@1+ (1,0) [0|0] "" Vector__XXX

BO_ 385 Inverter_L_Rcv: 6 Vector__XXX
 SG_ HndWhl82 m82 : 39|1@1+ (1,0) [0|1] "" Vector__XXX
 SG_ Warn_Ballast m143 : 39|1@1+ (1,0) [0|1] "" Vector__XXX
 SG_ HndWhl64 m64 : 39|1@1+ (1,0) [0|1] "" Vector__XXX
 SG_ ReduceLosses m90 : 39|1@1+ (1,0) [0|1] "" Vector__XXX
 SG_ MD82 m82 : 38|1@1+ (1,0) [0|1] "" Vector__XXX
 SG_ MD64 m64 : 38|1@1+ (1,0) [0|1] "" Vector__XXX
 SG_ DC_1Q3P m90 : 38|1@1+ (1,0) [0|1] "" Vector__XXX
 SG_ RFEpulse82 m82 : 37|1@1+ (1,0) [0|1] "" Vector__XXX
 SG_ RFEpulse64 m64 : 37|1@1+ (1,0) [0|1] "" Vector__XXX
 SG_ DC_1QMV m90 : 37|1@1+ (1,0) [0|1] "" Vector__XXX
 SG_ Iwcns82 m82 : 36|1@1+ (1,0) [0|1] "" Vector__XXX
 SG_ Iwcns64 m64 : 36|1@1+ (1,0) [0|1] "" Vector__XXX
 SG_ block m90 : 36|1@1+ (1,0) [0|1] "" Vector__XXX
 SG_ IrdANA82 m82 : 35|1@1+ (1,0) [0|1] "" Vector__XXX
 SG_ IrdANA64 m64 : 35|1@1+ (1,0) [0|1] "" Vector__XXX
 SG_ DEAD_2 m90 : 35|1@1+ (1,0) [0|1] "" Vector__XXX
 SG_ IrdTM82 m82 : 34|1@1+ (1,0) [0|1] "" Vector__XXX
 SG_ Warn_RaceAway m143 : 34|1@1+ (1,0) [0|1] "" Vector__XXX
 SG_ IrdTM64 m64 : 34|1@1+ (1,0) [0|1] "" Vector__XXX
 SG_ DC_field m90 : 34|1@1+ (1,0) [0|1] "" Vector__XXX
 SG_ _10Hz82 m82 : 33|1@1+ (1,0) [0|1] "" Vector__XXX
 SG_ Warn_IPeak m143 : 33|1@1+ (1,0) [0|1] "" Vector__XXX
 SG_ _10Hz64 m64 : 33|1@1+ (1,0) [0|1] "" Vector__XXX
 SG_ DC_1QdirVolt m90 : 33|1@1+ (1,0) [0|1] "" Vector__XXX
 SG_ CMC__Bit31_24__free m205 : 32|8@1+ (1,0) [0|255] "" Vector__XXX
 SG_ IrdTIR82 m82 : 32|1@1+ (1,0) [0|1] "" Vector__XXX
 SG_ Warn_Vout_Sat m143 : 32|1@1+ (1,0) [0|1] "" Vector__XXX
 SG_ IrdTIR64 m64 : 32|1@1+ (1,0) [0|1] "" Vector__XXX
 SG_ delta m90 : 32|1@1+ (1,0) [0|1] "" Vector__XXX
 SG_ M_R_Acc m53 : 32|16@1+ (1,0) [0|4000] "ms" Vector__XXX
 SG_ CMC__Bit23__TC_nCmdRestOption m205 : 31|1@1+ (1,0) [0|1] "" Vector__XXX
 SG_ IrdTi82 m82 : 31|1@1+ (1,0) [0|1] "" Vector__XXX
 SG_ Warn_DeviceTemp m143 : 31|1@1+ (1,0) [0|1] "" Vector__XXX
 SG_ IrdTi64 m64 : 31|1@1+ (1,0) [0|1] "" Vector__XXX
 SG_ NTC m90 : 31|1@1+ (1,0) [0|1] "" Vector__XXX
 SG_ DUP__Bit31_22__free m220 : 30|10@1+ (1,0) [0|1023] "" Vector__XXX
 SG_ IrdN82 m82 : 30|1@1+ (1,0) [0|1] "" Vector__XXX
 SG_ Warn_MotorTemp m143 : 30|1@1+ (1,0) [0|1] "" Vector__XXX
 SG_ IrdN64 m64 : 30|1@1+ (1,0) [0|1] "" Vector__XXX
 SG_ DUP__Bit21__InitWith_FRG_OFF m220 : 29|1@1+ (1,0) [0|1] "" Vector__XXX
 SG_ CMC__Bit22_21__TC_MinSpeed_conf m205 : 29|2@1+ (1,0) [0|3] "" Vector__XXX
 SG_ Iuserchd82 m82 : 29|1@1+ (1,0) [0|1] "" Vector__XXX
 SG_ Iuserchd64 m64 : 29|1@1+ (1,0) [0|1] "" Vector__XXX
 SG_ DUP__Bit20__HAL_Extmr_Acv m220 : 28|1@1+ (1,0) [0|1] "" Vector__XXX
 SG_ IrdDig82 m82 : 28|1@1+ (1,0) [0|1] "" Vector__XXX
 SG_ IrdDig64 m64 : 28|1@1+ (1,0) [0|1] "" Vector__XXX
 SG_ PWM_Freq m90 : 28|3@1+ (1,0) [0|7] "" Vector__XXX
 SG_ CMC__Bit20_19__TC_DeltaTime_conf m205 : 27|2@1+ (1,0) [0|3] "" Vector__XXX
 SG_ Nclip_plus82 m82 : 27|1@1+ (1,0) [0|1] "" Vector__XXX
 SG_ Nclip_plus64 m64 : 27|1@1+ (1,0) [0|1] "" Vector__XXX
 SG_ AC_DC m90 : 27|1@1+ (1,0) [0|1] "" Vector__XXX
 SG_ CMC__Bit18__TractionControl_Ena m205 : 26|1@1+ (1,0) [0|1] "" Vector__XXX
 SG_ Nclip_minus82 m82 : 26|1@1+ (1,0) [0|1] "" Vector__XXX
 SG_ Warn_Safe_In m143 : 26|1@1+ (1,0) [0|1] "" Vector__XXX
 SG_ Nclip_minus64 m64 : 26|1@1+ (1,0) [0|1] "" Vector__XXX
 SG_ MotBrake m90 : 26|1@1+ (1,0) [0|1] "" Vector__XXX
 SG_ DUP__Bit19_17__ECODE_ReDefine m220 : 25|3@1+ (1,0) [0|7] "" Vector__XXX
 SG_ Nclip82 m82 : 25|1@1+ (1,0) [0|1] "" Vector__XXX
 SG_ Warn_Illegal_Status m143 : 25|1@1+ (1,0) [0|1] "" Vector__XXX
 SG_ Nclip64 m64 : 25|1@1+ (1,0) [0|1] "" Vector__XXX
 SG_ Ramp4 m90 : 25|1@1+ (1,0) [0|1] "" Vector__XXX
 SG_ SVNRevision_Nr m254 : 24|16@1+ (1,0) [0|65535] "" Vector__XXX
 SG_ free m58 : 24|16@1- (1,0) [-32768|32767] "Num" Vector__XXX
 SG_ Special__Stop m9 : 24|16@1- (1,0) [-32768|32767] "" Vector__XXX
 SG_ DUP__Bit16__Bamobil3_2_OffCrct m220 : 24|1@1+ (1,0) [0|1] "" Vector__XXX
 SG_ CMC__Bit17_16__CheckIPeak_config m205 : 24|2@1+ (1,0) [0|3] "" Vector__XXX
 SG_ PID_I__Kf__Id m203 : 24|16@1+ (1,0) [0|200] "" Vector__XXX
 SG_ Bat_Opr_Limit__Gen m202 : 24|16@1+ (0.1,0) [0|6553.5] "A or W" Vector__XXX
 SG_ PID_I__xKp__Id m201 : 24|16@1+ (1,0) [0|200] "%" Vector__XXX
 SG_ DC_Bus_Max_Lim m165 : 24|16@1+ (1,0) [0|65535] "" Vector__XXX
 SG_ Regen_R m101 : 24|16@1+ (1,0) [0|65535] "Ohm" Vector__XXX
 SG_ SignMag82 m82 : 24|1@1+ (1,0) [0|1] "" Vector__XXX
 SG_ Ain_in_2_ScaleVal m215 : 24|16@1- (0.000244140625,0) [-8|7.999755859375] "" Vector__XXX
 SG_ Ain_in_1_ScaleVal m47 : 24|16@1- (0.000244140625,0) [-7.999|7.999] "" Vector__XXX
 SG_ PID_I__TiM__Id m43 : 24|16@1+ (1,0) [0|500] "" Vector__XXX
 SG_ PID_I__Ti__Id m29 : 24|16@1+ (1,0) [300|20000] "" Vector__XXX
 SG_ PID_I__Kp__Id m28 : 24|16@1+ (1,0) [0|200] "" Vector__XXX
 SG_ F_corner__Stop m13 : 24|16@1- (0.1,0) [-3276.8|3276.7] "Hz" Vector__XXX
 SG_ V_corner__Stop m12 : 24|16@1- (0.1,0) [-3276.8|3276.7] "%" Vector__XXX
 SG_ F_min__Stop m11 : 24|16@1- (0.1,0) [-3276.8|3276.7] "Hz" Vector__XXX
 SG_ V_min__Stop m10 : 24|16@1- (0.1,0) [-3276.8|3276.7] "%" Vector__XXX
 SG_ V_dc__Stop m8 : 24|16@1- (0.1,0) [-3276.8|3276.7] "%" Vector__XXX
 SG_ T_dc__Stop m7 : 24|16@1+ (1,0) [0|65535] "ms" Vector__XXX
 SG_ Ain_in_2_scaled214 m214 : 24|16@1- (1,0) [-32768|32767] "" Vector__XXX
 SG_ Ain_in_1_scaled213 m213 : 24|16@1- (1,0) [-32768|32767] "" Vector__XXX
 SG_ Warn_Warning_0 m143 : 24|1@1+ (1,0) [0|1] "" Vector__XXX
 SG_ SignMag64 m64 : 24|1@1+ (1,0) [0|1] "" Vector__XXX
 SG_ SRamp m90 : 24|1@1+ (1,0) [0|1] "" Vector__XXX
 SG_ M_R_Rcp m199 : 24|16@1+ (1,0) [0|4000] "ms" Vector__XXX
 SG_ M_R_Dec m237 : 24|16@1+ (1,0) [0|4000] "ms" Vector__XXX
 SG_ DUP__Bit15__CANopen_Acv m220 : 23|1@1+ (1,0) [0|1] "" Vector__XXX
 SG_ CMC__Bit15__Dig_E_Brake_Act m205 : 23|1@1+ (1,0) [0|1] "" Vector__XXX
 SG_ Gen_AutoIacLimit_is_Acv m204 : 23|1@1+ (1,0) [0|1] "" Vector__XXX
 SG_ Active193 m193 : 23|1@1+ (1,0) [0|1] "" Vector__XXX
 SG_ Active192 m192 : 23|1@1+ (1,0) [0|1] "" Vector__XXX
 SG_ Active191 m191 : 23|1@1+ (1,0) [0|1] "" Vector__XXX
 SG_ Active190 m190 : 23|1@1+ (1,0) [0|1] "" Vector__XXX
 SG_ MO_sc2_inv m164 : 23|1@1+ (1,0) [0|1] "" Vector__XXX
 SG_ Ecode_Bit15__T_IGBT148 m148 : 23|1@1+ (1,0) [0|1] "" Vector__XXX
 SG_ Ecode_Bit15__T_IGBT99 m99 : 23|1@1+ (1,0) [0|1] "" Vector__XXX
 SG_ Brk082 m82 : 23|1@1+ (1,0) [0|1] "" Vector__XXX
 SG_ KM_DEBUG_TEST m81 : 23|1@1+ (1,0) [0|1] "" Vector__XXX
 SG_ CS_Ain_1__N_Limit m54 : 23|1@1+ (1,0) [0|1] "" Vector__XXX
 SG_ BRK1216 m216 : 23|1@1+ (1,0) [0|1] "" Vector__XXX
 SG_ Err_Ballast m143 : 23|1@1+ (1,0) [0|1] "" Vector__XXX
 SG_ Brk064 m64 : 23|1@1+ (1,0) [0|1] "" Vector__XXX
 SG_ LowBd m90 : 23|1@1+ (1,0) [0|1] "" Vector__XXX
 SG_ DUP__Bit14__MTPA_reluct_enab m220 : 22|1@1+ (1,0) [0|1] "" Vector__XXX
 SG_ CMC__Bit14__Idc_Limit_Ena_V2 m205 : 22|1@1+ (1,0) [0|1] "" Vector__XXX
 SG_ Ecode_Bit14__UBMAm148 m148 : 22|1@1+ (1,0) [0|1] "" Vector__XXX
 SG_ Ecode_Bit14__UBMAm99 m99 : 22|1@1+ (1,0) [0|1] "" Vector__XXX
 SG_ Rdy82 m82 : 22|1@1+ (1,0) [0|1] "" Vector__XXX
 SG_ KM_PSEUDO_ENABLE m81 : 22|1@1+ (1,0) [0|1] "" Vector__XXX
 SG_ CS_Ain_2__I_Limit m54 : 22|1@1+ (1,0) [0|1] "" Vector__XXX
 SG_ GOFF m216 : 22|1@1+ (1,0) [0|1] "" Vector__XXX
 SG_ Err_HWErr m143 : 22|1@1+ (1,0) [0|1] "" Vector__XXX
 SG_ Rdy64 m64 : 22|1@1+ (1,0) [0|1] "" Vector__XXX
 SG_ Ana_0up m90 : 22|1@1+ (1,0) [0|1] "" Vector__XXX
 SG_ DUP__Bit13__Gen_AutoIacLimit m220 : 21|1@1+ (1,0) [0|1] "" Vector__XXX
 SG_ Ecode_Bit13__18m_plus148 m148 : 21|1@1+ (1,0) [0|1] "" Vector__XXX
 SG_ Ecode_Bit13__18m_plus99 m99 : 21|1@1+ (1,0) [0|1] "" Vector__XXX
 SG_ Tol82 m82 : 21|1@1+ (1,0) [0|1] "" Vector__XXX
 SG_ KM_rsvd_13 m81 : 21|1@1+ (1,0) [0|1] "" Vector__XXX
 SG_ OUT4 m216 : 21|1@1+ (1,0) [0|1] "" Vector__XXX
 SG_ Tol64 m64 : 21|1@1+ (1,0) [0|1] "" Vector__XXX
 SG_ DUP__Bit12__Boat_Pedal m220 : 20|1@1+ (1,0) [0|1] "" Vector__XXX
 SG_ MO_sc2_reso m164 : 20|3@1+ (1,0) [0|7] "" Vector__XXX
 SG_ Ecode_Bit12__15m_plus148 m148 : 20|1@1+ (1,0) [0|1] "" Vector__XXX
 SG_ Ecode_Bit12__15m_plus99 m99 : 20|1@1+ (1,0) [0|1] "" Vector__XXX
 SG_ Cal82 m82 : 20|1@1+ (1,0) [0|1] "" Vector__XXX
 SG_ KM_rsvd_12 m81 : 20|1@1+ (1,0) [0|1] "" Vector__XXX
 SG_ CurrentMode m17 : 20|4@1+ (1,0) [0|15] "" Vector__XXX
 SG_ CS_CMD_Type m54 : 20|2@1+ (1,0) [0|3] "" Vector__XXX
 SG_ OUT3 m216 : 20|1@1+ (1,0) [0|1] "" Vector__XXX
 SG_ Cal64 m64 : 20|1@1+ (1,0) [0|1] "" Vector__XXX
 SG_ MotorType m90 : 20|2@1+ (1,0) [0|3] "" Vector__XXX
 SG_ Test m27 : 20|4@1+ (1,0) [0|15] "" Vector__XXX
 SG_ DUP__Bit11__DCBus_Volts m220 : 19|1@1+ (1,0) [0|1] "" Vector__XXX
 SG_ MO_sc1_comp m164 : 19|1@1+ (1,0) [0|1] "" Vector__XXX
 SG_ Ecode_Bit11__15m_minus148 m148 : 19|1@1+ (1,0) [0|1] "" Vector__XXX
 SG_ Ecode_Bit11__15m_minus99 m99 : 19|1@1+ (1,0) [0|1] "" Vector__XXX
 SG_ Cal082 m82 : 19|1@1+ (1,0) [0|1] "" Vector__XXX
 SG_ KM_rsvd_11 m81 : 19|1@1+ (1,0) [0|1] "" Vector__XXX
 SG_ CS_oora2 m54 : 19|1@1+ (1,0) [0|1] "" Vector__XXX
 SG_ GO216 m216 : 19|1@1+ (1,0) [0|1] "" Vector__XXX
 SG_ Err_USER m143 : 19|1@1+ (1,0) [0|1] "" Vector__XXX
 SG_ Cal064 m64 : 19|1@1+ (1,0) [0|1] "" Vector__XXX
 SG_ OL_comp m90 : 19|1@1+ (1,0) [0|1] "" Vector__XXX
 SG_ DUP__Bit10__PARK_RMS m220 : 18|1@1+ (1,0) [0|1] "" Vector__XXX
 SG_ Ecode_Bit10__VCCm148 m148 : 18|1@1+ (1,0) [0|1] "" Vector__XXX
 SG_ Ecode_Bit10__VCCm99 m99 : 18|1@1+ (1,0) [0|1] "" Vector__XXX
 SG_ Rsw82 m82 : 18|1@1+ (1,0) [0|1] "" Vector__XXX
 SG_ KM_PHASING_EXTEND m81 : 18|1@1+ (1,0) [0|1] "" Vector__XXX
 SG_ BTBRdy m216 : 18|1@1+ (1,0) [0|1] "" Vector__XXX
 SG_ Err_RaceAway m143 : 18|1@1+ (1,0) [0|1] "" Vector__XXX
 SG_ Rsw64 m64 : 18|1@1+ (1,0) [0|1] "" Vector__XXX
 SG_ H2inv m90 : 18|1@1+ (1,0) [0|1] "" Vector__XXX
 SG_ DUP__Bit9__GENERATOR m220 : 17|1@1+ (1,0) [0|1] "" Vector__XXX
 SG_ Ecode_Bit9__FAIL_I148 m148 : 17|1@1+ (1,0) [0|1] "" Vector__XXX
 SG_ Ecode_Bit9__FAIL_I99 m99 : 17|1@1+ (1,0) [0|1] "" Vector__XXX
 SG_ _N082 m82 : 17|1@1+ (1,0) [0|1] "" Vector__XXX
 SG_ KM_HANDWHEEL m81 : 17|1@1+ (1,0) [0|1] "" Vector__XXX
 SG_ OUT2 m216 : 17|1@1+ (1,0) [0|1] "" Vector__XXX
 SG_ Err_IPeak m143 : 17|1@1+ (1,0) [0|1] "" Vector__XXX
 SG_ _N064 m64 : 17|1@1+ (1,0) [0|1] "" Vector__XXX
 SG_ Hxinv m90 : 17|1@1+ (1,0) [0|1] "" Vector__XXX
 SG_ DUP__Bit8__CAN_EXTENDED_0 m220 : 16|1@1+ (1,0) [0|1] "" Vector__XXX
 SG_ Source_ID219 m219 : 16|8@1+ (1,0) [0|255] "" Vector__XXX
 SG_ Source_ID218 m218 : 16|8@1+ (1,0) [0|255] "" Vector__XXX
 SG_ Source_ID195 m195 : 16|8@1+ (1,0) [0|255] "" Vector__XXX
 SG_ Source_ID194 m194 : 16|8@1+ (1,0) [0|255] "" Vector__XXX
 SG_ MO_sc1_reso m164 : 16|3@1+ (1,0) [0|7] "" Vector__XXX
 SG_ Ecode_Bit8__FAIL_IDC148 m148 : 16|1@1+ (1,0) [0|1] "" Vector__XXX
 SG_ Ecode_Bit8__FAIL_IDC99 m99 : 16|1@1+ (1,0) [0|1] "" Vector__XXX
 SG_ Ain_in_2_Filter m96 : 16|8@1+ (0.5,0) [0|127.5] "ms" Vector__XXX
 SG_ NI82 m82 : 16|1@1+ (1,0) [0|1] "" Vector__XXX
 SG_ KM_ALLOW_SYNC m81 : 16|1@1+ (1,0) [0|1] "" Vector__XXX
 SG_ CtrlSubMode m17 : 16|4@1+ (1,0) [0|15] "" Vector__XXX
 SG_ CS_Ain_2_Mode m54 : 16|3@1+ (1,0) [0|7] "" Vector__XXX
 SG_ OUT1 m216 : 16|1@1+ (1,0) [0|1] "" Vector__XXX
 SG_ Err_OverVoltage m143 : 16|1@1+ (1,0) [0|1] "" Vector__XXX
 SG_ NI64 m64 : 16|1@1+ (1,0) [0|1] "" Vector__XXX
 SG_ I1_Adc_Ena m90 : 16|1@1+ (1,0) [0|1] "" Vector__XXX
 SG_ brk1155 m155 : 15|1@1+ (1,0) [0|1] "" Vector__XXX
 SG_ CMC__Bit13_7__free m205 : 15|7@1+ (1,0) [0|127] "" Vector__XXX
 SG_ Ecode_Bit7__FLTLS148 m148 : 15|1@1+ (1,0) [0|1] "" Vector__XXX
 SG_ Ecode_Bit7__FLTLS99 m99 : 15|1@1+ (1,0) [0|1] "" Vector__XXX
 SG_ PN82 m82 : 15|1@1+ (1,0) [0|1] "" Vector__XXX
 SG_ KM_MIX_ANA_ON m81 : 15|1@1+ (1,0) [0|1] "" Vector__XXX
 SG_ CS_oora1 m54 : 15|1@1+ (1,0) [0|1] "" Vector__XXX
 SG_ Err_DeviceTemp m143 : 15|1@1+ (1,0) [0|1] "" Vector__XXX
 SG_ PN64 m64 : 15|1@1+ (1,0) [0|1] "" Vector__XXX
 SG_ Vdc_Ana m90 : 15|1@1+ (1,0) [0|1] "" Vector__XXX
 SG_ rsvd1 m155 : 14|1@1+ (1,0) [0|1] "" Vector__XXX
 SG_ rsvd m152 : 14|2@1+ (1,0) [0|3] "" Vector__XXX
 SG_ CMC__Bit6__TorqueTimeOut_100ms_E m205 : 14|1@1+ (1,0) [0|1] "" Vector__XXX
 SG_ I_DC_Limit_is_Acv m204 : 14|1@1+ (1,0) [0|1] "" Vector__XXX
 SG_ Ecode_Bit6__FLTHS148 m148 : 14|1@1+ (1,0) [0|1] "" Vector__XXX
 SG_ Ecode_Bit6__FLTHS99 m99 : 14|1@1+ (1,0) [0|1] "" Vector__XXX
 SG_ TNLim82 m82 : 14|1@1+ (1,0) [0|1] "" Vector__XXX
 SG_ KM_N_CLIP m81 : 14|1@1+ (1,0) [0|1] "" Vector__XXX
 SG_ Err_MotorTemp m143 : 14|1@1+ (1,0) [0|1] "" Vector__XXX
 SG_ TNLim64 m64 : 14|1@1+ (1,0) [0|1] "" Vector__XXX
 SG_ No_UESP_BTB m90 : 14|1@1+ (1,0) [0|1] "" Vector__XXX
 SG_ Out_4 m155 : 13|1@1+ (1,0) [0|1] "" Vector__XXX
 SG_ RFE152 m152 : 13|1@1+ (1,0) [0|1] "" Vector__XXX
 SG_ CMC__Bit5__Reset_NRamp_AtNZero m205 : 13|1@1+ (1,0) [0|1] "" Vector__XXX
 SG_ Recup_is_Acv m204 : 13|1@1+ (1,0) [0|1] "" Vector__XXX
 SG_ MO_Feedback_2 m164 : 13|3@1+ (1,0) [0|7] "" Vector__XXX
 SG_ Ecode_Bit5__N_FAIL148 m148 : 13|1@1+ (1,0) [0|1] "" Vector__XXX
 SG_ Ecode_Bit5__N_FAIL99 m99 : 13|1@1+ (1,0) [0|1] "" Vector__XXX
 SG_ Icns82 m82 : 13|1@1+ (1,0) [0|1] "" Vector__XXX
 SG_ KM_I_LIMIT m81 : 13|1@1+ (1,0) [0|1] "" Vector__XXX
 SG_ RFE216 m216 : 13|1@1+ (1,0) [0|1] "" Vector__XXX
 SG_ Err_PowerVoltage_Low m143 : 13|1@1+ (1,0) [0|1] "" Vector__XXX
 SG_ Icns64 m64 : 13|1@1+ (1,0) [0|1] "" Vector__XXX
 SG_ REFSOFT m90 : 13|1@1+ (1,0) [0|1] "" Vector__XXX
 SG_ Out_3 m155 : 12|1@1+ (1,0) [0|1] "" Vector__XXX
 SG_ Run152 m152 : 12|1@1+ (1,0) [0|1] "" Vector__XXX
 SG_ CMC__Bit4__Dig_M_RcpRamp_Ena m205 : 12|1@1+ (1,0) [0|1] "" Vector__XXX
 SG_ Compare_Var219 m219 : 12|3@1+ (1,0) [0|7] "" Vector__XXX
 SG_ Compare_Var218 m218 : 12|3@1+ (1,0) [0|7] "" Vector__XXX
 SG_ Compare_Var195 m195 : 12|3@1+ (1,0) [0|7] "" Vector__XXX
 SG_ Compare_Var194 m194 : 12|3@1+ (1,0) [0|7] "" Vector__XXX
 SG_ Ecode_Bit4__RDY3148 m148 : 12|1@1+ (1,0) [0|1] "" Vector__XXX
 SG_ Ecode_Bit4__RDY399 m99 : 12|1@1+ (1,0) [0|1] "" Vector__XXX
 SG_ OK82 m82 : 12|1@1+ (1,0) [0|1] "" Vector__XXX
 SG_ KM_TX_TOG_STAT m81 : 12|1@1+ (1,0) [0|1] "" Vector__XXX
 SG_ CS_Ain_1_Mode m54 : 12|3@1+ (1,0) [0|7] "" Vector__XXX
 SG_ FRGRUN m216 : 12|1@1+ (1,0) [0|1] "" Vector__XXX
 SG_ Err_FeedbackSignal m143 : 12|1@1+ (1,0) [0|1] "" Vector__XXX
 SG_ OK64 m64 : 12|1@1+ (1,0) [0|1] "" Vector__XXX
 SG_ I_ist_Inverse m90 : 12|1@1+ (1,0) [0|1] "" Vector__XXX
 SG_ Go155 m155 : 11|1@1+ (1,0) [0|1] "" Vector__XXX
 SG_ In_1 m152 : 11|1@1+ (1,0) [0|1] "" Vector__XXX
 SG_ CMC__Bit3__TorqueVal_Init_Ena m205 : 11|1@1+ (1,0) [0|1] "" Vector__XXX
 SG_ Ecode_Bit3__Free148 m148 : 11|1@1+ (1,0) [0|1] "" Vector__XXX
 SG_ Ecode_Bit3__Free99 m99 : 11|1@1+ (1,0) [0|1] "" Vector__XXX
 SG_ Lim_minus82 m82 : 11|1@1+ (1,0) [0|1] "" Vector__XXX
 SG_ KM_CAL_OFF m81 : 11|1@1+ (1,0) [0|1] "" Vector__XXX
 SG_ IN1 m216 : 11|1@1+ (1,0) [0|1] "" Vector__XXX
 SG_ Err_BusTimeout m143 : 11|1@1+ (1,0) [0|1] "" Vector__XXX
 SG_ Lim_minus64 m64 : 11|1@1+ (1,0) [0|1] "" Vector__XXX
 SG_ CoastStop m90 : 11|1@1+ (1,0) [0|1] "" Vector__XXX
 SG_ Rdy155 m155 : 10|1@1+ (1,0) [0|1] "" Vector__XXX
 SG_ In_2 m152 : 10|1@1+ (1,0) [0|1] "" Vector__XXX
 SG_ CMC__Bit2__Pdc_Limit_Usage m205 : 10|1@1+ (1,0) [0|1] "" Vector__XXX
 SG_ Op_Mode_Quadrant m204 : 10|3@1+ (1,0) [0|7] "" Vector__XXX
 SG_ Ecode_Bit2__HW0_State148 m148 : 10|1@1+ (1,0) [0|1] "" Vector__XXX
 SG_ Ecode_Bit2__HW0_State99 m99 : 10|1@1+ (1,0) [0|1] "" Vector__XXX
 SG_ Lim_plus82 m82 : 10|1@1+ (1,0) [0|1] "" Vector__XXX
 SG_ KM_FRG_OFF m81 : 10|1@1+ (1,0) [0|1] "" Vector__XXX
 SG_ CS_Ain_2_Format m54 : 10|2@1+ (1,0) [0|3] "" Vector__XXX
 SG_ IN2 m216 : 10|1@1+ (1,0) [0|1] "" Vector__XXX
 SG_ Err_RFE_Fault m143 : 10|1@1+ (1,0) [0|1] "" Vector__XXX
 SG_ Lim_plus64 m64 : 10|1@1+ (1,0) [0|1] "" Vector__XXX
 SG_ FB_Special m90 : 10|1@1+ (1,0) [0|1] "" Vector__XXX
 SG_ Out_2 m155 : 9|1@1+ (1,0) [0|1] "" Vector__XXX
 SG_ Lmt_2 m152 : 9|1@1+ (1,0) [0|1] "" Vector__XXX
 SG_ CMC__Bit1__Idc_Limit_Ena m205 : 9|1@1+ (1,0) [0|1] "" Vector__XXX
 SG_ DC_I_SensEna_Set m204 : 9|1@1+ (1,0) [0|1] "" Vector__XXX
 SG_ Ecode_Bit1__HW1_State148 m148 : 9|1@1+ (1,0) [0|1] "" Vector__XXX
 SG_ Ecode_Bit1__HW1_State99 m99 : 9|1@1+ (1,0) [0|1] "" Vector__XXX
 SG_ NcR082 m82 : 9|1@1+ (1,0) [0|1] "" Vector__XXX
 SG_ KM_SPEED_0 m81 : 9|1@1+ (1,0) [0|1] "" Vector__XXX
 SG_ LMT2 m216 : 9|1@1+ (1,0) [0|1] "" Vector__XXX
 SG_ Err_PowerFault m143 : 9|1@1+ (1,0) [0|1] "" Vector__XXX
 SG_ NcR064 m64 : 9|1@1+ (1,0) [0|1] "" Vector__XXX
 SG_ Ballast_Ext m90 : 9|1@1+ (1,0) [0|1] "" Vector__XXX
 SG_ SubVersion_Nr m254 : 8|16@1+ (1,0) [0|65535] "" Vector__XXX
 SG_ Out_1 m155 : 8|1@1+ (1,0) [0|1] "" Vector__XXX
 SG_ Lmt_1 m152 : 8|1@1+ (1,0) [0|1] "" Vector__XXX
 SG_ M_cmd_ramp m58 : 8|16@1- (1,0) [-32767|32767] "Num" Vector__XXX
 SG_ Vdc_Bus m102 : 8|16@1+ (0.03166389465,0) [0|2075] "V" Vector__XXX
 SG_ Pos_Ref_Start m120 : 8|16@1- (1,0) [-32768|32767] "" Vector__XXX
 SG_ Oszi_Read_cmd m23 : 8|16@1+ (1,0) [0|65535] "" Vector__XXX
 SG_ Oszi_Run_cmd m24 : 8|16@1+ (1,0) [0|65535] "" Vector__XXX
 SG_ Oszi_Skip m22 : 8|16@1+ (1,0) [0|65535] "" Vector__XXX
 SG_ Oszi_Source m21 : 8|16@1+ (1,0) [0|65535] "" Vector__XXX
 SG_ Trig_Source m20 : 8|16@1+ (1,0) [0|65535] "" Vector__XXX
 SG_ Trig_Edge m19 : 8|16@1- (1,0) [-32768|32767] "" Vector__XXX
 SG_ Trig_Level m18 : 8|16@1- (1,0) [-32768|32767] "" Vector__XXX
 SG_ Capture_Channel m16 : 8|16@1- (1,0) [-32768|32767] "" Vector__XXX
 SG_ Extra__Start m9 : 8|16@1- (1,0) [-32768|32767] "" Vector__XXX
 SG_ Work m247 : 8|16@1- (1,0) [-32768|32767] "Joul" Vector__XXX
 SG_ Power m246 : 8|16@1- (1,0) [-32768|32767] "W" Vector__XXX
 SG_ Brake_Delay m241 : 8|16@1+ (1,0) [0|65535] "ms" Vector__XXX
 SG_ T_peak m240 : 8|16@1+ (1,0) [0|65535] "s" Vector__XXX
 SG_ No_HW_Fault m239 : 8|1@1+ (1,0) [0|1] "" Vector__XXX
 SG_ FB_LossOfSignal m236 : 8|1@1+ (1,0) [0|1] "" Vector__XXX
 SG_ DUP__Bit7_0__DAC_Source_Channel m220 : 8|8@1+ (1,0) [0|255] "" Vector__XXX
 SG_ Var_4 m212 : 8|32@1- (1,0) [-2147483648|2147483647] "" Vector__XXX
 SG_ Var_3 m211 : 8|32@1- (1,0) [-2147483648|2147483647] "" Vector__XXX
 SG_ Var_2 m210 : 8|32@1- (1,0) [-2147483648|2147483647] "" Vector__XXX
 SG_ Can_RxTimeout m208 : 8|16@1- (1,0) [0|32767] "ms" Vector__XXX
 SG_ Var_1 m209 : 8|32@1- (1,0) [-2147483648|2147483647] "" Vector__XXX
 SG_ N_Rpm_MaxInt m206 : 8|16@1- (1,0) [-32768|32767] "rpm" Vector__XXX
 SG_ CMC__Bit0__DC_Current_Sens_Ena m205 : 8|1@1+ (1,0) [0|1] "" Vector__XXX
 SG_ DC_Current_Sens_Ena_Set m204 : 8|1@1+ (1,0) [0|1] "" Vector__XXX
 SG_ PID_I__Kf__Iq m203 : 8|16@1+ (1,0) [0|200] "" Vector__XXX
 SG_ Bat_Opr_Limit__Mot m202 : 8|16@1+ (0.1,0) [0|6553.5] "A or W" Vector__XXX
 SG_ PID_I__xKp__Iq m201 : 8|16@1+ (1,0) [0|200] "%" Vector__XXX
 SG_ Operand219 m219 : 8|4@1+ (1,0) [0|15] "" Vector__XXX
 SG_ Operand218 m218 : 8|4@1+ (1,0) [0|15] "" Vector__XXX
 SG_ Operand195 m195 : 8|4@1+ (1,0) [0|15] "" Vector__XXX
 SG_ Ain_in_2_scaled252 m252 : 8|16@1- (1,0) [-32768|32767] "" Vector__XXX
 SG_ Ain_in_1_scaled251 m251 : 8|16@1- (1,0) [-32768|32767] "" Vector__XXX
 SG_ Signal_PosTolerance m244 : 8|1@1+ (1,0) [0|1] "" Vector__XXX
 SG_ Signal_LessN0 m245 : 8|1@1+ (1,0) [0|1] "" Vector__XXX
 SG_ Signal_Icns m243 : 8|1@1+ (1,0) [0|1] "" Vector__XXX
 SG_ Signal_Brake m242 : 8|1@1+ (1,0) [0|1] "" Vector__XXX
 SG_ Signal_GO m227 : 8|1@1+ (1,0) [0|1] "" Vector__XXX
 SG_ I_Max_Inuse m36 : 8|16@1- (0.13876843,0) [-4547.16391424|4547.02514581] "Arms" Vector__XXX
 SG_ Operand194 m194 : 8|4@1+ (1,0) [0|15] "" Vector__XXX
 SG_ def_DIN_2 m193 : 8|15@1+ (1,0) [0|32767] "" Vector__XXX
 SG_ def_DIN_1 m192 : 8|15@1+ (1,0) [0|32767] "" Vector__XXX
 SG_ def_END_2 m191 : 8|15@1+ (1,0) [0|32767] "" Vector__XXX
 SG_ def_END_1 m190 : 8|15@1+ (1,0) [0|32767] "" Vector__XXX
 SG_ Motor_Ts m189 : 8|16@1- (0.001,0) [-32.768|32.767] "ms" Vector__XXX
 SG_ Motor_Rs m188 : 8|16@1+ (1,0) [0|65535] "mOhm" Vector__XXX
 SG_ Motor_Tr m182 : 8|16@1- (1,0) [-32768|32767] "ms" Vector__XXX
 SG_ Id_Min m181 : 8|16@1- (1,0) [0|100] "%" Vector__XXX
 SG_ Motor_Rr m180 : 8|16@1+ (1,0) [0|65535] "mOhm" Vector__XXX
 SG_ Motor_Lm m179 : 8|16@1+ (0.01,0) [0|655.35] "mH" Vector__XXX
 SG_ Id_Nom m178 : 8|16@1- (1,0) [-32768|32767] "%" Vector__XXX
 SG_ Motor_Lsd m187 : 8|16@1+ (0.001,0) [0|65.535] "mH" Vector__XXX
 SG_ Motor_Lsq m177 : 8|16@1+ (0.001,0) [0|65.535] "mH" Vector__XXX
 SG_ timer_delta m175 : 8|16@1- (1,0) [-32768|32767] "" Vector__XXX
 SG_ PWM_3 m174 : 8|16@1- (1,0) [-32768|32767] "" Vector__XXX
 SG_ PWM_2 m173 : 8|16@1- (1,0) [-32768|32767] "" Vector__XXX
 SG_ PWM_1 m172 : 8|16@1- (1,0) [-32768|32767] "" Vector__XXX
 SG_ Logic_Freq m171 : 8|16@1+ (1,0) [0|65535] "Hz" Vector__XXX
 SG_ FB_Pole m167 : 8|16@1+ (1,0) [0|65535] "" Vector__XXX
 SG_ FB_Incr_Mot m166 : 8|16@1+ (1,0) [0|65535] "Inc/Rev" Vector__XXX
 SG_ DC_Bus_Min_Lim m165 : 8|16@1+ (1,0) [0|65535] "" Vector__XXX
 SG_ MO_Feedback_1 m164 : 8|5@1+ (1,0) [0|31] "" Vector__XXX
 SG_ M_Temp m163 : 8|16@1+ (1,0) [0|32767] "Num" Vector__XXX
 SG_ Ballastcount m161 : 8|16@1- (1,0) [-32768|32767] "" Vector__XXX
 SG_ Info_Timer_Diff m153 : 8|16@1+ (1,0) [0|65535] "" Vector__XXX
 SG_ CAN_Error_CRC_Check151 m151 : 8|16@1+ (1,0) [0|65535] "" Vector__XXX
 SG_ CAN_Error_CRC_Check150 m150 : 8|16@1+ (1,0) [0|65535] "" Vector__XXX
 SG_ CAN_Error_No_Ack m149 : 8|16@1+ (1,0) [0|65535] "" Vector__XXX
 SG_ Ecode_Bit0_FirstErrorDtcd148 m148 : 8|1@1+ (1,0) [0|1] "" Vector__XXX
 SG_ CAN_Error_WriteTime m147 : 8|16@1+ (1,0) [0|65535] "" Vector__XXX
 SG_ CAN_Error_BusOff m146 : 8|16@1+ (1,0) [0|65535] "" Vector__XXX
 SG_ Pos_cmd m145 : 8|32@1- (1,0) [-2147483648|2147483647] "" Vector__XXX
 SG_ Clear_Errors m142 : 8|16@1+ (1,0) [0|65535] "" Vector__XXX
 SG_ PID_n__Ti m45 : 8|16@1+ (1,0) [0|10000] "ms" Vector__XXX
 SG_ V_Kp m140 : 8|16@1+ (1,0) [0|65535] "" Vector__XXX
 SG_ V_Ref m139 : 8|16@1- (1,0) [-32768|32767] "%" Vector__XXX
 SG_ CAN_ID_2_Tx m137 : 8|32@1+ (1,0) [0|4294967295] "" Vector__XXX
 SG_ CAN_ID_2_Rx m136 : 8|32@1+ (1,0) [0|4294967295] "" Vector__XXX
 SG_ Fun_Special m133 : 8|16@1+ (1,0) [0|65535] "" Vector__XXX
 SG_ Fun_Para_Write m132 : 8|16@1+ (1,0) [0|65535] "" Vector__XXX
 SG_ Fun_Para_Read m131 : 8|16@1+ (1,0) [0|65535] "" Vector__XXX
 SG_ Pos_Diff_Slack m128 : 8|16@1- (1,0) [-32768|32767] "" Vector__XXX
 SG_ Pos_Offset_Slack m127 : 8|32@1- (1,0) [-2147483648|2147483647] "" Vector__XXX
 SG_ FB2_Scale_Ext m126 : 8|32@1- (1,0) [-2147483648|2147483647] "" Vector__XXX
 SG_ Pos_ND_Offset m125 : 8|32@1- (1,0) [-2147483648|2147483647] "" Vector__XXX
 SG_ Pos_ND_Scale m124 : 8|32@1- (1,0) [-2147483648|2147483647] "" Vector__XXX
 SG_ Pos_Zero_Offset m123 : 8|32@1- (1,0) [-2147483648|2147483647] "" Vector__XXX
 SG_ Pos_Preset_Val m122 : 8|32@1- (1,0) [-2147483648|2147483647] "" Vector__XXX
 SG_ Pos_Tol_Win m121 : 8|16@1- (1,0) [-32768|32767] "" Vector__XXX
 SG_ Speed_2 m119 : 8|16@1- (1,0) [-32768|32767] "" Vector__XXX
 SG_ Speed_1 m118 : 8|16@1- (1,0) [-32768|32767] "" Vector__XXX
 SG_ Ref_Reso_Edge m117 : 8|16@1+ (1,0) [0|65535] "" Vector__XXX
 SG_ Pos_Zero_Capture m116 : 8|16@1+ (1,0) [0|65535] "" Vector__XXX
 SG_ CAN_NBT m115 : 8|16@1+ (1,0) [0|65535] "" Vector__XXX
 SG_ Pos_OffsRef m114 : 8|32@1- (1,0) [-2147483648|2147483647] "" Vector__XXX
 SG_ Pos_TiM m113 : 8|16@1+ (1,0) [0|100] "" Vector__XXX
 SG_ Pos_Error m112 : 8|32@1- (1,0) [-2147483648|2147483647] "" Vector__XXX
 SG_ Pos_Actual_2 m111 : 8|32@1- (1,0) [-2147483648|2147483647] "" Vector__XXX
 SG_ Pos_Dest m110 : 8|32@1- (1,0) [-2147483648|2147483647] "" Vector__XXX
 SG_ Pos_Actual m109 : 8|32@1- (1,0) [-2147483648|2147483647] "" Vector__XXX
 SG_ Pos_Td m108 : 8|16@1+ (1,0) [0|65535] "ms" Vector__XXX
 SG_ Pos_Ti m107 : 8|16@1+ (1,0) [0|10000] "ms" Vector__XXX
 SG_ Pos_Kp m106 : 8|16@1+ (1,0) [0|500] "" Vector__XXX
 SG_ CAN_ID_Tx m105 : 8|16@1+ (1,0) [0|65530] "" Vector__XXX
 SG_ CAN_ID_Rx m104 : 8|16@1+ (1,0) [0|65530] "" Vector__XXX
 SG_ Regen_P m101 : 8|16@1+ (1,0) [25|10000] "W" Vector__XXX
 SG_ Device_Mains m100 : 8|16@1+ (1,0) [0|1000] "V" Vector__XXX
 SG_ Ecode_Bit0_FirstErrorDtcd99 m99 : 8|1@1+ (1,0) [0|1] "" Vector__XXX
 SG_ Ixt_Monitor m97 : 8|16@1+ (1,0) [0|65535] "" Vector__XXX
 SG_ Ain_in_1_Filter m96 : 8|8@1+ (0.5,0) [0|127.5] "ms" Vector__XXX
 SG_ Speed_Filter m94 : 8|16@1+ (1,0) [0|15] "" Vector__XXX
 SG_ Rotor_Signals m92 : 8|16@1+ (1,0) [0|65535] "%" Vector__XXX
 SG_ PID_n__Kacc m91 : 8|16@1- (1,0) [0|100] "%" Vector__XXX
 SG_ n_Nom m89 : 8|16@1+ (1,0) [60|65000] "rpm" Vector__XXX
 SG_ I_Limit_Inuse_ramp m87 : 8|16@1- (0.37383776,0) [-12249.91571968|12249.54188192] "Arms" Vector__XXX
 SG_ Ain_in_2_Cutoff m83 : 8|16@1- (1,0) [-32768|32767] "" Vector__XXX
 SG_ Ena82 m82 : 8|1@1+ (1,0) [0|1] "" Vector__XXX
 SG_ KM_rsvd_0 m81 : 8|1@1+ (1,0) [0|1] "" Vector__XXX
 SG_ ActiveControlMode m17 : 8|8@1+ (1,0) [0|255] "" Vector__XXX
 SG_ Ain_in_1_Cutoff m80 : 8|16@1- (1,0) [0|32767] "" Vector__XXX
 SG_ Motor_Pole m79 : 8|16@1+ (1,0) [2|96] "" Vector__XXX
 SG_ It_Rg_Monitor m69 : 8|32@1- (1,0) [-2147483648|2147483647] "" Vector__XXX
 SG_ FB_Offset m68 : 8|16@1- (0.1,0) [-360|360] "" Vector__XXX
 SG_ MotorPos_Elec m67 : 8|16@1- (1,0) [-32768|32767] "" Vector__XXX
 SG_ MotorPos_Mech m66 : 8|16@1- (1,0) [-32768|32767] "" Vector__XXX
 SG_ Incr_Delta m65 : 8|16@1- (1,0) [-32768|32767] "" Vector__XXX
 SG_ N_Lim_minus m62 : 8|16@1- (0.003051851,0) [-100|0] "%" Vector__XXX
 SG_ N_Lim_plus m63 : 8|16@1- (0.003051851,0) [0|100] "%" Vector__XXX
 SG_ PID_n__TiM m59 : 8|16@1+ (1,0) [0|100] "%" Vector__XXX
 SG_ DZR_Seq m55 : 8|15@1+ (1,0) [0|32767] "" Vector__XXX
 SG_ Ain_in_2_OffsetVal m215 : 8|16@1- (1,0) [-32768|32767] "" Vector__XXX
 SG_ Ain_in_1_OffsetVal m47 : 8|16@1- (1,0) [-32768|32767] "" Vector__XXX
 SG_ PID_n__Td m46 : 8|16@1+ (1,0) [0|10000] "ms" Vector__XXX
 SG_ V_Ti m141 : 8|16@1+ (1,0) [0|65535] "ms" Vector__XXX
 SG_ PID_n__Kp m44 : 8|16@1+ (1,0) [0|200] "" Vector__XXX
 SG_ PID_I__TiM__Iq m43 : 8|16@1+ (1,0) [0|500] "" Vector__XXX
 SG_ I_Delta_Ramp m37 : 8|16@1- (1,0) [-32768|32767] "" Vector__XXX
 SG_ I3_Offset m31 : 8|16@1+ (1,0) [0|65535] "" Vector__XXX
 SG_ Cutoffdig m30 : 8|16@1+ (1,0) [0|65535] "" Vector__XXX
 SG_ PID_I__Ti__Iq m29 : 8|16@1+ (1,0) [300|20000] "" Vector__XXX
 SG_ PID_I__Kp__Iq m28 : 8|16@1+ (1,0) [0|200] "" Vector__XXX
 SG_ Calib_Ref_Value m26 : 8|16@1+ (0.1,0) [0|6553.5] "" Vector__XXX
 SG_ PWM_Enum m25 : 8|16@1+ (1,0) [0|65535] "" Vector__XXX
 SG_ Cos_Phi m14 : 8|16@1+ (1,0) [0|65535] "" Vector__XXX
 SG_ F_corner__Start m13 : 8|16@1- (0.1,0) [-3276.8|3276.7] "Hz" Vector__XXX
 SG_ V_corner__Start m12 : 8|16@1- (0.1,0) [-3276.8|3276.7] "%" Vector__XXX
 SG_ F_min__Start m11 : 8|16@1- (0.1,0) [-3276.8|3276.7] "Hz" Vector__XXX
 SG_ V_min__Start m10 : 8|16@1- (0.1,0) [-3276.8|3276.7] "%" Vector__XXX
 SG_ V_dc__Start m8 : 8|16@1- (0.1,0) [-3276.8|3276.7] "%" Vector__XXX
 SG_ T_dc__Start m7 : 8|16@1+ (1,0) [0|65535] "ms" Vector__XXX
 SG_ Motor_V_N m6 : 8|16@1+ (1,0) [0|65535] "V" Vector__XXX
 SG_ Motor_F_N m5 : 8|16@1+ (0.1,0) [0|6553.5] "Hz" Vector__XXX
 SG_ Temp_DEBUG m154 : 8|16@1- (1,0) [-32768|32767] "" Vector__XXX
 SG_ Ptr_2_DEBUG m186 : 8|16@1- (1,0) [-32768|32767] "" Vector__XXX
 SG_ Ptr_1_DEBUG m184 : 8|16@1- (1,0) [-32768|32767] "" Vector__XXX
 SG_ M_outdig__Iq m160 : 8|16@1- (1,0) [-32768|32767] "" Vector__XXX
 SG_ Id_Ref m35 : 8|16@1- (0.13876843,0) [-4547.16391424|4547.02514581] "Arms" Vector__XXX
 SG_ CS_Ain_1_Format m54 : 8|2@1+ (1,0) [0|3] "" Vector__XXX
 SG_ I_red_TM m162 : 8|16@1+ (1,0) [0|32767] "" Vector__XXX
 SG_ I_red_TE m76 : 8|16@1+ (1,0) [0|32767] "" Vector__XXX
 SG_ I_red_TD m88 : 8|16@1+ (1,0) [0|32767] "" Vector__XXX
 SG_ I_red_N m60 : 8|16@1+ (0.003051851,0) [0|100] "%" Vector__XXX
 SG_ I_lim_dig m70 : 8|16@1- (0.003051851,0) [0|100] "%" Vector__XXX
 SG_ DOUT_4 m223 : 8|1@1+ (1,0) [0|1] "" Vector__XXX
 SG_ I_Fault m233 : 8|1@1+ (1,0) [0|1] "" Vector__XXX
 SG_ Rdy_BTB m226 : 8|1@1+ (1,0) [0|1] "" Vector__XXX
 SG_ DOUT_3 m222 : 8|1@1+ (1,0) [0|1] "" Vector__XXX
 SG_ DOUT_2 m225 : 8|1@1+ (1,0) [0|1] "" Vector__XXX
 SG_ DOUT_1 m224 : 8|1@1+ (1,0) [0|1] "" Vector__XXX
 SG_ RUN232 m232 : 8|1@1+ (1,0) [0|1] "" Vector__XXX
 SG_ DIN_2 m231 : 8|1@1+ (1,0) [0|1] "" Vector__XXX
 SG_ END_2 m229 : 8|1@1+ (1,0) [0|1] "" Vector__XXX
 SG_ DIN_1 m230 : 8|1@1+ (1,0) [0|1] "" Vector__XXX
 SG_ END_1 m228 : 8|1@1+ (1,0) [0|1] "" Vector__XXX
 SG_ Vdc_Bus_Filt m235 : 8|16@1+ (0.03166389465,0) [0|2075] "V" Vector__XXX
 SG_ T_Air m75 : 8|16@1- (1,0) [-32768|32767] "" Vector__XXX
 SG_ T_Igbt m74 : 8|16@1+ (1,0) [0|65535] "" Vector__XXX
 SG_ T_Motor m73 : 8|16@1+ (1,0) [0|65535] "" Vector__XXX
 SG_ Vout m138 : 8|16@1- (1,0) [-32768|32767] "" Vector__XXX
 SG_ Vd m42 : 8|16@1- (1,0) [-32768|32767] "" Vector__XXX
 SG_ Vq m41 : 8|16@1- (1,0) [-32768|32767] "" Vector__XXX
 SG_ I2_ADC m170 : 8|16@1+ (1,0) [0|65535] "Num" Vector__XXX
 SG_ I3_ADC m169 : 8|16@1+ (1,0) [0|65535] "Num" Vector__XXX
 SG_ I3_Actual m86 : 8|16@1- (0.196248196,0) [-6430.660886528|6430.464638332] "A" Vector__XXX
 SG_ I2_Actual m85 : 8|16@1- (0.196248196,0) [-6430.660886528|6430.464638332] "A" Vector__XXX
 SG_ I1_Actual m84 : 8|16@1- (0.196248196,0) [-6430.660886528|6430.464638332] "A" Vector__XXX
 SG_ Id_Error m57 : 8|16@1- (0.13876843,0) [-4547.16391424|4547.02514581] "Arms" Vector__XXX
 SG_ Iq_Error m56 : 8|16@1- (0.13876843,0) [-4547.16391424|4547.02514581] "Arms" Vector__XXX
 SG_ Id_Actual m40 : 8|16@1- (0.13876843,0) [-4547.16391424|4547.02514581] "Arms" Vector__XXX
 SG_ Iq_Actual m39 : 8|16@1- (0.13876843,0) [-4547.16391424|4547.02514581] "Arms" Vector__XXX
 SG_ I_Actual_Filt m95 : 8|16@1- (0.13876843,0) [-4547.16391424|4547.02514581] "Arms" Vector__XXX
 SG_ I_Actual m32 : 8|16@1- (0.13876843,0) [-4547.16391424|4547.02514581] "Arms" Vector__XXX
 SG_ I_cmd_ramp m34 : 8|16@1- (0.13876843,0) [-4547.16391424|4547.02514581] "Arms" Vector__XXX
 SG_ I_cmd m38 : 8|16@1- (0.13876843,0) [-4547.16391424|4547.02514581] "Arms" Vector__XXX
 SG_ I_Limit_Inuse m72 : 8|16@1- (0.13876843,0) [-4547.16391424|4547.02514581] "Arms" Vector__XXX
 SG_ I_nom_eff m78 : 8|16@1+ (0.1,0) [0|6553.5] "0,1" Vector__XXX
 SG_ I_max_eff m77 : 8|16@1+ (0.1,0) [0|3276.7] "Arms" Vector__XXX
 SG_ I_con_eff m197 : 8|16@1+ (0.00610388818,0) [0|100] "%" Vector__XXX
 SG_ I_max_pk m196 : 8|16@1+ (0.00610388818,0) [0|100] "%" Vector__XXX
 SG_ ID_setdig__Id m33 : 8|16@1- (0.37383776,0) [-12249.91571968|12249.54188192] "Arms" Vector__XXX
 SG_ M_setdig__Iq m144 : 8|16@1- (1,0) [-32768|32767] "" Vector__XXX
 SG_ N_Error m51 : 8|16@1- (0.2166814173,0) [-7100|7100] "Num" Vector__XXX
 SG_ N_Lim m52 : 8|16@1- (0.003051851,0) [-100|100] "%" Vector__XXX
 SG_ N_cmd_ramp m50 : 8|16@1- (0.2166814173,0) [-7100|7100] "Num" Vector__XXX
 SG_ N_cmd m93 : 8|16@1- (1,0) [-32768|32767] "Num" Vector__XXX
 SG_ N_setdig m49 : 8|16@1- (0.2166814173,0) [-7100|7100] "Num" Vector__XXX
 SG_ Nmax100perc m200 : 8|16@1- (1,0) [-32768|32767] "rpm" Vector__XXX
 SG_ Ain_in_2_raw m214 : 8|16@1- (1,0) [-32768|32767] "" Vector__XXX
 SG_ Ain_in_1_raw m213 : 8|16@1- (1,0) [-32768|32767] "" Vector__XXX
 SG_ LMT1 m216 : 8|1@1+ (1,0) [0|1] "" Vector__XXX
 SG_ Err_BadParas m143 : 8|1@1+ (1,0) [0|1] "" Vector__XXX
 SG_ Ena64 m64 : 8|1@1+ (1,0) [0|1] "" Vector__XXX
 SG_ DC_BUS_comp m90 : 8|1@1+ (1,0) [0|1] "" Vector__XXX
 SG_ I_200perc m217 : 8|16@1+ (1,0) [0|65535] "adc" Vector__XXX
 SG_ V_Shunt m238 : 8|16@1+ (1,0) [0|65535] "mV" Vector__XXX
 SG_ I_device m198 : 8|16@1+ (0.1,0) [0|6553.5] "A" Vector__XXX
 SG_ Axis m248 : 15|32@0+ (1,0) [0|0] "" Vector__XXX
 SG_ SNr m98 : 8|32@1+ (1,0) [0|4294967295] "" Vector__XXX
 SG_ DeviceType m103 : 8|8@1+ (1,0) [0|255] "" Vector__XXX
 SG_ Firmware m27 : 8|12@1+ (1,0) [0|4095] "" Vector__XXX
 SG_ N_Actual_Filt m168 : 8|16@1- (0.1098666341,0) [-3600.1098661888|3599.9999995547] "rpm" Vector__XXX
 SG_ N_R_Lim m199 : 8|16@1+ (1,0) [0|1000] "ms" Vector__XXX
 SG_ N_R_Dec m237 : 8|16@1+ (1,0) [0|30000] "ms" Vector__XXX
 SG_ N_Actual m48 : 8|16@1- (0.1098666341,0) [-3600|3599.9999995547] "Num" Vector__XXX
 SG_ Rcv_Mux M : 0|8@1+ (1,0) [0|0] "" Vector__XXX

BO_ 514 Inverter_R_Send: 5 Vector__XXX
 SG_ ReduceLosses m90 : 39|1@1+ (1,0) [0|1] "" Vector__XXX
 SG_ DC_1Q3P m90 : 38|1@1+ (1,0) [0|1] "" Vector__XXX
 SG_ DC_1QMV m90 : 37|1@1+ (1,0) [0|1] "" Vector__XXX
 SG_ block m90 : 36|1@1+ (1,0) [0|1] "" Vector__XXX
 SG_ DEAD_2 m90 : 35|1@1+ (1,0) [0|1] "" Vector__XXX
 SG_ DC_field m90 : 34|1@1+ (1,0) [0|1] "" Vector__XXX
 SG_ DC_1QdirVolt m90 : 33|1@1+ (1,0) [0|1] "" Vector__XXX
 SG_ CMC__Bit31_24__free m205 : 32|8@1+ (1,0) [0|255] "" Vector__XXX
 SG_ delta m90 : 32|1@1+ (1,0) [0|1] "" Vector__XXX
 SG_ CMC__Bit23__TC_nCmdRestOption m205 : 31|1@1+ (1,0) [0|1] "" Vector__XXX
 SG_ NTC m90 : 31|1@1+ (1,0) [0|1] "" Vector__XXX
 SG_ DUP__Bit31_22__free m220 : 30|10@1+ (1,0) [0|1023] "" Vector__XXX
 SG_ DUP__Bit21__InitWith_FRG_OFF m220 : 29|1@1+ (1,0) [0|1] "" Vector__XXX
 SG_ CMC__Bit22_21__TC_MinSpeed_conf m205 : 29|2@1+ (1,0) [0|3] "" Vector__XXX
 SG_ DUP__Bit20__HAL_Extmr_Acv m220 : 28|1@1+ (1,0) [0|1] "" Vector__XXX
 SG_ PWM_Freq m90 : 28|3@1+ (1,0) [0|7] "" Vector__XXX
 SG_ CMC__Bit20_19__TC_DeltaTime_conf m205 : 27|2@1+ (1,0) [0|3] "" Vector__XXX
 SG_ AC_DC m90 : 27|1@1+ (1,0) [0|1] "" Vector__XXX
 SG_ CMC__Bit18__TractionControl_Ena m205 : 26|1@1+ (1,0) [0|1] "" Vector__XXX
 SG_ MotBrake m90 : 26|1@1+ (1,0) [0|1] "" Vector__XXX
 SG_ DUP__Bit19_17__ECODE_ReDefine m220 : 25|3@1+ (1,0) [0|7] "" Vector__XXX
 SG_ Ramp4 m90 : 25|1@1+ (1,0) [0|1] "" Vector__XXX
 SG_ M_R_Dec m237 : 24|16@1+ (1,0) [0|4000] "ms" Vector__XXX
 SG_ DUP__Bit16__Bamobil3_2_OffCrct m220 : 24|1@1+ (1,0) [0|1] "" Vector__XXX
 SG_ Ain_in_2_ScaleVal m215 : 24|16@1- (0.000244140625,0) [-8|7.999755859375] "" Vector__XXX
 SG_ CMC__Bit17_16__CheckIPeak_config m205 : 24|2@1+ (1,0) [0|3] "" Vector__XXX
 SG_ PID_I__Kf__Id m203 : 24|16@1+ (1,0) [0|200] "" Vector__XXX
 SG_ Bat_Opr_Limit__Gen m202 : 24|16@1+ (0.1,0) [0|6553.5] "A or W" Vector__XXX
 SG_ PID_I__xKp__Id m201 : 24|16@1+ (1,0) [0|200] "%" Vector__XXX
 SG_ M_R_Rcp m199 : 24|16@1+ (1,0) [0|4000] "ms" Vector__XXX
 SG_ DC_Bus_Max_Lim m165 : 24|16@1+ (1,0) [0|65535] "" Vector__XXX
 SG_ Regen_R m101 : 24|16@1+ (1,0) [0|65535] "Ohm" Vector__XXX
 SG_ SRamp m90 : 24|1@1+ (1,0) [0|1] "" Vector__XXX
 SG_ M_R_Acc m53 : 24|16@1+ (1,0) [0|4000] "ms" Vector__XXX
 SG_ Ain_in_1_ScaleVal m47 : 24|16@1- (0.000244140625,0) [-7.999|7.999] "" Vector__XXX
 SG_ PID_I__TiM__Id m43 : 24|16@1+ (1,0) [0|500] "" Vector__XXX
 SG_ PID_I__Ti__Id m29 : 24|16@1+ (1,0) [300|20000] "" Vector__XXX
 SG_ PID_I__Kp__Id m28 : 24|16@1+ (1,0) [0|200] "" Vector__XXX
 SG_ F_corner__Stop m13 : 24|16@1- (0.1,0) [-3276.8|3276.7] "Hz" Vector__XXX
 SG_ V_corner__Stop m12 : 24|16@1- (0.1,0) [-3276.8|3276.7] "%" Vector__XXX
 SG_ F_min__Stop m11 : 24|16@1- (0.1,0) [-3276.8|3276.7] "Hz" Vector__XXX
 SG_ V_min__Stop m10 : 24|16@1- (0.1,0) [-3276.8|3276.7] "%" Vector__XXX
 SG_ Special__Stop m9 : 24|16@1- (1,0) [-32768|32767] "" Vector__XXX
 SG_ V_dc__Stop m8 : 24|16@1- (0.1,0) [-3276.8|3276.7] "%" Vector__XXX
 SG_ T_dc__Stop m7 : 24|16@1+ (1,0) [0|65535] "ms" Vector__XXX
 SG_ DUP__Bit15__CANopen_Acv m220 : 23|1@1+ (1,0) [0|1] "" Vector__XXX
 SG_ CMC__Bit15__Dig_E_Brake_Act m205 : 23|1@1+ (1,0) [0|1] "" Vector__XXX
 SG_ Active193 m193 : 23|1@1+ (1,0) [0|1] "" Vector__XXX
 SG_ Active192 m192 : 23|1@1+ (1,0) [0|1] "" Vector__XXX
 SG_ Active191 m191 : 23|1@1+ (1,0) [0|1] "" Vector__XXX
 SG_ Active190 m190 : 23|1@1+ (1,0) [0|1] "" Vector__XXX
 SG_ MO_sc2_inv m164 : 23|1@1+ (1,0) [0|1] "" Vector__XXX
 SG_ LowBd m90 : 23|1@1+ (1,0) [0|1] "" Vector__XXX
 SG_ KM_DEBUG_TEST m81 : 23|1@1+ (1,0) [0|1] "" Vector__XXX
 SG_ CS_Ain_1__N_Limit m54 : 23|1@1+ (1,0) [0|1] "" Vector__XXX
 SG_ DUP__Bit14__MTPA_reluct_enab m220 : 22|1@1+ (1,0) [0|1] "" Vector__XXX
 SG_ CMC__Bit14__Idc_Limit_Ena_V2 m205 : 22|1@1+ (1,0) [0|1] "" Vector__XXX
 SG_ Ana_0up m90 : 22|1@1+ (1,0) [0|1] "" Vector__XXX
 SG_ KM_PSEUDO_ENABLE m81 : 22|1@1+ (1,0) [0|1] "" Vector__XXX
 SG_ CS_Ain_2__I_Limit m54 : 22|1@1+ (1,0) [0|1] "" Vector__XXX
 SG_ DUP__Bit13__Gen_AutoIacLimit m220 : 21|1@1+ (1,0) [0|1] "" Vector__XXX
 SG_ KM_rsvd_13 m81 : 21|1@1+ (1,0) [0|1] "" Vector__XXX
 SG_ DUP__Bit12__Boat_Pedal m220 : 20|1@1+ (1,0) [0|1] "" Vector__XXX
 SG_ MO_sc2_reso m164 : 20|3@1+ (1,0) [0|7] "" Vector__XXX
 SG_ MotorType m90 : 20|2@1+ (1,0) [0|3] "" Vector__XXX
 SG_ KM_rsvd_12 m81 : 20|1@1+ (1,0) [0|1] "" Vector__XXX
 SG_ CS_CMD_Type m54 : 20|2@1+ (1,0) [0|3] "" Vector__XXX
 SG_ DUP__Bit11__DCBus_Volts m220 : 19|1@1+ (1,0) [0|1] "" Vector__XXX
 SG_ MO_sc1_comp m164 : 19|1@1+ (1,0) [0|1] "" Vector__XXX
 SG_ OL_comp m90 : 19|1@1+ (1,0) [0|1] "" Vector__XXX
 SG_ KM_rsvd_11 m81 : 19|1@1+ (1,0) [0|1] "" Vector__XXX
 SG_ CS_oora2 m54 : 19|1@1+ (1,0) [0|1] "" Vector__XXX
 SG_ DUP__Bit10__PARK_RMS m220 : 18|1@1+ (1,0) [0|1] "" Vector__XXX
 SG_ H2inv m90 : 18|1@1+ (1,0) [0|1] "" Vector__XXX
 SG_ KM_PHASING_EXTEND m81 : 18|1@1+ (1,0) [0|1] "" Vector__XXX
 SG_ DUP__Bit9__GENERATOR m220 : 17|1@1+ (1,0) [0|1] "" Vector__XXX
 SG_ Hxinv m90 : 17|1@1+ (1,0) [0|1] "" Vector__XXX
 SG_ KM_HANDWHEEL m81 : 17|1@1+ (1,0) [0|1] "" Vector__XXX
 SG_ DUP__Bit8__CAN_EXTENDED_0 m220 : 16|1@1+ (1,0) [0|1] "" Vector__XXX
 SG_ Source_ID219 m219 : 16|8@1+ (1,0) [0|255] "" Vector__XXX
 SG_ Source_ID218 m218 : 16|8@1+ (1,0) [0|255] "" Vector__XXX
 SG_ Source_ID195 m195 : 16|8@1+ (1,0) [0|255] "" Vector__XXX
 SG_ Source_ID194 m194 : 16|8@1+ (1,0) [0|255] "" Vector__XXX
 SG_ MO_sc1_reso m164 : 16|3@1+ (1,0) [0|7] "" Vector__XXX
 SG_ Ain_in_2_Filter m96 : 16|8@1+ (0.5,0) [0|127.5] "ms" Vector__XXX
 SG_ I1_Adc_Ena m90 : 16|1@1+ (1,0) [0|1] "" Vector__XXX
 SG_ KM_ALLOW_SYNC m81 : 16|1@1+ (1,0) [0|1] "" Vector__XXX
 SG_ Ret_Interval m61 : 16|8@1+ (1,0) [0|255] "ms" Vector__XXX
 SG_ CS_Ain_2_Mode m54 : 16|3@1+ (1,0) [0|7] "" Vector__XXX
 SG_ CMC__Bit13_7__free m205 : 15|7@1+ (1,0) [0|127] "" Vector__XXX
 SG_ Vdc_Ana m90 : 15|1@1+ (1,0) [0|1] "" Vector__XXX
 SG_ KM_MIX_ANA_ON m81 : 15|1@1+ (1,0) [0|1] "" Vector__XXX
 SG_ CS_oora1 m54 : 15|1@1+ (1,0) [0|1] "" Vector__XXX
 SG_ CMC__Bit6__TorqueTimeOut_100ms_E m205 : 14|1@1+ (1,0) [0|1] "" Vector__XXX
 SG_ No_UESP_BTB m90 : 14|1@1+ (1,0) [0|1] "" Vector__XXX
 SG_ KM_N_CLIP m81 : 14|1@1+ (1,0) [0|1] "" Vector__XXX
 SG_ CMC__Bit5__Reset_NRamp_AtNZero m205 : 13|1@1+ (1,0) [0|1] "" Vector__XXX
 SG_ MO_Feedback_2 m164 : 13|3@1+ (1,0) [0|7] "" Vector__XXX
 SG_ REFSOFT m90 : 13|1@1+ (1,0) [0|1] "" Vector__XXX
 SG_ KM_I_LIMIT m81 : 13|1@1+ (1,0) [0|1] "" Vector__XXX
 SG_ CMC__Bit4__Dig_M_RcpRamp_Ena m205 : 12|1@1+ (1,0) [0|1] "" Vector__XXX
 SG_ Compare_Var219 m219 : 12|3@1+ (1,0) [0|7] "" Vector__XXX
 SG_ Compare_Var218 m218 : 12|3@1+ (1,0) [0|7] "" Vector__XXX
 SG_ Compare_Var195 m195 : 12|3@1+ (1,0) [0|7] "" Vector__XXX
 SG_ Compare_Var194 m194 : 12|3@1+ (1,0) [0|7] "" Vector__XXX
 SG_ I_ist_Inverse m90 : 12|1@1+ (1,0) [0|1] "" Vector__XXX
 SG_ KM_TX_TOG_STAT m81 : 12|1@1+ (1,0) [0|1] "" Vector__XXX
 SG_ CS_Ain_1_Mode m54 : 12|3@1+ (1,0) [0|7] "" Vector__XXX
 SG_ CMC__Bit3__TorqueVal_Init_Ena m205 : 11|1@1+ (1,0) [0|1] "" Vector__XXX
 SG_ CoastStop m90 : 11|1@1+ (1,0) [0|1] "" Vector__XXX
 SG_ KM_CAL_OFF m81 : 11|1@1+ (1,0) [0|1] "" Vector__XXX
 SG_ CMC__Bit2__Pdc_Limit_Usage m205 : 10|1@1+ (1,0) [0|1] "" Vector__XXX
 SG_ FB_Special m90 : 10|1@1+ (1,0) [0|1] "" Vector__XXX
 SG_ KM_FRG_OFF m81 : 10|1@1+ (1,0) [0|1] "" Vector__XXX
 SG_ CS_Ain_2_Format m54 : 10|2@1+ (1,0) [0|3] "" Vector__XXX
 SG_ CMC__Bit1__Idc_Limit_Ena m205 : 9|1@1+ (1,0) [0|1] "" Vector__XXX
 SG_ Ballast_Ext m90 : 9|1@1+ (1,0) [0|1] "" Vector__XXX
 SG_ KM_SPEED_0 m81 : 9|1@1+ (1,0) [0|1] "" Vector__XXX
 SG_ Axis m248 : 15|32@0+ (1,0) [0|0] "" Vector__XXX
 SG_ Brake_Delay m241 : 8|16@1+ (1,0) [0|65535] "ms" Vector__XXX
 SG_ T_peak m240 : 8|16@1+ (1,0) [0|65535] "s" Vector__XXX
 SG_ V_Shunt m238 : 8|16@1+ (1,0) [0|65535] "mV" Vector__XXX
 SG_ N_R_Dec m237 : 8|16@1+ (1,0) [0|30000] "ms" Vector__XXX
 SG_ DUP__Bit7_0__DAC_Source_Channel m220 : 8|8@1+ (1,0) [0|255] "" Vector__XXX
 SG_ Ain_in_2_OffsetVal m215 : 8|16@1- (1,0) [-32768|32767] "" Vector__XXX
 SG_ Var_4 m212 : 8|32@1- (1,0) [-2147483648|2147483647] "" Vector__XXX
 SG_ Var_3 m211 : 8|32@1- (1,0) [-2147483648|2147483647] "" Vector__XXX
 SG_ Var_2 m210 : 8|32@1- (1,0) [-2147483648|2147483647] "" Vector__XXX
 SG_ Var_1 m209 : 8|32@1- (1,0) [-2147483648|2147483647] "" Vector__XXX
 SG_ Can_RxTimeout m208 : 8|16@1- (1,0) [0|32767] "ms" Vector__XXX
 SG_ CMC__Bit0__DC_Current_Sens_Ena m205 : 8|1@1+ (1,0) [0|1] "" Vector__XXX
 SG_ PID_I__Kf__Iq m203 : 8|16@1+ (1,0) [0|200] "" Vector__XXX
 SG_ Bat_Opr_Limit__Mot m202 : 8|16@1+ (0.1,0) [0|6553.5] "A or W" Vector__XXX
 SG_ PID_I__xKp__Iq m201 : 8|16@1+ (1,0) [0|200] "%" Vector__XXX
 SG_ Nmax100perc m200 : 8|16@1- (1,0) [-32768|32767] "rpm" Vector__XXX
 SG_ N_R_Lim m199 : 8|16@1+ (1,0) [0|1000] "ms" Vector__XXX
 SG_ I_device m198 : 8|16@1+ (0.1,0) [0|6553.5] "A" Vector__XXX
 SG_ I_con_eff m197 : 8|16@1+ (0.00610388818,0) [0|100] "%" Vector__XXX
 SG_ I_max_pk m196 : 8|16@1+ (0.00610388818,0) [0|100] "%" Vector__XXX
 SG_ Operand219 m219 : 8|4@1+ (1,0) [0|15] "" Vector__XXX
 SG_ Operand218 m218 : 8|4@1+ (1,0) [0|15] "" Vector__XXX
 SG_ Operand195 m195 : 8|4@1+ (1,0) [0|15] "" Vector__XXX
 SG_ Operand194 m194 : 8|4@1+ (1,0) [0|15] "" Vector__XXX
 SG_ def_DIN_2 m193 : 8|15@1+ (1,0) [0|32767] "" Vector__XXX
 SG_ def_DIN_1 m192 : 8|15@1+ (1,0) [0|32767] "" Vector__XXX
 SG_ def_END_2 m191 : 8|15@1+ (1,0) [0|32767] "" Vector__XXX
 SG_ def_END_1 m190 : 8|15@1+ (1,0) [0|32767] "" Vector__XXX
 SG_ Motor_Ts m189 : 8|16@1- (0.001,0) [-32.768|32.767] "ms" Vector__XXX
 SG_ Motor_Rs m188 : 8|16@1+ (1,0) [0|65535] "mOhm" Vector__XXX
 SG_ Motor_Lsd m187 : 8|16@1+ (0.001,0) [0|65.535] "mH" Vector__XXX
 SG_ Motor_Tr m182 : 8|16@1- (1,0) [-32768|32767] "ms" Vector__XXX
 SG_ Id_Min m181 : 8|16@1- (1,0) [0|100] "%" Vector__XXX
 SG_ Motor_Rr m180 : 8|16@1+ (1,0) [0|65535] "mOhm" Vector__XXX
 SG_ Motor_Lm m179 : 8|16@1+ (0.01,0) [0|655.35] "mH" Vector__XXX
 SG_ Id_Nom m178 : 8|16@1- (1,0) [-32768|32767] "%" Vector__XXX
 SG_ Motor_Lsq m177 : 8|16@1+ (0.001,0) [0|65.535] "mH" Vector__XXX
 SG_ FB_Pole m167 : 8|16@1+ (1,0) [0|65535] "" Vector__XXX
 SG_ FB_Incr_Mot m166 : 8|16@1+ (1,0) [0|65535] "Inc/Rev" Vector__XXX
 SG_ DC_Bus_Min_Lim m165 : 8|16@1+ (1,0) [0|65535] "" Vector__XXX
 SG_ MO_Feedback_1 m164 : 8|5@1+ (1,0) [0|31] "" Vector__XXX
 SG_ M_Temp m163 : 8|16@1+ (1,0) [0|32767] "Num" Vector__XXX
 SG_ I_red_TM m162 : 8|16@1+ (1,0) [0|32767] "" Vector__XXX
 SG_ M_setdig__Iq m144 : 8|16@1- (1,0) [-32768|32767] "" Vector__XXX
 SG_ Clear_Errors m142 : 8|16@1+ (1,0) [1|1] "" Vector__XXX
 SG_ V_Ti m141 : 8|16@1+ (1,0) [0|65535] "ms" Vector__XXX
 SG_ V_Kp m140 : 8|16@1+ (1,0) [0|65535] "" Vector__XXX
 SG_ V_Ref m139 : 8|16@1- (1,0) [-32768|32767] "%" Vector__XXX
 SG_ CAN_ID_2_Tx m137 : 8|32@1+ (1,0) [0|4294967295] "" Vector__XXX
 SG_ CAN_ID_2_Rx m136 : 8|32@1+ (1,0) [0|4294967295] "" Vector__XXX
 SG_ Fun_Special m133 : 8|16@1+ (1,0) [0|65535] "" Vector__XXX
 SG_ Eprom132 m132 : 8|8@1+ (1,0) [0|2] "" Vector__XXX
 SG_ Eprom131 m131 : 8|8@1+ (1,0) [0|2] "" Vector__XXX
 SG_ Pos_Diff_Slack m128 : 8|16@1- (1,0) [-32768|32767] "" Vector__XXX
 SG_ Pos_Offset_Slack m127 : 8|32@1- (1,0) [-2147483648|2147483647] "" Vector__XXX
 SG_ FB2_Scale_Ext m126 : 8|32@1- (1,0) [-2147483648|2147483647] "" Vector__XXX
 SG_ Pos_ND_Offset m125 : 8|32@1- (1,0) [-2147483648|2147483647] "" Vector__XXX
 SG_ Pos_ND_Scale m124 : 8|32@1- (1,0) [-2147483648|2147483647] "" Vector__XXX
 SG_ Pos_Preset_Val m122 : 8|32@1- (1,0) [-2147483648|2147483647] "" Vector__XXX
 SG_ Pos_Tol_Win m121 : 8|16@1- (1,0) [-32768|32767] "" Vector__XXX
 SG_ Speed_2 m119 : 8|16@1- (1,0) [-32768|32767] "" Vector__XXX
 SG_ Speed_1 m118 : 8|16@1- (1,0) [-32768|32767] "" Vector__XXX
 SG_ Ref_Reso_Edge m117 : 8|16@1+ (1,0) [0|65535] "" Vector__XXX
 SG_ CAN_NBT m115 : 8|16@1+ (1,0) [0|65535] "" Vector__XXX
 SG_ Pos_OffsRef m114 : 8|32@1- (1,0) [-2147483648|2147483647] "" Vector__XXX
 SG_ Pos_TiM m113 : 8|16@1+ (1,0) [0|100] "" Vector__XXX
 SG_ Pos_Dest m110 : 8|32@1- (1,0) [-2147483648|2147483647] "" Vector__XXX
 SG_ Pos_Td m108 : 8|16@1+ (1,0) [0|65535] "ms" Vector__XXX
 SG_ Pos_Ti m107 : 8|16@1+ (1,0) [0|10000] "ms" Vector__XXX
 SG_ Pos_Kp m106 : 8|16@1+ (1,0) [0|500] "" Vector__XXX
 SG_ CAN_ID_Tx m105 : 8|16@1+ (1,0) [0|65530] "" Vector__XXX
 SG_ CAN_ID_Rx m104 : 8|16@1+ (1,0) [0|65530] "" Vector__XXX
 SG_ DeviceType m103 : 8|8@1+ (1,0) [0|255] "" Vector__XXX
 SG_ Regen_P m101 : 8|16@1+ (1,0) [25|10000] "W" Vector__XXX
 SG_ Device_Mains m100 : 8|16@1+ (1,0) [0|1000] "V" Vector__XXX
 SG_ SNr m98 : 8|32@1+ (1,0) [0|4294967295] "" Vector__XXX
 SG_ Ain_in_1_Filter m96 : 8|8@1+ (0.5,0) [0|127.5] "ms" Vector__XXX
 SG_ Speed_Filter m94 : 8|16@1+ (1,0) [0|15] "" Vector__XXX
 SG_ PID_n__Kacc m91 : 8|16@1- (1,0) [0|100] "%" Vector__XXX
 SG_ DC_BUS_comp m90 : 8|1@1+ (1,0) [0|1] "" Vector__XXX
 SG_ n_Nom m89 : 8|16@1+ (1,0) [60|65000] "rpm" Vector__XXX
 SG_ I_red_TD m88 : 8|16@1+ (1,0) [0|32767] "" Vector__XXX
 SG_ Ain_in_2_Cutoff m83 : 8|16@1- (1,0) [-32768|32767] "" Vector__XXX
 SG_ KM_rsvd_0 m81 : 8|1@1+ (1,0) [0|1] "" Vector__XXX
 SG_ Ain_in_1_Cutoff m80 : 8|16@1- (1,0) [0|32767] "" Vector__XXX
 SG_ Motor_Pole m79 : 8|16@1+ (1,0) [2|96] "" Vector__XXX
 SG_ I_nom_eff m78 : 8|16@1+ (0.1,0) [0|6553.5] "0,1" Vector__XXX
 SG_ I_max_eff m77 : 8|16@1+ (0.1,0) [0|3276.7] "Arms" Vector__XXX
 SG_ I_red_TE m76 : 8|16@1+ (1,0) [0|32767] "" Vector__XXX
 SG_ I_lim_dig m70 : 8|16@1- (0.003051851,0) [0|100] "%" Vector__XXX
 SG_ Read_ID m61 : 8|8@1+ (1,0) [0|255] "" Vector__XXX
 SG_ FB_Offset m68 : 8|16@1- (0.1,0) [-360|360] "" Vector__XXX
 SG_ N_Lim_plus m63 : 8|16@1- (0.003051851,0) [0|100] "%" Vector__XXX
 SG_ N_Lim_minus m62 : 8|16@1- (0.003051851,0) [-100|0] "%" Vector__XXX
 SG_ I_red_N m60 : 8|16@1+ (0.003051851,0) [0|100] "%" Vector__XXX
 SG_ PID_n__TiM m59 : 8|16@1+ (1,0) [0|100] "%" Vector__XXX
 SG_ CS_Ain_1_Format m54 : 8|2@1+ (1,0) [0|3] "" Vector__XXX
 SG_ N_R_Acc m53 : 8|16@1+ (1,0) [0|30000] "ms" Vector__XXX
 SG_ N_Lim m52 : 8|16@1- (0.003051851,0) [-100|100] "%" Vector__XXX
 SG_ N_setdig m49 : 8|16@1- (0.2166814173,0) [-7100|7100] "Num" Vector__XXX
 SG_ Ain_in_1_OffsetVal m47 : 8|16@1- (1,0) [-32768|32767] "" Vector__XXX
 SG_ PID_n__Td m46 : 8|16@1+ (1,0) [0|10000] "ms" Vector__XXX
 SG_ PID_n__Ti m45 : 8|16@1+ (1,0) [0|10000] "ms" Vector__XXX
 SG_ PID_n__Kp m44 : 8|16@1+ (1,0) [0|200] "" Vector__XXX
 SG_ PID_I__TiM__Iq m43 : 8|16@1+ (1,0) [0|500] "" Vector__XXX
 SG_ I_Delta_Ramp m37 : 8|16@1- (1,0) [-32768|32767] "" Vector__XXX
 SG_ ID_setdig__Id m33 : 8|16@1- (0.37383776,0) [-12249.91571968|12249.54188192] "Arms" Vector__XXX
 SG_ Cutoffdig m30 : 8|16@1+ (1,0) [0|65535] "" Vector__XXX
 SG_ PID_I__Ti__Iq m29 : 8|16@1+ (1,0) [300|20000] "" Vector__XXX
 SG_ PID_I__Kp__Iq m28 : 8|16@1+ (1,0) [0|200] "" Vector__XXX
 SG_ Calib_Ref_Value m26 : 8|16@1+ (0.1,0) [0|6553.5] "" Vector__XXX
 SG_ Oszi_Run_cmd m24 : 8|16@1+ (1,0) [0|65535] "" Vector__XXX
 SG_ Oszi_Read_cmd m23 : 8|16@1+ (1,0) [0|65535] "" Vector__XXX
 SG_ Oszi_Skip m22 : 8|16@1+ (1,0) [0|65535] "" Vector__XXX
 SG_ Oszi_Source m21 : 8|16@1+ (1,0) [0|65535] "" Vector__XXX
 SG_ Trig_Source m20 : 8|16@1+ (1,0) [0|65535] "" Vector__XXX
 SG_ Trig_Edge m19 : 8|16@1- (1,0) [-32768|32767] "" Vector__XXX
 SG_ Trig_Level m18 : 8|16@1- (1,0) [-32768|32767] "" Vector__XXX
 SG_ Capture_Channel m16 : 8|16@1- (1,0) [-32768|32767] "" Vector__XXX
 SG_ Extra__Start m15 : 8|16@1- (1,0) [-32768|32767] "" Vector__XXX
 SG_ Cos_Phi m14 : 8|16@1+ (1,0) [0|65535] "" Vector__XXX
 SG_ F_corner__Start m13 : 8|16@1- (0.1,0) [-3276.8|3276.7] "Hz" Vector__XXX
 SG_ V_corner__Start m12 : 8|16@1- (0.1,0) [-3276.8|3276.7] "%" Vector__XXX
 SG_ F_min__Start m11 : 8|16@1- (0.1,0) [-3276.8|3276.7] "Hz" Vector__XXX
 SG_ V_min__Start m10 : 8|16@1- (0.1,0) [-3276.8|3276.7] "%" Vector__XXX
 SG_ Special__Start m9 : 8|16@1- (1,0) [-32768|32767] "" Vector__XXX
 SG_ V_dc__Start m8 : 8|16@1- (0.1,0) [-3276.8|3276.7] "%" Vector__XXX
 SG_ T_dc__Start m7 : 8|16@1+ (1,0) [0|65535] "ms" Vector__XXX
 SG_ Motor_F_N m5 : 8|16@1+ (0.1,0) [0|6553.5] "Hz" Vector__XXX
 SG_ Send_Mux M : 0|8@1+ (1,0) [0|0] "" Vector__XXX

BO_ 386 Inverter_R_Rcv: 6 Vector__XXX
 SG_ HndWhl82 m82 : 39|1@1+ (1,0) [0|1] "" Vector__XXX
 SG_ Warn_Ballast m143 : 39|1@1+ (1,0) [0|1] "" Vector__XXX
 SG_ HndWhl64 m64 : 39|1@1+ (1,0) [0|1] "" Vector__XXX
 SG_ ReduceLosses m90 : 39|1@1+ (1,0) [0|1] "" Vector__XXX
 SG_ MD82 m82 : 38|1@1+ (1,0) [0|1] "" Vector__XXX
 SG_ MD64 m64 : 38|1@1+ (1,0) [0|1] "" Vector__XXX
 SG_ DC_1Q3P m90 : 38|1@1+ (1,0) [0|1] "" Vector__XXX
 SG_ RFEpulse82 m82 : 37|1@1+ (1,0) [0|1] "" Vector__XXX
 SG_ RFEpulse64 m64 : 37|1@1+ (1,0) [0|1] "" Vector__XXX
 SG_ DC_1QMV m90 : 37|1@1+ (1,0) [0|1] "" Vector__XXX
 SG_ Iwcns82 m82 : 36|1@1+ (1,0) [0|1] "" Vector__XXX
 SG_ Iwcns64 m64 : 36|1@1+ (1,0) [0|1] "" Vector__XXX
 SG_ block m90 : 36|1@1+ (1,0) [0|1] "" Vector__XXX
 SG_ IrdANA82 m82 : 35|1@1+ (1,0) [0|1] "" Vector__XXX
 SG_ IrdANA64 m64 : 35|1@1+ (1,0) [0|1] "" Vector__XXX
 SG_ DEAD_2 m90 : 35|1@1+ (1,0) [0|1] "" Vector__XXX
 SG_ IrdTM82 m82 : 34|1@1+ (1,0) [0|1] "" Vector__XXX
 SG_ Warn_RaceAway m143 : 34|1@1+ (1,0) [0|1] "" Vector__XXX
 SG_ IrdTM64 m64 : 34|1@1+ (1,0) [0|1] "" Vector__XXX
 SG_ DC_field m90 : 34|1@1+ (1,0) [0|1] "" Vector__XXX
 SG_ _10Hz82 m82 : 33|1@1+ (1,0) [0|1] "" Vector__XXX
 SG_ Warn_IPeak m143 : 33|1@1+ (1,0) [0|1] "" Vector__XXX
 SG_ _10Hz64 m64 : 33|1@1+ (1,0) [0|1] "" Vector__XXX
 SG_ DC_1QdirVolt m90 : 33|1@1+ (1,0) [0|1] "" Vector__XXX
 SG_ CMC__Bit31_24__free m205 : 32|8@1+ (1,0) [0|255] "" Vector__XXX
 SG_ IrdTIR82 m82 : 32|1@1+ (1,0) [0|1] "" Vector__XXX
 SG_ Warn_Vout_Sat m143 : 32|1@1+ (1,0) [0|1] "" Vector__XXX
 SG_ IrdTIR64 m64 : 32|1@1+ (1,0) [0|1] "" Vector__XXX
 SG_ delta m90 : 32|1@1+ (1,0) [0|1] "" Vector__XXX
 SG_ M_R_Acc m53 : 32|16@1+ (1,0) [0|4000] "ms" Vector__XXX
 SG_ CMC__Bit23__TC_nCmdRestOption m205 : 31|1@1+ (1,0) [0|1] "" Vector__XXX
 SG_ IrdTi82 m82 : 31|1@1+ (1,0) [0|1] "" Vector__XXX
 SG_ Warn_DeviceTemp m143 : 31|1@1+ (1,0) [0|1] "" Vector__XXX
 SG_ IrdTi64 m64 : 31|1@1+ (1,0) [0|1] "" Vector__XXX
 SG_ NTC m90 : 31|1@1+ (1,0) [0|1] "" Vector__XXX
 SG_ DUP__Bit31_22__free m220 : 30|10@1+ (1,0) [0|1023] "" Vector__XXX
 SG_ IrdN82 m82 : 30|1@1+ (1,0) [0|1] "" Vector__XXX
 SG_ Warn_MotorTemp m143 : 30|1@1+ (1,0) [0|1] "" Vector__XXX
 SG_ IrdN64 m64 : 30|1@1+ (1,0) [0|1] "" Vector__XXX
 SG_ DUP__Bit21__InitWith_FRG_OFF m220 : 29|1@1+ (1,0) [0|1] "" Vector__XXX
 SG_ CMC__Bit22_21__TC_MinSpeed_conf m205 : 29|2@1+ (1,0) [0|3] "" Vector__XXX
 SG_ Iuserchd82 m82 : 29|1@1+ (1,0) [0|1] "" Vector__XXX
 SG_ Iuserchd64 m64 : 29|1@1+ (1,0) [0|1] "" Vector__XXX
 SG_ DUP__Bit20__HAL_Extmr_Acv m220 : 28|1@1+ (1,0) [0|1] "" Vector__XXX
 SG_ IrdDig82 m82 : 28|1@1+ (1,0) [0|1] "" Vector__XXX
 SG_ IrdDig64 m64 : 28|1@1+ (1,0) [0|1] "" Vector__XXX
 SG_ PWM_Freq m90 : 28|3@1+ (1,0) [0|7] "" Vector__XXX
 SG_ CMC__Bit20_19__TC_DeltaTime_conf m205 : 27|2@1+ (1,0) [0|3] "" Vector__XXX
 SG_ Nclip_plus82 m82 : 27|1@1+ (1,0) [0|1] "" Vector__XXX
 SG_ Nclip_plus64 m64 : 27|1@1+ (1,0) [0|1] "" Vector__XXX
 SG_ AC_DC m90 : 27|1@1+ (1,0) [0|1] "" Vector__XXX
 SG_ CMC__Bit18__TractionControl_Ena m205 : 26|1@1+ (1,0) [0|1] "" Vector__XXX
 SG_ Nclip_minus82 m82 : 26|1@1+ (1,0) [0|1] "" Vector__XXX
 SG_ Warn_Safe_In m143 : 26|1@1+ (1,0) [0|1] "" Vector__XXX
 SG_ Nclip_minus64 m64 : 26|1@1+ (1,0) [0|1] "" Vector__XXX
 SG_ MotBrake m90 : 26|1@1+ (1,0) [0|1] "" Vector__XXX
 SG_ DUP__Bit19_17__ECODE_ReDefine m220 : 25|3@1+ (1,0) [0|7] "" Vector__XXX
 SG_ Nclip82 m82 : 25|1@1+ (1,0) [0|1] "" Vector__XXX
 SG_ Warn_Illegal_Status m143 : 25|1@1+ (1,0) [0|1] "" Vector__XXX
 SG_ Nclip64 m64 : 25|1@1+ (1,0) [0|1] "" Vector__XXX
 SG_ Ramp4 m90 : 25|1@1+ (1,0) [0|1] "" Vector__XXX
 SG_ SVNRevision_Nr m254 : 24|16@1+ (1,0) [0|65535] "" Vector__XXX
 SG_ free m58 : 24|16@1- (1,0) [-32768|32767] "Num" Vector__XXX
 SG_ Special__Stop m9 : 24|16@1- (1,0) [-32768|32767] "" Vector__XXX
 SG_ DUP__Bit16__Bamobil3_2_OffCrct m220 : 24|1@1+ (1,0) [0|1] "" Vector__XXX
 SG_ CMC__Bit17_16__CheckIPeak_config m205 : 24|2@1+ (1,0) [0|3] "" Vector__XXX
 SG_ PID_I__Kf__Id m203 : 24|16@1+ (1,0) [0|200] "" Vector__XXX
 SG_ Bat_Opr_Limit__Gen m202 : 24|16@1+ (0.1,0) [0|6553.5] "A or W" Vector__XXX
 SG_ PID_I__xKp__Id m201 : 24|16@1+ (1,0) [0|200] "%" Vector__XXX
 SG_ DC_Bus_Max_Lim m165 : 24|16@1+ (1,0) [0|65535] "" Vector__XXX
 SG_ Regen_R m101 : 24|16@1+ (1,0) [0|65535] "Ohm" Vector__XXX
 SG_ SignMag82 m82 : 24|1@1+ (1,0) [0|1] "" Vector__XXX
 SG_ Ain_in_2_ScaleVal m215 : 24|16@1- (0.000244140625,0) [-8|7.999755859375] "" Vector__XXX
 SG_ Ain_in_1_ScaleVal m47 : 24|16@1- (0.000244140625,0) [-7.999|7.999] "" Vector__XXX
 SG_ PID_I__TiM__Id m43 : 24|16@1+ (1,0) [0|500] "" Vector__XXX
 SG_ PID_I__Ti__Id m29 : 24|16@1+ (1,0) [300|20000] "" Vector__XXX
 SG_ PID_I__Kp__Id m28 : 24|16@1+ (1,0) [0|200] "" Vector__XXX
 SG_ F_corner__Stop m13 : 24|16@1- (0.1,0) [-3276.8|3276.7] "Hz" Vector__XXX
 SG_ V_corner__Stop m12 : 24|16@1- (0.1,0) [-3276.8|3276.7] "%" Vector__XXX
 SG_ F_min__Stop m11 : 24|16@1- (0.1,0) [-3276.8|3276.7] "Hz" Vector__XXX
 SG_ V_min__Stop m10 : 24|16@1- (0.1,0) [-3276.8|3276.7] "%" Vector__XXX
 SG_ V_dc__Stop m8 : 24|16@1- (0.1,0) [-3276.8|3276.7] "%" Vector__XXX
 SG_ T_dc__Stop m7 : 24|16@1+ (1,0) [0|65535] "ms" Vector__XXX
 SG_ Ain_in_2_scaled214 m214 : 24|16@1- (1,0) [-32768|32767] "" Vector__XXX
 SG_ Ain_in_1_scaled213 m213 : 24|16@1- (1,0) [-32768|32767] "" Vector__XXX
 SG_ Warn_Warning_0 m143 : 24|1@1+ (1,0) [0|1] "" Vector__XXX
 SG_ SignMag64 m64 : 24|1@1+ (1,0) [0|1] "" Vector__XXX
 SG_ SRamp m90 : 24|1@1+ (1,0) [0|1] "" Vector__XXX
 SG_ M_R_Rcp m199 : 24|16@1+ (1,0) [0|4000] "ms" Vector__XXX
 SG_ M_R_Dec m237 : 24|16@1+ (1,0) [0|4000] "ms" Vector__XXX
 SG_ DUP__Bit15__CANopen_Acv m220 : 23|1@1+ (1,0) [0|1] "" Vector__XXX
 SG_ CMC__Bit15__Dig_E_Brake_Act m205 : 23|1@1+ (1,0) [0|1] "" Vector__XXX
 SG_ Gen_AutoIacLimit_is_Acv m204 : 23|1@1+ (1,0) [0|1] "" Vector__XXX
 SG_ Active193 m193 : 23|1@1+ (1,0) [0|1] "" Vector__XXX
 SG_ Active192 m192 : 23|1@1+ (1,0) [0|1] "" Vector__XXX
 SG_ Active191 m191 : 23|1@1+ (1,0) [0|1] "" Vector__XXX
 SG_ Active190 m190 : 23|1@1+ (1,0) [0|1] "" Vector__XXX
 SG_ MO_sc2_inv m164 : 23|1@1+ (1,0) [0|1] "" Vector__XXX
 SG_ Ecode_Bit15__T_IGBT148 m148 : 23|1@1+ (1,0) [0|1] "" Vector__XXX
 SG_ Ecode_Bit15__T_IGBT99 m99 : 23|1@1+ (1,0) [0|1] "" Vector__XXX
 SG_ Brk082 m82 : 23|1@1+ (1,0) [0|1] "" Vector__XXX
 SG_ KM_DEBUG_TEST m81 : 23|1@1+ (1,0) [0|1] "" Vector__XXX
 SG_ CS_Ain_1__N_Limit m54 : 23|1@1+ (1,0) [0|1] "" Vector__XXX
 SG_ BRK1216 m216 : 23|1@1+ (1,0) [0|1] "" Vector__XXX
 SG_ Err_Ballast m143 : 23|1@1+ (1,0) [0|1] "" Vector__XXX
 SG_ Brk064 m64 : 23|1@1+ (1,0) [0|1] "" Vector__XXX
 SG_ LowBd m90 : 23|1@1+ (1,0) [0|1] "" Vector__XXX
 SG_ DUP__Bit14__MTPA_reluct_enab m220 : 22|1@1+ (1,0) [0|1] "" Vector__XXX
 SG_ CMC__Bit14__Idc_Limit_Ena_V2 m205 : 22|1@1+ (1,0) [0|1] "" Vector__XXX
 SG_ Ecode_Bit14__UBMAm148 m148 : 22|1@1+ (1,0) [0|1] "" Vector__XXX
 SG_ Ecode_Bit14__UBMAm99 m99 : 22|1@1+ (1,0) [0|1] "" Vector__XXX
 SG_ Rdy82 m82 : 22|1@1+ (1,0) [0|1] "" Vector__XXX
 SG_ KM_PSEUDO_ENABLE m81 : 22|1@1+ (1,0) [0|1] "" Vector__XXX
 SG_ CS_Ain_2__I_Limit m54 : 22|1@1+ (1,0) [0|1] "" Vector__XXX
 SG_ GOFF m216 : 22|1@1+ (1,0) [0|1] "" Vector__XXX
 SG_ Err_HWErr m143 : 22|1@1+ (1,0) [0|1] "" Vector__XXX
 SG_ Rdy64 m64 : 22|1@1+ (1,0) [0|1] "" Vector__XXX
 SG_ Ana_0up m90 : 22|1@1+ (1,0) [0|1] "" Vector__XXX
 SG_ DUP__Bit13__Gen_AutoIacLimit m220 : 21|1@1+ (1,0) [0|1] "" Vector__XXX
 SG_ Ecode_Bit13__18m_plus148 m148 : 21|1@1+ (1,0) [0|1] "" Vector__XXX
 SG_ Ecode_Bit13__18m_plus99 m99 : 21|1@1+ (1,0) [0|1] "" Vector__XXX
 SG_ Tol82 m82 : 21|1@1+ (1,0) [0|1] "" Vector__XXX
 SG_ KM_rsvd_13 m81 : 21|1@1+ (1,0) [0|1] "" Vector__XXX
 SG_ OUT4 m216 : 21|1@1+ (1,0) [0|1] "" Vector__XXX
 SG_ Tol64 m64 : 21|1@1+ (1,0) [0|1] "" Vector__XXX
 SG_ DUP__Bit12__Boat_Pedal m220 : 20|1@1+ (1,0) [0|1] "" Vector__XXX
 SG_ MO_sc2_reso m164 : 20|3@1+ (1,0) [0|7] "" Vector__XXX
 SG_ Ecode_Bit12__15m_plus148 m148 : 20|1@1+ (1,0) [0|1] "" Vector__XXX
 SG_ Ecode_Bit12__15m_plus99 m99 : 20|1@1+ (1,0) [0|1] "" Vector__XXX
 SG_ Cal82 m82 : 20|1@1+ (1,0) [0|1] "" Vector__XXX
 SG_ KM_rsvd_12 m81 : 20|1@1+ (1,0) [0|1] "" Vector__XXX
 SG_ CurrentMode m17 : 20|4@1+ (1,0) [0|15] "" Vector__XXX
 SG_ CS_CMD_Type m54 : 20|2@1+ (1,0) [0|3] "" Vector__XXX
 SG_ OUT3 m216 : 20|1@1+ (1,0) [0|1] "" Vector__XXX
 SG_ Cal64 m64 : 20|1@1+ (1,0) [0|1] "" Vector__XXX
 SG_ MotorType m90 : 20|2@1+ (1,0) [0|3] "" Vector__XXX
 SG_ Test m27 : 20|4@1+ (1,0) [0|15] "" Vector__XXX
 SG_ DUP__Bit11__DCBus_Volts m220 : 19|1@1+ (1,0) [0|1] "" Vector__XXX
 SG_ MO_sc1_comp m164 : 19|1@1+ (1,0) [0|1] "" Vector__XXX
 SG_ Ecode_Bit11__15m_minus148 m148 : 19|1@1+ (1,0) [0|1] "" Vector__XXX
 SG_ Ecode_Bit11__15m_minus99 m99 : 19|1@1+ (1,0) [0|1] "" Vector__XXX
 SG_ Cal082 m82 : 19|1@1+ (1,0) [0|1] "" Vector__XXX
 SG_ KM_rsvd_11 m81 : 19|1@1+ (1,0) [0|1] "" Vector__XXX
 SG_ CS_oora2 m54 : 19|1@1+ (1,0) [0|1] "" Vector__XXX
 SG_ GO216 m216 : 19|1@1+ (1,0) [0|1] "" Vector__XXX
 SG_ Err_USER m143 : 19|1@1+ (1,0) [0|1] "" Vector__XXX
 SG_ Cal064 m64 : 19|1@1+ (1,0) [0|1] "" Vector__XXX
 SG_ OL_comp m90 : 19|1@1+ (1,0) [0|1] "" Vector__XXX
 SG_ DUP__Bit10__PARK_RMS m220 : 18|1@1+ (1,0) [0|1] "" Vector__XXX
 SG_ Ecode_Bit10__VCCm148 m148 : 18|1@1+ (1,0) [0|1] "" Vector__XXX
 SG_ Ecode_Bit10__VCCm99 m99 : 18|1@1+ (1,0) [0|1] "" Vector__XXX
 SG_ Rsw82 m82 : 18|1@1+ (1,0) [0|1] "" Vector__XXX
 SG_ KM_PHASING_EXTEND m81 : 18|1@1+ (1,0) [0|1] "" Vector__XXX
 SG_ BTBRdy m216 : 18|1@1+ (1,0) [0|1] "" Vector__XXX
 SG_ Err_RaceAway m143 : 18|1@1+ (1,0) [0|1] "" Vector__XXX
 SG_ Rsw64 m64 : 18|1@1+ (1,0) [0|1] "" Vector__XXX
 SG_ H2inv m90 : 18|1@1+ (1,0) [0|1] "" Vector__XXX
 SG_ DUP__Bit9__GENERATOR m220 : 17|1@1+ (1,0) [0|1] "" Vector__XXX
 SG_ Ecode_Bit9__FAIL_I148 m148 : 17|1@1+ (1,0) [0|1] "" Vector__XXX
 SG_ Ecode_Bit9__FAIL_I99 m99 : 17|1@1+ (1,0) [0|1] "" Vector__XXX
 SG_ _N082 m82 : 17|1@1+ (1,0) [0|1] "" Vector__XXX
 SG_ KM_HANDWHEEL m81 : 17|1@1+ (1,0) [0|1] "" Vector__XXX
 SG_ OUT2 m216 : 17|1@1+ (1,0) [0|1] "" Vector__XXX
 SG_ Err_IPeak m143 : 17|1@1+ (1,0) [0|1] "" Vector__XXX
 SG_ _N064 m64 : 17|1@1+ (1,0) [0|1] "" Vector__XXX
 SG_ Hxinv m90 : 17|1@1+ (1,0) [0|1] "" Vector__XXX
 SG_ DUP__Bit8__CAN_EXTENDED_0 m220 : 16|1@1+ (1,0) [0|1] "" Vector__XXX
 SG_ Source_ID219 m219 : 16|8@1+ (1,0) [0|255] "" Vector__XXX
 SG_ Source_ID218 m218 : 16|8@1+ (1,0) [0|255] "" Vector__XXX
 SG_ Source_ID195 m195 : 16|8@1+ (1,0) [0|255] "" Vector__XXX
 SG_ Source_ID194 m194 : 16|8@1+ (1,0) [0|255] "" Vector__XXX
 SG_ MO_sc1_reso m164 : 16|3@1+ (1,0) [0|7] "" Vector__XXX
 SG_ Ecode_Bit8__FAIL_IDC148 m148 : 16|1@1+ (1,0) [0|1] "" Vector__XXX
 SG_ Ecode_Bit8__FAIL_IDC99 m99 : 16|1@1+ (1,0) [0|1] "" Vector__XXX
 SG_ Ain_in_2_Filter m96 : 16|8@1+ (0.5,0) [0|127.5] "ms" Vector__XXX
 SG_ NI82 m82 : 16|1@1+ (1,0) [0|1] "" Vector__XXX
 SG_ KM_ALLOW_SYNC m81 : 16|1@1+ (1,0) [0|1] "" Vector__XXX
 SG_ CtrlSubMode m17 : 16|4@1+ (1,0) [0|15] "" Vector__XXX
 SG_ CS_Ain_2_Mode m54 : 16|3@1+ (1,0) [0|7] "" Vector__XXX
 SG_ OUT1 m216 : 16|1@1+ (1,0) [0|1] "" Vector__XXX
 SG_ Err_OverVoltage m143 : 16|1@1+ (1,0) [0|1] "" Vector__XXX
 SG_ NI64 m64 : 16|1@1+ (1,0) [0|1] "" Vector__XXX
 SG_ I1_Adc_Ena m90 : 16|1@1+ (1,0) [0|1] "" Vector__XXX
 SG_ brk1155 m155 : 15|1@1+ (1,0) [0|1] "" Vector__XXX
 SG_ CMC__Bit13_7__free m205 : 15|7@1+ (1,0) [0|127] "" Vector__XXX
 SG_ Ecode_Bit7__FLTLS148 m148 : 15|1@1+ (1,0) [0|1] "" Vector__XXX
 SG_ Ecode_Bit7__FLTLS99 m99 : 15|1@1+ (1,0) [0|1] "" Vector__XXX
 SG_ PN82 m82 : 15|1@1+ (1,0) [0|1] "" Vector__XXX
 SG_ KM_MIX_ANA_ON m81 : 15|1@1+ (1,0) [0|1] "" Vector__XXX
 SG_ CS_oora1 m54 : 15|1@1+ (1,0) [0|1] "" Vector__XXX
 SG_ Err_DeviceTemp m143 : 15|1@1+ (1,0) [0|1] "" Vector__XXX
 SG_ PN64 m64 : 15|1@1+ (1,0) [0|1] "" Vector__XXX
 SG_ Vdc_Ana m90 : 15|1@1+ (1,0) [0|1] "" Vector__XXX
 SG_ rsvd1 m155 : 14|1@1+ (1,0) [0|1] "" Vector__XXX
 SG_ rsvd m152 : 14|2@1+ (1,0) [0|3] "" Vector__XXX
 SG_ CMC__Bit6__TorqueTimeOut_100ms_E m205 : 14|1@1+ (1,0) [0|1] "" Vector__XXX
 SG_ I_DC_Limit_is_Acv m204 : 14|1@1+ (1,0) [0|1] "" Vector__XXX
 SG_ Ecode_Bit6__FLTHS148 m148 : 14|1@1+ (1,0) [0|1] "" Vector__XXX
 SG_ Ecode_Bit6__FLTHS99 m99 : 14|1@1+ (1,0) [0|1] "" Vector__XXX
 SG_ TNLim82 m82 : 14|1@1+ (1,0) [0|1] "" Vector__XXX
 SG_ KM_N_CLIP m81 : 14|1@1+ (1,0) [0|1] "" Vector__XXX
 SG_ Err_MotorTemp m143 : 14|1@1+ (1,0) [0|1] "" Vector__XXX
 SG_ TNLim64 m64 : 14|1@1+ (1,0) [0|1] "" Vector__XXX
 SG_ No_UESP_BTB m90 : 14|1@1+ (1,0) [0|1] "" Vector__XXX
 SG_ Out_4 m155 : 13|1@1+ (1,0) [0|1] "" Vector__XXX
 SG_ RFE152 m152 : 13|1@1+ (1,0) [0|1] "" Vector__XXX
 SG_ CMC__Bit5__Reset_NRamp_AtNZero m205 : 13|1@1+ (1,0) [0|1] "" Vector__XXX
 SG_ Recup_is_Acv m204 : 13|1@1+ (1,0) [0|1] "" Vector__XXX
 SG_ MO_Feedback_2 m164 : 13|3@1+ (1,0) [0|7] "" Vector__XXX
 SG_ Ecode_Bit5__N_FAIL148 m148 : 13|1@1+ (1,0) [0|1] "" Vector__XXX
 SG_ Ecode_Bit5__N_FAIL99 m99 : 13|1@1+ (1,0) [0|1] "" Vector__XXX
 SG_ Icns82 m82 : 13|1@1+ (1,0) [0|1] "" Vector__XXX
 SG_ KM_I_LIMIT m81 : 13|1@1+ (1,0) [0|1] "" Vector__XXX
 SG_ RFE216 m216 : 13|1@1+ (1,0) [0|1] "" Vector__XXX
 SG_ Err_PowerVoltage_Low m143 : 13|1@1+ (1,0) [0|1] "" Vector__XXX
 SG_ Icns64 m64 : 13|1@1+ (1,0) [0|1] "" Vector__XXX
 SG_ REFSOFT m90 : 13|1@1+ (1,0) [0|1] "" Vector__XXX
 SG_ Out_3 m155 : 12|1@1+ (1,0) [0|1] "" Vector__XXX
 SG_ Run152 m152 : 12|1@1+ (1,0) [0|1] "" Vector__XXX
 SG_ CMC__Bit4__Dig_M_RcpRamp_Ena m205 : 12|1@1+ (1,0) [0|1] "" Vector__XXX
 SG_ Compare_Var219 m219 : 12|3@1+ (1,0) [0|7] "" Vector__XXX
 SG_ Compare_Var218 m218 : 12|3@1+ (1,0) [0|7] "" Vector__XXX
 SG_ Compare_Var195 m195 : 12|3@1+ (1,0) [0|7] "" Vector__XXX
 SG_ Compare_Var194 m194 : 12|3@1+ (1,0) [0|7] "" Vector__XXX
 SG_ Ecode_Bit4__RDY3148 m148 : 12|1@1+ (1,0) [0|1] "" Vector__XXX
 SG_ Ecode_Bit4__RDY399 m99 : 12|1@1+ (1,0) [0|1] "" Vector__XXX
 SG_ OK82 m82 : 12|1@1+ (1,0) [0|1] "" Vector__XXX
 SG_ KM_TX_TOG_STAT m81 : 12|1@1+ (1,0) [0|1] "" Vector__XXX
 SG_ CS_Ain_1_Mode m54 : 12|3@1+ (1,0) [0|7] "" Vector__XXX
 SG_ FRGRUN m216 : 12|1@1+ (1,0) [0|1] "" Vector__XXX
 SG_ Err_FeedbackSignal m143 : 12|1@1+ (1,0) [0|1] "" Vector__XXX
 SG_ OK64 m64 : 12|1@1+ (1,0) [0|1] "" Vector__XXX
 SG_ I_ist_Inverse m90 : 12|1@1+ (1,0) [0|1] "" Vector__XXX
 SG_ Go155 m155 : 11|1@1+ (1,0) [0|1] "" Vector__XXX
 SG_ In_1 m152 : 11|1@1+ (1,0) [0|1] "" Vector__XXX
 SG_ CMC__Bit3__TorqueVal_Init_Ena m205 : 11|1@1+ (1,0) [0|1] "" Vector__XXX
 SG_ Ecode_Bit3__Free148 m148 : 11|1@1+ (1,0) [0|1] "" Vector__XXX
 SG_ Ecode_Bit3__Free99 m99 : 11|1@1+ (1,0) [0|1] "" Vector__XXX
 SG_ Lim_minus82 m82 : 11|1@1+ (1,0) [0|1] "" Vector__XXX
 SG_ KM_CAL_OFF m81 : 11|1@1+ (1,0) [0|1] "" Vector__XXX
 SG_ IN1 m216 : 11|1@1+ (1,0) [0|1] "" Vector__XXX
 SG_ Err_BusTimeout m143 : 11|1@1+ (1,0) [0|1] "" Vector__XXX
 SG_ Lim_minus64 m64 : 11|1@1+ (1,0) [0|1] "" Vector__XXX
 SG_ CoastStop m90 : 11|1@1+ (1,0) [0|1] "" Vector__XXX
 SG_ Rdy155 m155 : 10|1@1+ (1,0) [0|1] "" Vector__XXX
 SG_ In_2 m152 : 10|1@1+ (1,0) [0|1] "" Vector__XXX
 SG_ CMC__Bit2__Pdc_Limit_Usage m205 : 10|1@1+ (1,0) [0|1] "" Vector__XXX
 SG_ Op_Mode_Quadrant m204 : 10|3@1+ (1,0) [0|7] "" Vector__XXX
 SG_ Ecode_Bit2__HW0_State148 m148 : 10|1@1+ (1,0) [0|1] "" Vector__XXX
 SG_ Ecode_Bit2__HW0_State99 m99 : 10|1@1+ (1,0) [0|1] "" Vector__XXX
 SG_ Lim_plus82 m82 : 10|1@1+ (1,0) [0|1] "" Vector__XXX
 SG_ KM_FRG_OFF m81 : 10|1@1+ (1,0) [0|1] "" Vector__XXX
 SG_ CS_Ain_2_Format m54 : 10|2@1+ (1,0) [0|3] "" Vector__XXX
 SG_ IN2 m216 : 10|1@1+ (1,0) [0|1] "" Vector__XXX
 SG_ Err_RFE_Fault m143 : 10|1@1+ (1,0) [0|1] "" Vector__XXX
 SG_ Lim_plus64 m64 : 10|1@1+ (1,0) [0|1] "" Vector__XXX
 SG_ FB_Special m90 : 10|1@1+ (1,0) [0|1] "" Vector__XXX
 SG_ Out_2 m155 : 9|1@1+ (1,0) [0|1] "" Vector__XXX
 SG_ Lmt_2 m152 : 9|1@1+ (1,0) [0|1] "" Vector__XXX
 SG_ CMC__Bit1__Idc_Limit_Ena m205 : 9|1@1+ (1,0) [0|1] "" Vector__XXX
 SG_ DC_I_SensEna_Set m204 : 9|1@1+ (1,0) [0|1] "" Vector__XXX
 SG_ Ecode_Bit1__HW1_State148 m148 : 9|1@1+ (1,0) [0|1] "" Vector__XXX
 SG_ Ecode_Bit1__HW1_State99 m99 : 9|1@1+ (1,0) [0|1] "" Vector__XXX
 SG_ NcR082 m82 : 9|1@1+ (1,0) [0|1] "" Vector__XXX
 SG_ KM_SPEED_0 m81 : 9|1@1+ (1,0) [0|1] "" Vector__XXX
 SG_ LMT2 m216 : 9|1@1+ (1,0) [0|1] "" Vector__XXX
 SG_ Err_PowerFault m143 : 9|1@1+ (1,0) [0|1] "" Vector__XXX
 SG_ NcR064 m64 : 9|1@1+ (1,0) [0|1] "" Vector__XXX
 SG_ Ballast_Ext m90 : 9|1@1+ (1,0) [0|1] "" Vector__XXX
 SG_ SubVersion_Nr m254 : 8|16@1+ (1,0) [0|65535] "" Vector__XXX
 SG_ Out_1 m155 : 8|1@1+ (1,0) [0|1] "" Vector__XXX
 SG_ Lmt_1 m152 : 8|1@1+ (1,0) [0|1] "" Vector__XXX
 SG_ M_cmd_ramp m58 : 8|16@1- (1,0) [-32767|32767] "Num" Vector__XXX
 SG_ Vdc_Bus m102 : 8|16@1+ (0.03166389465,0) [0|2075] "V" Vector__XXX
 SG_ Pos_Ref_Start m120 : 8|16@1- (1,0) [-32768|32767] "" Vector__XXX
 SG_ Oszi_Read_cmd m23 : 8|16@1+ (1,0) [0|65535] "" Vector__XXX
 SG_ Oszi_Run_cmd m24 : 8|16@1+ (1,0) [0|65535] "" Vector__XXX
 SG_ Oszi_Skip m22 : 8|16@1+ (1,0) [0|65535] "" Vector__XXX
 SG_ Oszi_Source m21 : 8|16@1+ (1,0) [0|65535] "" Vector__XXX
 SG_ Trig_Source m20 : 8|16@1+ (1,0) [0|65535] "" Vector__XXX
 SG_ Trig_Edge m19 : 8|16@1- (1,0) [-32768|32767] "" Vector__XXX
 SG_ Trig_Level m18 : 8|16@1- (1,0) [-32768|32767] "" Vector__XXX
 SG_ Capture_Channel m16 : 8|16@1- (1,0) [-32768|32767] "" Vector__XXX
 SG_ Extra__Start m9 : 8|16@1- (1,0) [-32768|32767] "" Vector__XXX
 SG_ Work m247 : 8|16@1- (1,0) [-32768|32767] "Joul" Vector__XXX
 SG_ Power m246 : 8|16@1- (1,0) [-32768|32767] "W" Vector__XXX
 SG_ Brake_Delay m241 : 8|16@1+ (1,0) [0|65535] "ms" Vector__XXX
 SG_ T_peak m240 : 8|16@1+ (1,0) [0|65535] "s" Vector__XXX
 SG_ No_HW_Fault m239 : 8|1@1+ (1,0) [0|1] "" Vector__XXX
 SG_ FB_LossOfSignal m236 : 8|1@1+ (1,0) [0|1] "" Vector__XXX
 SG_ DUP__Bit7_0__DAC_Source_Channel m220 : 8|8@1+ (1,0) [0|255] "" Vector__XXX
 SG_ Var_4 m212 : 8|32@1- (1,0) [-2147483648|2147483647] "" Vector__XXX
 SG_ Var_3 m211 : 8|32@1- (1,0) [-2147483648|2147483647] "" Vector__XXX
 SG_ Var_2 m210 : 8|32@1- (1,0) [-2147483648|2147483647] "" Vector__XXX
 SG_ Can_RxTimeout m208 : 8|16@1- (1,0) [0|32767] "ms" Vector__XXX
 SG_ Var_1 m209 : 8|32@1- (1,0) [-2147483648|2147483647] "" Vector__XXX
 SG_ N_Rpm_MaxInt m206 : 8|16@1- (1,0) [-32768|32767] "rpm" Vector__XXX
 SG_ CMC__Bit0__DC_Current_Sens_Ena m205 : 8|1@1+ (1,0) [0|1] "" Vector__XXX
 SG_ DC_Current_Sens_Ena_Set m204 : 8|1@1+ (1,0) [0|1] "" Vector__XXX
 SG_ PID_I__Kf__Iq m203 : 8|16@1+ (1,0) [0|200] "" Vector__XXX
 SG_ Bat_Opr_Limit__Mot m202 : 8|16@1+ (0.1,0) [0|6553.5] "A or W" Vector__XXX
 SG_ PID_I__xKp__Iq m201 : 8|16@1+ (1,0) [0|200] "%" Vector__XXX
 SG_ Operand219 m219 : 8|4@1+ (1,0) [0|15] "" Vector__XXX
 SG_ Operand218 m218 : 8|4@1+ (1,0) [0|15] "" Vector__XXX
 SG_ Operand195 m195 : 8|4@1+ (1,0) [0|15] "" Vector__XXX
 SG_ Ain_in_2_scaled252 m252 : 8|16@1- (1,0) [-32768|32767] "" Vector__XXX
 SG_ Ain_in_1_scaled251 m251 : 8|16@1- (1,0) [-32768|32767] "" Vector__XXX
 SG_ Signal_PosTolerance m244 : 8|1@1+ (1,0) [0|1] "" Vector__XXX
 SG_ Signal_LessN0 m245 : 8|1@1+ (1,0) [0|1] "" Vector__XXX
 SG_ Signal_Icns m243 : 8|1@1+ (1,0) [0|1] "" Vector__XXX
 SG_ Signal_Brake m242 : 8|1@1+ (1,0) [0|1] "" Vector__XXX
 SG_ Signal_GO m227 : 8|1@1+ (1,0) [0|1] "" Vector__XXX
 SG_ I_Max_Inuse m36 : 8|16@1- (0.13876843,0) [-4547.16391424|4547.02514581] "Arms" Vector__XXX
 SG_ Operand194 m194 : 8|4@1+ (1,0) [0|15] "" Vector__XXX
 SG_ def_DIN_2 m193 : 8|15@1+ (1,0) [0|32767] "" Vector__XXX
 SG_ def_DIN_1 m192 : 8|15@1+ (1,0) [0|32767] "" Vector__XXX
 SG_ def_END_2 m191 : 8|15@1+ (1,0) [0|32767] "" Vector__XXX
 SG_ def_END_1 m190 : 8|15@1+ (1,0) [0|32767] "" Vector__XXX
 SG_ Motor_Ts m189 : 8|16@1- (0.001,0) [-32.768|32.767] "ms" Vector__XXX
 SG_ Motor_Rs m188 : 8|16@1+ (1,0) [0|65535] "mOhm" Vector__XXX
 SG_ Motor_Tr m182 : 8|16@1- (1,0) [-32768|32767] "ms" Vector__XXX
 SG_ Id_Min m181 : 8|16@1- (1,0) [0|100] "%" Vector__XXX
 SG_ Motor_Rr m180 : 8|16@1+ (1,0) [0|65535] "mOhm" Vector__XXX
 SG_ Motor_Lm m179 : 8|16@1+ (0.01,0) [0|655.35] "mH" Vector__XXX
 SG_ Id_Nom m178 : 8|16@1- (1,0) [-32768|32767] "%" Vector__XXX
 SG_ Motor_Lsd m187 : 8|16@1+ (0.001,0) [0|65.535] "mH" Vector__XXX
 SG_ Motor_Lsq m177 : 8|16@1+ (0.001,0) [0|65.535] "mH" Vector__XXX
 SG_ timer_delta m175 : 8|16@1- (1,0) [-32768|32767] "" Vector__XXX
 SG_ PWM_3 m174 : 8|16@1- (1,0) [-32768|32767] "" Vector__XXX
 SG_ PWM_2 m173 : 8|16@1- (1,0) [-32768|32767] "" Vector__XXX
 SG_ PWM_1 m172 : 8|16@1- (1,0) [-32768|32767] "" Vector__XXX
 SG_ Logic_Freq m171 : 8|16@1+ (1,0) [0|65535] "Hz" Vector__XXX
 SG_ FB_Pole m167 : 8|16@1+ (1,0) [0|65535] "" Vector__XXX
 SG_ FB_Incr_Mot m166 : 8|16@1+ (1,0) [0|65535] "Inc/Rev" Vector__XXX
 SG_ DC_Bus_Min_Lim m165 : 8|16@1+ (1,0) [0|65535] "" Vector__XXX
 SG_ MO_Feedback_1 m164 : 8|5@1+ (1,0) [0|31] "" Vector__XXX
 SG_ M_Temp m163 : 8|16@1+ (1,0) [0|32767] "Num" Vector__XXX
 SG_ Ballastcount m161 : 8|16@1- (1,0) [-32768|32767] "" Vector__XXX
 SG_ Info_Timer_Diff m153 : 8|16@1+ (1,0) [0|65535] "" Vector__XXX
 SG_ CAN_Error_CRC_Check151 m151 : 8|16@1+ (1,0) [0|65535] "" Vector__XXX
 SG_ CAN_Error_CRC_Check150 m150 : 8|16@1+ (1,0) [0|65535] "" Vector__XXX
 SG_ CAN_Error_No_Ack m149 : 8|16@1+ (1,0) [0|65535] "" Vector__XXX
 SG_ Ecode_Bit0_FirstErrorDtcd148 m148 : 8|1@1+ (1,0) [0|1] "" Vector__XXX
 SG_ CAN_Error_WriteTime m147 : 8|16@1+ (1,0) [0|65535] "" Vector__XXX
 SG_ CAN_Error_BusOff m146 : 8|16@1+ (1,0) [0|65535] "" Vector__XXX
 SG_ Pos_cmd m145 : 8|32@1- (1,0) [-2147483648|2147483647] "" Vector__XXX
 SG_ Clear_Errors m142 : 8|16@1+ (1,0) [0|65535] "" Vector__XXX
 SG_ PID_n__Ti m45 : 8|16@1+ (1,0) [0|10000] "ms" Vector__XXX
 SG_ V_Kp m140 : 8|16@1+ (1,0) [0|65535] "" Vector__XXX
 SG_ V_Ref m139 : 8|16@1- (1,0) [-32768|32767] "%" Vector__XXX
 SG_ CAN_ID_2_Tx m137 : 8|32@1+ (1,0) [0|4294967295] "" Vector__XXX
 SG_ CAN_ID_2_Rx m136 : 8|32@1+ (1,0) [0|4294967295] "" Vector__XXX
 SG_ Fun_Special m133 : 8|16@1+ (1,0) [0|65535] "" Vector__XXX
 SG_ Fun_Para_Write m132 : 8|16@1+ (1,0) [0|65535] "" Vector__XXX
 SG_ Fun_Para_Read m131 : 8|16@1+ (1,0) [0|65535] "" Vector__XXX
 SG_ Pos_Diff_Slack m128 : 8|16@1- (1,0) [-32768|32767] "" Vector__XXX
 SG_ Pos_Offset_Slack m127 : 8|32@1- (1,0) [-2147483648|2147483647] "" Vector__XXX
 SG_ FB2_Scale_Ext m126 : 8|32@1- (1,0) [-2147483648|2147483647] "" Vector__XXX
 SG_ Pos_ND_Offset m125 : 8|32@1- (1,0) [-2147483648|2147483647] "" Vector__XXX
 SG_ Pos_ND_Scale m124 : 8|32@1- (1,0) [-2147483648|2147483647] "" Vector__XXX
 SG_ Pos_Zero_Offset m123 : 8|32@1- (1,0) [-2147483648|2147483647] "" Vector__XXX
 SG_ Pos_Preset_Val m122 : 8|32@1- (1,0) [-2147483648|2147483647] "" Vector__XXX
 SG_ Pos_Tol_Win m121 : 8|16@1- (1,0) [-32768|32767] "" Vector__XXX
 SG_ Speed_2 m119 : 8|16@1- (1,0) [-32768|32767] "" Vector__XXX
 SG_ Speed_1 m118 : 8|16@1- (1,0) [-32768|32767] "" Vector__XXX
 SG_ Ref_Reso_Edge m117 : 8|16@1+ (1,0) [0|65535] "" Vector__XXX
 SG_ Pos_Zero_Capture m116 : 8|16@1+ (1,0) [0|65535] "" Vector__XXX
 SG_ CAN_NBT m115 : 8|16@1+ (1,0) [0|65535] "" Vector__XXX
 SG_ Pos_OffsRef m114 : 8|32@1- (1,0) [-2147483648|2147483647] "" Vector__XXX
 SG_ Pos_TiM m113 : 8|16@1+ (1,0) [0|100] "" Vector__XXX
 SG_ Pos_Error m112 : 8|32@1- (1,0) [-2147483648|2147483647] "" Vector__XXX
 SG_ Pos_Actual_2 m111 : 8|32@1- (1,0) [-2147483648|2147483647] "" Vector__XXX
 SG_ Pos_Dest m110 : 8|32@1- (1,0) [-2147483648|2147483647] "" Vector__XXX
 SG_ Pos_Actual m109 : 8|32@1- (1,0) [-2147483648|2147483647] "" Vector__XXX
 SG_ Pos_Td m108 : 8|16@1+ (1,0) [0|65535] "ms" Vector__XXX
 SG_ Pos_Ti m107 : 8|16@1+ (1,0) [0|10000] "ms" Vector__XXX
 SG_ Pos_Kp m106 : 8|16@1+ (1,0) [0|500] "" Vector__XXX
 SG_ CAN_ID_Tx m105 : 8|16@1+ (1,0) [0|65530] "" Vector__XXX
 SG_ CAN_ID_Rx m104 : 8|16@1+ (1,0) [0|65530] "" Vector__XXX
 SG_ Regen_P m101 : 8|16@1+ (1,0) [25|10000] "W" Vector__XXX
 SG_ Device_Mains m100 : 8|16@1+ (1,0) [0|1000] "V" Vector__XXX
 SG_ Ecode_Bit0_FirstErrorDtcd99 m99 : 8|1@1+ (1,0) [0|1] "" Vector__XXX
 SG_ Ixt_Monitor m97 : 8|16@1+ (1,0) [0|65535] "" Vector__XXX
 SG_ Ain_in_1_Filter m96 : 8|8@1+ (0.5,0) [0|127.5] "ms" Vector__XXX
 SG_ Speed_Filter m94 : 8|16@1+ (1,0) [0|15] "" Vector__XXX
 SG_ Rotor_Signals m92 : 8|16@1+ (1,0) [0|65535] "%" Vector__XXX
 SG_ PID_n__Kacc m91 : 8|16@1- (1,0) [0|100] "%" Vector__XXX
 SG_ n_Nom m89 : 8|16@1+ (1,0) [60|65000] "rpm" Vector__XXX
 SG_ I_Limit_Inuse_ramp m87 : 8|16@1- (0.37383776,0) [-12249.91571968|12249.54188192] "Arms" Vector__XXX
 SG_ Ain_in_2_Cutoff m83 : 8|16@1- (1,0) [-32768|32767] "" Vector__XXX
 SG_ Ena82 m82 : 8|1@1+ (1,0) [0|1] "" Vector__XXX
 SG_ KM_rsvd_0 m81 : 8|1@1+ (1,0) [0|1] "" Vector__XXX
 SG_ ActiveControlMode m17 : 8|8@1+ (1,0) [0|255] "" Vector__XXX
 SG_ Ain_in_1_Cutoff m80 : 8|16@1- (1,0) [0|32767] "" Vector__XXX
 SG_ Motor_Pole m79 : 8|16@1+ (1,0) [2|96] "" Vector__XXX
 SG_ It_Rg_Monitor m69 : 8|32@1- (1,0) [-2147483648|2147483647] "" Vector__XXX
 SG_ FB_Offset m68 : 8|16@1- (0.1,0) [-360|360] "" Vector__XXX
 SG_ MotorPos_Elec m67 : 8|16@1- (1,0) [-32768|32767] "" Vector__XXX
 SG_ MotorPos_Mech m66 : 8|16@1- (1,0) [-32768|32767] "" Vector__XXX
 SG_ Incr_Delta m65 : 8|16@1- (1,0) [-32768|32767] "" Vector__XXX
 SG_ N_Lim_minus m62 : 8|16@1- (0.003051851,0) [-100|0] "%" Vector__XXX
 SG_ N_Lim_plus m63 : 8|16@1- (0.003051851,0) [0|100] "%" Vector__XXX
 SG_ PID_n__TiM m59 : 8|16@1+ (1,0) [0|100] "%" Vector__XXX
 SG_ DZR_Seq m55 : 8|15@1+ (1,0) [0|32767] "" Vector__XXX
 SG_ Ain_in_2_OffsetVal m215 : 8|16@1- (1,0) [-32768|32767] "" Vector__XXX
 SG_ Ain_in_1_OffsetVal m47 : 8|16@1- (1,0) [-32768|32767] "" Vector__XXX
 SG_ PID_n__Td m46 : 8|16@1+ (1,0) [0|10000] "ms" Vector__XXX
 SG_ V_Ti m141 : 8|16@1+ (1,0) [0|65535] "ms" Vector__XXX
 SG_ PID_n__Kp m44 : 8|16@1+ (1,0) [0|200] "" Vector__XXX
 SG_ PID_I__TiM__Iq m43 : 8|16@1+ (1,0) [0|500] "" Vector__XXX
 SG_ I_Delta_Ramp m37 : 8|16@1- (1,0) [-32768|32767] "" Vector__XXX
 SG_ I3_Offset m31 : 8|16@1+ (1,0) [0|65535] "" Vector__XXX
 SG_ Cutoffdig m30 : 8|16@1+ (1,0) [0|65535] "" Vector__XXX
 SG_ PID_I__Ti__Iq m29 : 8|16@1+ (1,0) [300|20000] "" Vector__XXX
 SG_ PID_I__Kp__Iq m28 : 8|16@1+ (1,0) [0|200] "" Vector__XXX
 SG_ Calib_Ref_Value m26 : 8|16@1+ (0.1,0) [0|6553.5] "" Vector__XXX
 SG_ PWM_Enum m25 : 8|16@1+ (1,0) [0|65535] "" Vector__XXX
 SG_ Cos_Phi m14 : 8|16@1+ (1,0) [0|65535] "" Vector__XXX
 SG_ F_corner__Start m13 : 8|16@1- (0.1,0) [-3276.8|3276.7] "Hz" Vector__XXX
 SG_ V_corner__Start m12 : 8|16@1- (0.1,0) [-3276.8|3276.7] "%" Vector__XXX
 SG_ F_min__Start m11 : 8|16@1- (0.1,0) [-3276.8|3276.7] "Hz" Vector__XXX
 SG_ V_min__Start m10 : 8|16@1- (0.1,0) [-3276.8|3276.7] "%" Vector__XXX
 SG_ V_dc__Start m8 : 8|16@1- (0.1,0) [-3276.8|3276.7] "%" Vector__XXX
 SG_ T_dc__Start m7 : 8|16@1+ (1,0) [0|65535] "ms" Vector__XXX
 SG_ Motor_V_N m6 : 8|16@1+ (1,0) [0|65535] "V" Vector__XXX
 SG_ Motor_F_N m5 : 8|16@1+ (0.1,0) [0|6553.5] "Hz" Vector__XXX
 SG_ Temp_DEBUG m154 : 8|16@1- (1,0) [-32768|32767] "" Vector__XXX
 SG_ Ptr_2_DEBUG m186 : 8|16@1- (1,0) [-32768|32767] "" Vector__XXX
 SG_ Ptr_1_DEBUG m184 : 8|16@1- (1,0) [-32768|32767] "" Vector__XXX
 SG_ M_outdig__Iq m160 : 8|16@1- (1,0) [-32768|32767] "" Vector__XXX
 SG_ Id_Ref m35 : 8|16@1- (0.13876843,0) [-4547.16391424|4547.02514581] "Arms" Vector__XXX
 SG_ CS_Ain_1_Format m54 : 8|2@1+ (1,0) [0|3] "" Vector__XXX
 SG_ I_red_TM m162 : 8|16@1+ (1,0) [0|32767] "" Vector__XXX
 SG_ I_red_TE m76 : 8|16@1+ (1,0) [0|32767] "" Vector__XXX
 SG_ I_red_TD m88 : 8|16@1+ (1,0) [0|32767] "" Vector__XXX
 SG_ I_red_N m60 : 8|16@1+ (0.003051851,0) [0|100] "%" Vector__XXX
 SG_ I_lim_dig m70 : 8|16@1- (0.003051851,0) [0|100] "%" Vector__XXX
 SG_ DOUT_4 m223 : 8|1@1+ (1,0) [0|1] "" Vector__XXX
 SG_ I_Fault m233 : 8|1@1+ (1,0) [0|1] "" Vector__XXX
 SG_ Rdy_BTB m226 : 8|1@1+ (1,0) [0|1] "" Vector__XXX
 SG_ DOUT_3 m222 : 8|1@1+ (1,0) [0|1] "" Vector__XXX
 SG_ DOUT_2 m225 : 8|1@1+ (1,0) [0|1] "" Vector__XXX
 SG_ DOUT_1 m224 : 8|1@1+ (1,0) [0|1] "" Vector__XXX
 SG_ RUN232 m232 : 8|1@1+ (1,0) [0|1] "" Vector__XXX
 SG_ DIN_2 m231 : 8|1@1+ (1,0) [0|1] "" Vector__XXX
 SG_ END_2 m229 : 8|1@1+ (1,0) [0|1] "" Vector__XXX
 SG_ DIN_1 m230 : 8|1@1+ (1,0) [0|1] "" Vector__XXX
 SG_ END_1 m228 : 8|1@1+ (1,0) [0|1] "" Vector__XXX
 SG_ Vdc_Bus_Filt m235 : 8|16@1+ (0.03166389465,0) [0|2075] "V" Vector__XXX
 SG_ T_Air m75 : 8|16@1- (1,0) [-32768|32767] "" Vector__XXX
 SG_ T_Igbt m74 : 8|16@1+ (1,0) [0|65535] "" Vector__XXX
 SG_ T_Motor m73 : 8|16@1+ (1,0) [0|65535] "" Vector__XXX
 SG_ Vout m138 : 8|16@1- (1,0) [-32768|32767] "" Vector__XXX
 SG_ Vd m42 : 8|16@1- (1,0) [-32768|32767] "" Vector__XXX
 SG_ Vq m41 : 8|16@1- (1,0) [-32768|32767] "" Vector__XXX
 SG_ I2_ADC m170 : 8|16@1+ (1,0) [0|65535] "Num" Vector__XXX
 SG_ I3_ADC m169 : 8|16@1+ (1,0) [0|65535] "Num" Vector__XXX
 SG_ I3_Actual m86 : 8|16@1- (0.196248196,0) [-6430.660886528|6430.464638332] "A" Vector__XXX
 SG_ I2_Actual m85 : 8|16@1- (0.196248196,0) [-6430.660886528|6430.464638332] "A" Vector__XXX
 SG_ I1_Actual m84 : 8|16@1- (0.196248196,0) [-6430.660886528|6430.464638332] "A" Vector__XXX
 SG_ Id_Error m57 : 8|16@1- (0.13876843,0) [-4547.16391424|4547.02514581] "Arms" Vector__XXX
 SG_ Iq_Error m56 : 8|16@1- (0.13876843,0) [-4547.16391424|4547.02514581] "Arms" Vector__XXX
 SG_ Id_Actual m40 : 8|16@1- (0.13876843,0) [-4547.16391424|4547.02514581] "Arms" Vector__XXX
 SG_ Iq_Actual m39 : 8|16@1- (0.13876843,0) [-4547.16391424|4547.02514581] "Arms" Vector__XXX
 SG_ I_Actual_Filt m95 : 8|16@1- (0.13876843,0) [-4547.16391424|4547.02514581] "Arms" Vector__XXX
 SG_ I_Actual m32 : 8|16@1- (0.13876843,0) [-4547.16391424|4547.02514581] "Arms" Vector__XXX
 SG_ I_cmd_ramp m34 : 8|16@1- (0.13876843,0) [-4547.16391424|4547.02514581] "Arms" Vector__XXX
 SG_ I_cmd m38 : 8|16@1- (0.13876843,0) [-4547.16391424|4547.02514581] "Arms" Vector__XXX
 SG_ I_Limit_Inuse m72 : 8|16@1- (0.13876843,0) [-4547.16391424|4547.02514581] "Arms" Vector__XXX
 SG_ I_nom_eff m78 : 8|16@1+ (0.1,0) [0|6553.5] "0,1" Vector__XXX
 SG_ I_max_eff m77 : 8|16@1+ (0.1,0) [0|3276.7] "Arms" Vector__XXX
 SG_ I_con_eff m197 : 8|16@1+ (0.00610388818,0) [0|100] "%" Vector__XXX
 SG_ I_max_pk m196 : 8|16@1+ (0.00610388818,0) [0|100] "%" Vector__XXX
 SG_ ID_setdig__Id m33 : 8|16@1- (0.37383776,0) [-12249.91571968|12249.54188192] "Arms" Vector__XXX
 SG_ M_setdig__Iq m144 : 8|16@1- (1,0) [-32768|32767] "" Vector__XXX
 SG_ N_Error m51 : 8|16@1- (0.2166814173,0) [-7100|7100] "Num" Vector__XXX
 SG_ N_Lim m52 : 8|16@1- (0.003051851,0) [-100|100] "%" Vector__XXX
 SG_ N_cmd_ramp m50 : 8|16@1- (0.2166814173,0) [-7100|7100] "Num" Vector__XXX
 SG_ N_cmd m93 : 8|16@1- (1,0) [-32768|32767] "Num" Vector__XXX
 SG_ N_setdig m49 : 8|16@1- (0.2166814173,0) [-7100|7100] "Num" Vector__XXX
 SG_ Nmax100perc m200 : 8|16@1- (1,0) [-32768|32767] "rpm" Vector__XXX
 SG_ Ain_in_2_raw m214 : 8|16@1- (1,0) [-32768|32767] "" Vector__XXX
 SG_ Ain_in_1_raw m213 : 8|16@1- (1,0) [-32768|32767] "" Vector__XXX
 SG_ LMT1 m216 : 8|1@1+ (1,0) [0|1] "" Vector__XXX
 SG_ Err_BadParas m143 : 8|1@1+ (1,0) [0|1] "" Vector__XXX
 SG_ Ena64 m64 : 8|1@1+ (1,0) [0|1] "" Vector__XXX
 SG_ DC_BUS_comp m90 : 8|1@1+ (1,0) [0|1] "" Vector__XXX
 SG_ I_200perc m217 : 8|16@1+ (1,0) [0|65535] "adc" Vector__XXX
 SG_ V_Shunt m238 : 8|16@1+ (1,0) [0|65535] "mV" Vector__XXX
 SG_ I_device m198 : 8|16@1+ (0.1,0) [0|6553.5] "A" Vector__XXX
 SG_ Axis m248 : 15|32@0+ (1,0) [0|0] "" Vector__XXX
 SG_ SNr m98 : 8|32@1+ (1,0) [0|4294967295] "" Vector__XXX
 SG_ DeviceType m103 : 8|8@1+ (1,0) [0|255] "" Vector__XXX
 SG_ Firmware m27 : 8|12@1+ (1,0) [0|4095] "" Vector__XXX
 SG_ N_Actual_Filt m168 : 8|16@1- (0.1098666341,0) [-3600.1098661888|3599.9999995547] "rpm" Vector__XXX
 SG_ N_R_Lim m199 : 8|16@1+ (1,0) [0|1000] "ms" Vector__XXX
 SG_ N_R_Dec m237 : 8|16@1+ (1,0) [0|30000] "ms" Vector__XXX
 SG_ N_Actual m48 : 8|16@1- (0.1098666341,0) [-3600|3599.9999995547] "Num" Vector__XXX
 SG_ Rcv_Mux M : 0|8@1+ (1,0) [0|0] "" Vector__XXX

CM_ SG_ 513 ReduceLosses "Automatic change to 4 kHz in case n < 10 Hz (No Derating)";
CM_ SG_ 513 DC_1Q3P "DC-1Quadrant, no high-side, bottom parallel";
CM_ SG_ 513 DC_1QMV "DC-1Quadrant, minimale Schaltverluste";
CM_ SG_ 513 block "Blockstrom bei ROT";
CM_ SG_ 513 DEAD_2 "deadband*2";
CM_ SG_ 513 DC_field "DC-Feldregler";
CM_ SG_ 513 DC_1QdirVolt "DC-1Quadrant, direkt pwm (Volt)";
CM_ SG_ 513 CMC__Bit31_24__free "Free (NOT INUSE)";
CM_ SG_ 513 delta "Motorphasen Dreieck";
CM_ SG_ 513 CMC__Bit23__TC_nCmdRestOption "Defines how the speed command ramp should be reset when TC triggers";
CM_ SG_ 513 NTC "IGBT NTC Temperature Sensor";
CM_ SG_ 513 DUP__Bit31_22__free "Bit 31_22 - free (NOT INUSE)";
CM_ SG_ 513 DUP__Bit21__InitWith_FRG_OFF "Initialize inverter with a set Software Lock";
CM_ SG_ 513 CMC__Bit22_21__TC_MinSpeed_conf "Definition of the minumim rpm Speed percentage to activate the TC (0perc, 10perc, 20perc, 30perc)";
CM_ SG_ 513 DUP__Bit20__HAL_Extmr_Acv "HAL Sensor Estimator Logic Activation";
CM_ SG_ 513 PWM_Freq "PWM Frequency define";
CM_ SG_ 513 CMC__Bit20_19__TC_DeltaTime_conf "Definition of the Delta Time rpm Speed Change supervision (20ms, 50ms, 100ms, 250ms)";
CM_ SG_ 513 AC_DC "AC or DC power supply";
CM_ SG_ 513 CMC__Bit18__TractionControl_Ena "Enable the special Traction Control Logic";
CM_ SG_ 513 MotBrake "Motor Brake";
CM_ SG_ 513 DUP__Bit19_17__ECODE_ReDefine "(Write Protected) External ECODE processing matrix reconfiguration";
CM_ SG_ 513 M_R_Dec "Torque Ramp Dec Time [0..4000 ms]";
CM_ SG_ 513 DUP__Bit16__Bamobil3_2_OffCrct "(Write Protected) Activation for the Offset Correction for older Bamobil 3.2 hardware setup";
CM_ SG_ 513 Ain_in_2_ScaleVal "Analog Input Signal 2 - Scale Value Setting";
CM_ SG_ 513 CMC__Bit17_16__CheckIPeak_config "Configuration of the I Peak supervision Limits";
CM_ SG_ 513 PID_I__Kf__Id "Feedforward - Proportional Gain Id-Current Controller";
CM_ SG_ 513 Bat_Opr_Limit__Gen "Idc or Pdc Limit during Generator operation";
CM_ SG_ 513 PID_I__xKp__Id "Proportional Gain Id-Current Controller if actual current is above I Limit Inuse Current - perc is depending on Kp value";
CM_ SG_ 513 M_R_Rcp "Torque Ramp Rcp Time [0..4000 ms]";
CM_ SG_ 513 DC_Bus_Max_Lim "DC Bus Max Value Superpision Limit";
CM_ SG_ 513 Regen_R "Regenerative Resistor Value";
CM_ SG_ 513 SRamp "S-Ramp N Command (Inactive)";
CM_ SG_ 513 M_R_Acc "Torque Ramp Acc Time [0..4000 ms]";
CM_ SG_ 513 Ain_in_1_ScaleVal "Analog Input Signal 1 - Scale Value Setting";
CM_ SG_ 513 PID_I__TiM__Id "Id-Current Control Integral Maximum Output Range";
CM_ SG_ 513 PID_I__Ti__Id "Integral Action Time (Integral Part) Id-Current Controller";
CM_ SG_ 513 PID_I__Kp__Id "Proportional Gain Id-Current Controller - A entry 33 equals 1.0 normalized";
CM_ SG_ 513 F_corner__Stop "Frequency at max output voltage - Stop";
CM_ SG_ 513 V_corner__Stop "Voltage (percentage of DC-Bus) at max. Frequency";
CM_ SG_ 513 F_min__Stop "Minimum Frequency (FU operation) at Stop";
CM_ SG_ 513 V_min__Stop "Minimum Voltage (FU operation) at Stop";
CM_ SG_ 513 Special__Stop "FU Special - Start";
CM_ SG_ 513 V_dc__Stop "DC-Voltage Value for DC-Braking";
CM_ SG_ 513 T_dc__Stop "DC Current Time";
CM_ SG_ 513 DUP__Bit15__CANopen_Acv "(Write Protected) Use CANopen instead of normal CAN protocol for the CAN communication";
CM_ SG_ 513 CMC__Bit15__Dig_E_Brake_Act "Activate automated digital Recuperation Command";
CM_ SG_ 513 MO_sc2_inv "Motor Options -";
CM_ SG_ 513 LowBd "Low Baud rate of 9600 (serial)";
CM_ SG_ 513 KM_DEBUG_TEST "Kern Mode State Bit -";
CM_ SG_ 513 CS_Ain_1__N_Limit "Command Source Mask - Analog 1 N Limit Bit";
CM_ SG_ 513 DUP__Bit14__MTPA_reluct_enab "Enable MTPA calculation and automatic command of Id_ref";
CM_ SG_ 513 CMC__Bit14__Idc_Limit_Ena_V2 "Enable the Limitiation Calculation depending on the DC Current limits V2";
CM_ SG_ 513 Ana_0up "Messbereich DC-Bus,1 (0..5 V), 0 (2,5..5 V)";
CM_ SG_ 513 KM_PSEUDO_ENABLE "Kern Mode State Bit -";
CM_ SG_ 513 CS_Ain_2__I_Limit "Command Source Mask - Analog 2 I Limit Status Bit";
CM_ SG_ 513 DUP__Bit13__Gen_AutoIacLimit "Special Generator Mode with automatic Iac limit reduction";
CM_ SG_ 513 KM_rsvd_13 "Kern Mode State Bit - rsvd_13";
CM_ SG_ 513 DUP__Bit12__Boat_Pedal "Command (Acc Pedal) must be at 0 to enable inverter";
CM_ SG_ 513 MO_sc2_reso "Motor Options -";
CM_ SG_ 513 MotorType "Motor Type define";
CM_ SG_ 513 KM_rsvd_12 "Kern Mode State Bit - rsvd_12";
CM_ SG_ 513 CS_CMD_Type "Command Source Mask - Bitmask Coding of Command Type";
CM_ SG_ 513 DUP__Bit11__DCBus_Volts "DCBus Value as V for output Communication";
CM_ SG_ 513 MO_sc1_comp "Motor Options -";
CM_ SG_ 513 OL_comp "Over Loop current limit or slip compensation Enable";
CM_ SG_ 513 KM_rsvd_11 "Kern Mode State Bit - rsvd_11";
CM_ SG_ 513 DUP__Bit10__PARK_RMS "Set factor 1divsqrt(2) in park currents";
CM_ SG_ 513 H2inv "Inverted Hall 2";
CM_ SG_ 513 KM_PHASING_EXTEND "Kern Mode State Bit -";
CM_ SG_ 513 DUP__Bit9__GENERATOR "Special DC Bus generator operation";
CM_ SG_ 513 Hxinv "Inverted order of Hall sensors";
CM_ SG_ 513 KM_HANDWHEEL "Kern Mode State Bit -";
CM_ SG_ 513 DUP__Bit8__CAN_EXTENDED_0 "CAN PDOs extension";
CM_ SG_ 513 Source_ID219 "Signal Source ID for the compare operation according to RegID Address";
CM_ SG_ 513 Source_ID218 "Signal Source ID for the compare operation according to RegID Address";
CM_ SG_ 513 Source_ID195 "Signal Source ID for the compare operation according to RegID Address";
CM_ SG_ 513 Source_ID194 "Signal Source ID for the compare operation according to RegID Address";
CM_ SG_ 513 MO_sc1_reso "Motor Options -";
CM_ SG_ 513 Ain_in_2_Filter "Analog Input Signal 2 - Filter Value Setting";
CM_ SG_ 513 I1_Adc_Ena "Current Measurement I1 Enable";
CM_ SG_ 513 KM_ALLOW_SYNC "Kern Mode State Bit - Allow Sync";
CM_ SG_ 513 CS_Ain_2_Mode "Command Source Mask - Analog 2 Mode Bits";
CM_ SG_ 513 CMC__Bit13_7__free "Free (NOT INUSE)";
CM_ SG_ 513 Vdc_Ana "Analogue DC-Bus measurement";
CM_ SG_ 513 KM_MIX_ANA_ON "Kern Mode State Bit -";
CM_ SG_ 513 CMC__Bit6__TorqueTimeOut_100ms_E "Set Torque command to 0 if no new external torque command input within 100 ms is registered";
CM_ SG_ 513 No_UESP_BTB "BTB nicht mit Powervoltage Ãœberwachung verknÃ¼pft";
CM_ SG_ 513 KM_N_CLIP "Kern Mode State Bit -";
CM_ SG_ 513 CMC__Bit5__Reset_NRamp_AtNZero "Speed Ramp Reset to 0 if actual speed crosses 0 rpm";
CM_ SG_ 513 MO_Feedback_2 "Motor Options - Feedback 2 Type";
CM_ SG_ 513 KM_I_LIMIT "Kern Mode State Bit -";
CM_ SG_ 513 CMC__Bit4__Dig_M_RcpRamp_Ena "Enable the use of Recuperation Ramps during Torque Mode";
CM_ SG_ 513 Compare_Var219 "Arrangement Variable Selection List for digital Output 4";
CM_ SG_ 513 Compare_Var218 "Arrangement Variable Selection List for digital Output 3";
CM_ SG_ 513 Compare_Var195 "Arrangement Variable Selection List for digital Output 2";
CM_ SG_ 513 Compare_Var194 "Arrangement Variable Selection List for digital Output 1";
CM_ SG_ 513 I_ist_Inverse "Current Measurement Inverse";
CM_ SG_ 513 KM_TX_TOG_STAT "Kern Mode State Bit -";
CM_ SG_ 513 CS_Ain_1_Mode "Command Source Mask - Analog 1 Mode Bits";
CM_ SG_ 513 CMC__Bit3__TorqueVal_Init_Ena "Enable Init as Torque Mode after Enable (Run)";
CM_ SG_ 513 CoastStop "Coast Stop Activation";
CM_ SG_ 513 KM_CAL_OFF "Kern Mode State Bit -";
CM_ SG_ 513 CMC__Bit2__Pdc_Limit_Usage "Use the DC current Limitiation Calculation depending on the DC Power limits";
CM_ SG_ 513 FB_Special "Feedback Speciality";
CM_ SG_ 513 KM_FRG_OFF "Kern Mode State Bit -";
CM_ SG_ 513 CS_Ain_2_Format "Command Source Mask - Analog 2 Format Bits";
CM_ SG_ 513 CMC__Bit1__Idc_Limit_Ena "Enable the Limitiation Calculation depending on the DC Current limits";
CM_ SG_ 513 Ballast_Ext "Ballast-R extern";
CM_ SG_ 513 KM_SPEED_0 "Kern Mode State Bit -";
CM_ SG_ 513 Axis "Inverter 4 Letter Name define";
CM_ SG_ 513 Brake_Delay "Mechanical Brake Delay Time (e.g. Relay)";
CM_ SG_ 513 T_peak "Allowed Timing for Peak Current";
CM_ SG_ 513 V_Shunt "Current Sensor rated voltage";
CM_ SG_ 513 N_R_Dec "Speed Ramp Dec Time [0..30000 ms]";
CM_ SG_ 513 DUP__Bit7_0__DAC_Source_Channel "DAC Configuration of the RegID Source Channel as Output";
CM_ SG_ 513 Ain_in_2_OffsetVal "Analog Input Signal 2 - Offset Value Setting";
CM_ SG_ 513 Var_4 "Comparison Variable 4";
CM_ SG_ 513 Var_3 "Comparison Variable 3";
CM_ SG_ 513 Var_2 "Comparison Variable 2";
CM_ SG_ 513 Var_1 "Comparison Variable 1";
CM_ SG_ 513 Can_RxTimeout "CAN Timeout time settings";
CM_ SG_ 513 CMC__Bit0__DC_Current_Sens_Ena "Enable the use of the DC current Sensor (if present)";
CM_ SG_ 513 PID_I__Kf__Iq "Feedforward - Proportional Gain Iq-Current Controller";
CM_ SG_ 513 Bat_Opr_Limit__Mot "Idc or Pdc Limit during Motor operation";
CM_ SG_ 513 PID_I__xKp__Iq "Proportional Gain Iq-Current Controller if actual current is above I Limit Inuse Current - perc is depending on Kp value";
CM_ SG_ 513 Nmax100perc "Maximum Speed Value for Resolution of 16Bit";
CM_ SG_ 513 N_R_Lim "Emergency Stopping Ramp Time [0..1000 ms]";
CM_ SG_ 513 I_device "Set device define for continuous current";
CM_ SG_ 513 I_con_eff "Continuous Device Current (Arms) settings via percentage entry - Percentage as 13 Bit entry format (16383 is equal 100perc)";
CM_ SG_ 513 I_max_pk "Max. Device Current (A) settings via percentage entry - Percentage as 13 Bit entry format (16383 equal 100perc)";
CM_ SG_ 513 Operand219 "Selection List Operant for digital Output OUT 4";
CM_ SG_ 513 Operand218 "Selection List Operant for digital Output OUT 3";
CM_ SG_ 513 Operand195 "Selection List Operant for digital Output OUT 2";
CM_ SG_ 513 Operand194 "Selection List Operant for digital Output OUT 1";
CM_ SG_ 513 def_DIN_2 "Definition - Function attribution of the Digital Input - DIN 2";
CM_ SG_ 513 def_DIN_1 "Definition - Function attribution of the Digital Input - DIN 1";
CM_ SG_ 513 def_END_2 "Definition - Function attribution of the Digital Input - END 2 (Limit 2)";
CM_ SG_ 513 def_END_1 "Definition - Function attribution of the Digital Input - END 1 (Limit 1)";
CM_ SG_ 513 Motor_Ts "Stator Time Contant of the Motor";
CM_ SG_ 513 Motor_Rs "Motor - Stator Resistance Value";
CM_ SG_ 513 Motor_Lsd "Motor Leakage Inductance ph-ph - Lsd";
CM_ SG_ 513 Motor_Tr "Rotor Time Contant of the Motor";
CM_ SG_ 513 Id_Min "Minimum Magnetising d-Current value as perc of nominal current";
CM_ SG_ 513 Motor_Rr "Motor - Rotor Resistance Value";
CM_ SG_ 513 Motor_Lm "Motor - Magnetizing Inductance - L";
CM_ SG_ 513 Id_Nom "Nominal Magnetising d-Current value as perc of nominal current";
CM_ SG_ 513 Motor_Lsq "Motor - Stator Leakage Inductance - Lsq";
CM_ SG_ 513 FB_Pole "Feedback Pole number";
CM_ SG_ 513 FB_Incr_Mot "Feedback System Increments per rotation";
CM_ SG_ 513 DC_Bus_Min_Lim "DC Bus Min Value Superpision Limit";
CM_ SG_ 513 MO_Feedback_1 "Motor Options - Feedback 1 Type";
CM_ SG_ 513 M_Temp "Motor Temperature Limit for Inverter Error shutdown";
CM_ SG_ 513 I_red_TM "Current reduction by motor temperature";
CM_ SG_ 513 M_setdig__Iq "Digital numerical Iq-Current Command - input";
CM_ SG_ 513 Clear_Errors "Clear Errors. Just send a value of 0 to this ID Address";
CM_ SG_ 513 V_Ti "Integral Action Time (Integral Part) Voltage Controller (0.0001 x Ti equals 1.0)";
CM_ SG_ 513 V_Kp "Proportional Gain Voltage Controller (0.0001 * Ti equals 1.0)";
CM_ SG_ 513 V_Ref "Voltage Controller Reference value in perc of Vout (V_Red - Start of Field Reduction)";
CM_ SG_ 513 CAN_ID_2_Tx "CAN Identiciation ID - 2 - for Transmit - Tx";
CM_ SG_ 513 CAN_ID_2_Rx "CAN Identiciation ID - 2 - for Receive - Rx";
CM_ SG_ 513 Fun_Special "Special Functions for automatic logics or calculations";
CM_ SG_ 513 Pos_Diff_Slack "Position Difference Slack Value";
CM_ SG_ 513 Pos_Offset_Slack "Position Offset Slack Value";
CM_ SG_ 513 FB2_Scale_Ext "Feedback 2 - External Scale Factor";
CM_ SG_ 513 Pos_ND_Offset "NDrive Position Display Offset Factor";
CM_ SG_ 513 Pos_ND_Scale "NDrive Position Display Scale Factor";
CM_ SG_ 513 Pos_Preset_Val "Numeric Preset Position Value (Set actual Position to Preset Position)";
CM_ SG_ 513 Pos_Tol_Win "Tolerance Window for Destination Position";
CM_ SG_ 513 Speed_2 "Position Reference Speed 1 (Slow) + Phasing electrical Rotation Speed";
CM_ SG_ 513 Speed_1 "Position Reference Speed 1 (Fast)";
CM_ SG_ 513 Ref_Reso_Edge "Resolver Position at Reference Switch (Rsw)";
CM_ SG_ 513 CAN_NBT "CAN BaudRate Configuration Setting";
CM_ SG_ 513 Pos_OffsRef "Numeric Position Zero Offset Value";
CM_ SG_ 513 Pos_TiM "Position Control Integral Maximum Output Range";
CM_ SG_ 513 Pos_Dest "Numeric Destination Position Value";
CM_ SG_ 513 Pos_Td "Derative Action Time (Derative Part) Position Controller";
CM_ SG_ 513 Pos_Ti "Integral Action Time (Integral Part) Position Controller";
CM_ SG_ 513 Pos_Kp "Proportional Gain Position Controller";
CM_ SG_ 513 CAN_ID_Tx "CAN Identiciation ID for Transmit - Tx";
CM_ SG_ 513 CAN_ID_Rx "CAN Identiciation ID for Receive - Rx";
CM_ SG_ 513 DeviceType "Coding Signal defining various device types";
CM_ SG_ 513 Regen_P "Regenerative Resistor Power Value";
CM_ SG_ 513 Device_Mains "Device Mains Supply Voltage Value";
CM_ SG_ 513 SNr "Device Serial Number";
CM_ SG_ 513 Ain_in_1_Filter "Analog Input Signal 1 - Filter Value Setting";
CM_ SG_ 513 Speed_Filter "Additional Filter Adjustment of the Rotation Speed Measurement";
CM_ SG_ 513 PID_n__Kacc "Speed Control Acceleration Feed Foreward Gain";
CM_ SG_ 513 DC_BUS_comp "Analoge Zwischenkreismessung geht in Uout ein";
CM_ SG_ 513 n_Nom "Motor Nominal Rotation Speed";
CM_ SG_ 513 I_red_TD "Start of current reduction by power stage temperature";
CM_ SG_ 513 Ain_in_2_Cutoff "Analog Input Signal 2 - Cutoff Value Setting";
CM_ SG_ 513 KM_rsvd_0 "Kern Mode State Bit - rsvd_0";
CM_ SG_ 513 Ain_in_1_Cutoff "Analog Input Signal 1 - Cutoff Value Setting";
CM_ SG_ 513 Motor_Pole "Motor Pole Number";
CM_ SG_ 513 I_nom_eff "Motor Nominal Effective Current";
CM_ SG_ 513 I_max_eff "Motor Maximum Effective Peak Current";
CM_ SG_ 513 I_red_TE "Stop of current reduction by power stage temperature";
CM_ SG_ 513 I_lim_dig "Derating Reduction to percentage Value - Trigger is Dig Input - Percentage as 15 Bit entry format (32767 equal 100perc)";
CM_ SG_ 513 Read_ID "Global ID for Read Command 0x3D in Get_Value";
CM_ SG_ 513 FB_Offset "FeedBack Offset Angle Value";
CM_ SG_ 513 N_Lim_plus "Speed n Limit plus - Percentage as 15 Bit entry format (32767 equal 100perc)";
CM_ SG_ 513 N_Lim_minus "Speed n Limit minus - Percentage as 15 Bit entry format (-32767 equal -100perc)";
CM_ SG_ 513 I_red_N "Current reduction by rotation speed - Percentage as 15 Bit entry format (32767 equal 100perc)";
CM_ SG_ 513 PID_n__TiM "Speed Control Integral Maximum Output Range";
CM_ SG_ 513 CS_Ain_1_Format "Command Source Mask - Analog 1 Format Bits";
CM_ SG_ 513 N_R_Acc "Speed Ramp Acc Time [0..30000 ms]";
CM_ SG_ 513 N_Lim "Speed n Limit - Percentage as 15 Bit entry format (32767 equal 100perc)";
CM_ SG_ 513 N_setdig "Digital numerical Speed Command - input";
CM_ SG_ 513 Ain_in_1_OffsetVal "Analog Input Signal 1 - Offset Value Setting";
CM_ SG_ 513 PID_n__Td "Derative Action Time (Derative Part) Speed Controller";
CM_ SG_ 513 PID_n__Ti "Integral Action Time (Integral Part) Speed Controller";
CM_ SG_ 513 PID_n__Kp "Proportional Gain Speed Controller";
CM_ SG_ 513 PID_I__TiM__Iq "Iq-Current Control Integral Maximum Output Range";
CM_ SG_ 513 I_Delta_Ramp "Final Current Ramp Step setting";
CM_ SG_ 513 ID_setdig__Id "Digital numerical Id-Current Command - input";
CM_ SG_ 513 Cutoffdig "Digital Cutoff area of incomming digital commands";
CM_ SG_ 513 PID_I__Ti__Iq "Integral Action Time (Integral Part) Iq-Current Controller";
CM_ SG_ 513 PID_I__Kp__Iq "Proportional Gain Iq-Current Controller - A entry 33 equals 1.0 normalized";
CM_ SG_ 513 Calib_Ref_Value "Entry for the Reference Value used for various Calibrations";
CM_ SG_ 513 Oszi_Run_cmd "NDrive Oszillloscop - Run Command";
CM_ SG_ 513 Oszi_Read_cmd "NDrive Oszillloscop - Read Command";
CM_ SG_ 513 Oszi_Skip "NDrive Oszillloscop - Capture Skip";
CM_ SG_ 513 Oszi_Source "NDrive Oszillloscop - Capture Source";
CM_ SG_ 513 Trig_Source "NDrive Oszillloscop - Capture Trigger Source";
CM_ SG_ 513 Trig_Edge "NDrive Oszillloscop - Capture Trigger Level";
CM_ SG_ 513 Trig_Level "NDrive Oszillloscop - Capture Trigger Edge";
CM_ SG_ 513 Capture_Channel "NDrive Oszillloscop - Capture Channel";
CM_ SG_ 513 Extra__Start "FU Extra - Start";
CM_ SG_ 513 Cos_Phi "Motor Power Factor";
CM_ SG_ 513 F_corner__Start "Frequency at max output voltage - Start";
CM_ SG_ 513 V_corner__Start "Voltage (percentage of DC-Bus) at max. Frequency";
CM_ SG_ 513 F_min__Start "Minimum Frequency (FU operation) at Start";
CM_ SG_ 513 V_min__Start "Minimum Voltage (FU operation) at Start";
CM_ SG_ 513 Special__Start "FU Special - Start";
CM_ SG_ 513 V_dc__Start "DC Voltage for Pre-Magnitization - Start";
CM_ SG_ 513 T_dc__Start "Time For DC Pre-Charge-Magnitising - Start";
CM_ SG_ 513 Motor_F_N "Nominal Motor Frequency";
CM_ SG_ 385 HndWhl82 "Hand-wheel function selected";
CM_ SG_ 385 Warn_Ballast "Ballast circuit > 87 % overloaded";
CM_ SG_ 385 HndWhl64 "Hand-wheel function selected";
CM_ SG_ 385 ReduceLosses "Automatic change to 4 kHz in case n < 10 Hz (No Derating)";
CM_ SG_ 385 MD82 "free";
CM_ SG_ 385 MD64 "free";
CM_ SG_ 385 DC_1Q3P "DC-1Quadrant, no high-side, bottom parallel";
CM_ SG_ 385 RFEpulse82 "Pulsed RFE-input monitoring active";
CM_ SG_ 385 RFEpulse64 "Pulsed RFE-input monitoring active";
CM_ SG_ 385 DC_1QMV "DC-1Quadrant, minimale Schaltverluste";
CM_ SG_ 385 Iwcns82 "Current peak value warning";
CM_ SG_ 385 Iwcns64 "Current peak value warning";
CM_ SG_ 385 block "Blockstrom bei ROT";
CM_ SG_ 385 IrdANA82 "Current derating due to analog input (if = 90 %) possible";
CM_ SG_ 385 IrdANA64 "Current derating due to analog input (if = 90 %) possible";
CM_ SG_ 385 DEAD_2 "deadband*2";
CM_ SG_ 385 IrdTM82 "Derating Triggered - Current limited by motor temperature Limit";
CM_ SG_ 385 Warn_RaceAway "Resolution range of the speed measurement exceeded";
CM_ SG_ 385 IrdTM64 "Derating Triggered - Current limited by motor temperature Limit";
CM_ SG_ 385 DC_field "DC-Feldregler";
CM_ SG_ 385 _10Hz82 "Additional current limit if frequency less than 10 Hz";
CM_ SG_ 385 Warn_IPeak "Overcurrent 200 %";
CM_ SG_ 385 _10Hz64 "Additional current limit if frequency less than 10 Hz";
CM_ SG_ 385 DC_1QdirVolt "DC-1Quadrant, direkt pwm (Volt)";
CM_ SG_ 385 CMC__Bit31_24__free "Free (NOT INUSE)";
CM_ SG_ 385 IrdTIR82 "Derating Triggered - Current limited by igbt temperature Limit";
CM_ SG_ 385 Warn_Vout_Sat "Limit of the existing voltage output is reached";
CM_ SG_ 385 IrdTIR64 "Derating Triggered - Current limited by igbt temperature Limit";
CM_ SG_ 385 delta "Motorphasen Dreieck";
CM_ SG_ 385 M_R_Acc "Torque Ramp Acc Time [0..4000 ms]";
CM_ SG_ 385 CMC__Bit23__TC_nCmdRestOption "Defines how the speed command ramp should be reset when TC triggers";
CM_ SG_ 385 IrdTi82 "Derating Configured - Current limited by igbt temperature Limit";
CM_ SG_ 385 Warn_DeviceTemp "Device temperature > 87 % of limit";
CM_ SG_ 385 IrdTi64 "Derating Configured - Current limited by igbt temperature Limit";
CM_ SG_ 385 NTC "IGBT NTC Temperature Sensor";
CM_ SG_ 385 DUP__Bit31_22__free "Bit 31_22 - free (NOT INUSE)";
CM_ SG_ 385 IrdN82 "Derating Triggered - Current limited by speed Limit";
CM_ SG_ 385 Warn_MotorTemp "Motor temperature > (I-red-TM or 93 % from M-Temp)";
CM_ SG_ 385 IrdN64 "Derating Triggered - Current limited by speed Limit";
CM_ SG_ 385 DUP__Bit21__InitWith_FRG_OFF "Initialize inverter with a set Software Lock";
CM_ SG_ 385 CMC__Bit22_21__TC_MinSpeed_conf "Definition of the minumim rpm Speed percentage to activate the TC (0perc, 10perc, 20perc, 30perc)";
CM_ SG_ 385 Iuserchd82 "Actual current limit reached";
CM_ SG_ 385 Iuserchd64 "Actual current limit reached";
CM_ SG_ 385 DUP__Bit20__HAL_Extmr_Acv "HAL Sensor Estimator Logic Activation";
CM_ SG_ 385 IrdDig82 "Current limiting (switchable) reached";
CM_ SG_ 385 IrdDig64 "Current limiting (switchable) reached";
CM_ SG_ 385 PWM_Freq "PWM Frequency define";
CM_ SG_ 385 CMC__Bit20_19__TC_DeltaTime_conf "Definition of the Delta Time rpm Speed Change supervision (20ms, 50ms, 100ms, 250ms)";
CM_ SG_ 385 Nclip_plus82 "Additional switchable positive speed limiting possible";
CM_ SG_ 385 Nclip_plus64 "Additional switchable positive speed limiting possible";
CM_ SG_ 385 AC_DC "AC or DC power supply";
CM_ SG_ 385 CMC__Bit18__TractionControl_Ena "Enable the special Traction Control Logic";
CM_ SG_ 385 Nclip_minus82 "Additional switchable negative speed limiting possible";
CM_ SG_ 385 Warn_Safe_In "RFE input inactive (active without RUN input)";
CM_ SG_ 385 Nclip_minus64 "Additional switchable negative speed limiting possible";
CM_ SG_ 385 MotBrake "Motor Brake";
CM_ SG_ 385 DUP__Bit19_17__ECODE_ReDefine "(Write Protected) External ECODE processing matrix reconfiguration";
CM_ SG_ 385 Nclip82 "General speed limiting (if = 90 %) possible";
CM_ SG_ 385 Warn_Illegal_Status "RUN signal disturbed, EMI";
CM_ SG_ 385 Nclip64 "General speed limiting (if = 90 %) possible";
CM_ SG_ 385 SVNRevision_Nr "Firmware SVN Revision Number";
CM_ SG_ 385 free "free";
CM_ SG_ 385 Special__Stop "FU Special - Start";
CM_ SG_ 385 DUP__Bit16__Bamobil3_2_OffCrct "(Write Protected) Activation for the Offset Correction for older Bamobil 3.2 hardware setup";
CM_ SG_ 385 CMC__Bit17_16__CheckIPeak_config "Configuration of the I Peak supervision Limits";
CM_ SG_ 385 PID_I__Kf__Id "Feedforward - Proportional Gain Id-Current Controller";
CM_ SG_ 385 Bat_Opr_Limit__Gen "Idc or Pdc Limit during Generator operation";
CM_ SG_ 385 PID_I__xKp__Id "Proportional Gain Id-Current Controller if actual current is above I Limit Inuse Current - perc is depending on Kp value";
CM_ SG_ 385 DC_Bus_Max_Lim "DC Bus Max Value Superpision Limit";
CM_ SG_ 385 Regen_R "Regenerative Resistor Value";
CM_ SG_ 385 SignMag82 "Speed internally inverted";
CM_ SG_ 385 Ain_in_2_ScaleVal "Analog Input Signal 2 - Scale Value Setting";
CM_ SG_ 385 Ain_in_1_ScaleVal "Analog Input Signal 1 - Scale Value Setting";
CM_ SG_ 385 PID_I__TiM__Id "Id-Current Control Integral Maximum Output Range";
CM_ SG_ 385 PID_I__Ti__Id "Integral Action Time (Integral Part) Id-Current Controller";
CM_ SG_ 385 PID_I__Kp__Id "Proportional Gain Id-Current Controller - A entry 33 equals 1.0 normalized";
CM_ SG_ 385 F_corner__Stop "Frequency at max output voltage - Stop";
CM_ SG_ 385 V_corner__Stop "Voltage (percentage of DC-Bus) at max. Frequency";
CM_ SG_ 385 F_min__Stop "Minimum Frequency (FU operation) at Stop";
CM_ SG_ 385 V_min__Stop "Minimum Voltage (FU operation) at Stop";
CM_ SG_ 385 V_dc__Stop "DC-Voltage Value for DC-Braking";
CM_ SG_ 385 T_dc__Stop "DC Current Time";
CM_ SG_ 385 Ain_in_2_scaled214 "Analog Input Signal 2 - Scaled";
CM_ SG_ 385 Ain_in_1_scaled213 "Analog Input Signal 1 - Scaled";
CM_ SG_ 385 Warn_Warning_0 "No device identification";
CM_ SG_ 385 SignMag64 "Speed internally inverted";
CM_ SG_ 385 SRamp "S-Ramp N Command (Inactive)";
CM_ SG_ 385 M_R_Rcp "Torque Ramp Rcp Time [0..4000 ms]";
CM_ SG_ 385 M_R_Dec "Torque Ramp Dec Time [0..4000 ms]";
CM_ SG_ 385 DUP__Bit15__CANopen_Acv "(Write Protected) Use CANopen instead of normal CAN protocol for the CAN communication";
CM_ SG_ 385 CMC__Bit15__Dig_E_Brake_Act "Activate automated digital Recuperation Command";
CM_ SG_ 385 Gen_AutoIacLimit_is_Acv "Automatic Iac Lmiting in generator mode is active";
CM_ SG_ 385 MO_sc2_inv "Motor Options -";
CM_ SG_ 385 Ecode_Bit15__T_IGBT148 "Ecode - Bit 15 - T Igbt error (digital)";
CM_ SG_ 385 Ecode_Bit15__T_IGBT99 "Ecode - Bit 15 - T Igbt error (digital)";
CM_ SG_ 385 Brk082 "De-energized brake with motor active";
CM_ SG_ 385 KM_DEBUG_TEST "Kern Mode State Bit -";
CM_ SG_ 385 CS_Ain_1__N_Limit "Command Source Mask - Analog 1 N Limit Bit";
CM_ SG_ 385 BRK1216 "Excited Brake";
CM_ SG_ 385 Err_Ballast "Ballast circuit overloaded";
CM_ SG_ 385 Brk064 "De-energized brake with motor active";
CM_ SG_ 385 LowBd "Low Baud rate of 9600 (serial)";
CM_ SG_ 385 DUP__Bit14__MTPA_reluct_enab "Enable MTPA calculation and automatic command of Id_ref";
CM_ SG_ 385 CMC__Bit14__Idc_Limit_Ena_V2 "Enable the Limitiation Calculation depending on the DC Current limits V2";
CM_ SG_ 385 Ecode_Bit14__UBMAm148 "Ecode - Bit 14 - UBMA overvoltage error (digital)";
CM_ SG_ 385 Ecode_Bit14__UBMAm99 "Ecode - Bit 14 - UBMA overvoltage error (digital)";
CM_ SG_ 385 Rdy82 "Drive is ready (BTB/TDY contact is closed)";
CM_ SG_ 385 KM_PSEUDO_ENABLE "Kern Mode State Bit -";
CM_ SG_ 385 CS_Ain_2__I_Limit "Command Source Mask - Analog 2 I Limit Status Bit";
CM_ SG_ 385 Err_HWErr "Current - measurement error";
CM_ SG_ 385 Rdy64 "Drive is ready (BTB/TDY contact is closed)";
CM_ SG_ 385 Ana_0up "Messbereich DC-Bus,1 (0..5 V), 0 (2,5..5 V)";
CM_ SG_ 385 DUP__Bit13__Gen_AutoIacLimit "Special Generator Mode with automatic Iac limit reduction";
CM_ SG_ 385 Ecode_Bit13__18m_plus148 "Ecode - Bit 13 - 18V plus Voltage error";
CM_ SG_ 385 Ecode_Bit13__18m_plus99 "Ecode - Bit 13 - 18V plus Voltage error";
CM_ SG_ 385 Tol82 "Position within tolerance window";
CM_ SG_ 385 KM_rsvd_13 "Kern Mode State Bit - rsvd_13";
CM_ SG_ 385 OUT4 "Digital output Dout 4 on";
CM_ SG_ 385 Tol64 "Position within tolerance window";
CM_ SG_ 385 DUP__Bit12__Boat_Pedal "Command (Acc Pedal) must be at 0 to enable inverter";
CM_ SG_ 385 MO_sc2_reso "Motor Options -";
CM_ SG_ 385 Ecode_Bit12__15m_plus148 "Ecode - Bit 12 - 15V plus Voltage error";
CM_ SG_ 385 Ecode_Bit12__15m_plus99 "Ecode - Bit 12 - 15V plus Voltage error";
CM_ SG_ 385 Cal82 "Calibration move completed (position calibrated)";
CM_ SG_ 385 KM_rsvd_12 "Kern Mode State Bit - rsvd_12";
CM_ SG_ 385 CurrentMode "Active Control Current Mode Mask";
CM_ SG_ 385 CS_CMD_Type "Command Source Mask - Bitmask Coding of Command Type";
CM_ SG_ 385 OUT3 "Digital output Dout 3 on";
CM_ SG_ 385 Cal64 "Calibration move completed (position calibrated)";
CM_ SG_ 385 MotorType "Motor Type define";
CM_ SG_ 385 Test "Firmware Test Number";
CM_ SG_ 385 DUP__Bit11__DCBus_Volts "DCBus Value as V for output Communication";
CM_ SG_ 385 MO_sc1_comp "Motor Options -";
CM_ SG_ 385 Ecode_Bit11__15m_minus148 "Ecode - Bit 11 - 15V minus Voltage error";
CM_ SG_ 385 Ecode_Bit11__15m_minus99 "Ecode - Bit 11 - 15V minus Voltage error";
CM_ SG_ 385 Cal082 "Calibration move active";
CM_ SG_ 385 KM_rsvd_11 "Kern Mode State Bit - rsvd_11";
CM_ SG_ 385 GO216 "Internal enable GO active";
CM_ SG_ 385 Err_USER "User - choice of Error";
CM_ SG_ 385 Cal064 "Calibration move active";
CM_ SG_ 385 OL_comp "Over Loop current limit or slip compensation Enable";
CM_ SG_ 385 DUP__Bit10__PARK_RMS "Set factor 1divsqrt(2) in park currents";
CM_ SG_ 385 Ecode_Bit10__VCCm148 "Ecode - Bit 10 - VCC Voltage error";
CM_ SG_ 385 Ecode_Bit10__VCCm99 "Ecode - Bit 10 - VCC Voltage error";
CM_ SG_ 385 Rsw82 "Reference switch tripped";
CM_ SG_ 385 KM_PHASING_EXTEND "Kern Mode State Bit -";
CM_ SG_ 385 BTBRdy "Hardware relay, output BTB (Rdy) on";
CM_ SG_ 385 Err_RaceAway "Drive races (without command value, wrong direction)";
CM_ SG_ 385 Rsw64 "Reference switch tripped";
CM_ SG_ 385 H2inv "Inverted Hall 2";
CM_ SG_ 385 DUP__Bit9__GENERATOR "Special DC Bus generator operation";
CM_ SG_ 385 Ecode_Bit9__FAIL_I148 "Ecode - Bit 9 - I Error detected";
CM_ SG_ 385 Ecode_Bit9__FAIL_I99 "Ecode - Bit 9 - I Error detected";
CM_ SG_ 385 _N082 "Acutal speed less than 0.1% (standstill)";
CM_ SG_ 385 KM_HANDWHEEL "Kern Mode State Bit -";
CM_ SG_ 385 OUT2 "Digital output Dout 2 on";
CM_ SG_ 385 Err_IPeak "Overcurrent or strongly oscillating current detected";
CM_ SG_ 385 _N064 "Acutal speed less than 0.1% (standstill)";
CM_ SG_ 385 Hxinv "Inverted order of Hall sensors";
CM_ SG_ 385 DUP__Bit8__CAN_EXTENDED_0 "CAN PDOs extension";
CM_ SG_ 385 Source_ID219 "Signal Source ID for the compare operation according to RegID Address";
CM_ SG_ 385 Source_ID218 "Signal Source ID for the compare operation according to RegID Address";
CM_ SG_ 385 Source_ID195 "Signal Source ID for the compare operation according to RegID Address";
CM_ SG_ 385 Source_ID194 "Signal Source ID for the compare operation according to RegID Address";
CM_ SG_ 385 MO_sc1_reso "Motor Options -";
CM_ SG_ 385 Ecode_Bit8__FAIL_IDC148 "Ecode - Bit 1 - Idc Error detected";
CM_ SG_ 385 Ecode_Bit8__FAIL_IDC99 "Ecode - Bit 1 - Idc Error detected";
CM_ SG_ 385 Ain_in_2_Filter "Analog Input Signal 2 - Filter Value Setting";
CM_ SG_ 385 NI82 "Speed control possible";
CM_ SG_ 385 KM_ALLOW_SYNC "Kern Mode State Bit - Allow Sync";
CM_ SG_ 385 CtrlSubMode "Active SubControl Mode Mask";
CM_ SG_ 385 CS_Ain_2_Mode "Command Source Mask - Analog 2 Mode Bits";
CM_ SG_ 385 OUT1 "Digital output Dout 1 on";
CM_ SG_ 385 Err_OverVoltage "Overvoltage > 1.8 x UN reached";
CM_ SG_ 385 NI64 "Speed control possible";
CM_ SG_ 385 I1_Adc_Ena "Current Measurement I1 Enable";
CM_ SG_ 385 brk1155 "Output Signal - break 1";
CM_ SG_ 385 CMC__Bit13_7__free "Free (NOT INUSE)";
CM_ SG_ 385 Ecode_Bit7__FLTLS148 "Ecode - Bit 7 - FLTLS";
CM_ SG_ 385 Ecode_Bit7__FLTLS99 "Ecode - Bit 7 - FLTLS";
CM_ SG_ 385 PN82 "Position control possible";
CM_ SG_ 385 KM_MIX_ANA_ON "Kern Mode State Bit -";
CM_ SG_ 385 Err_DeviceTemp "Device temperature too high";
CM_ SG_ 385 PN64 "Position control possible";
CM_ SG_ 385 Vdc_Ana "Analogue DC-Bus measurement";
CM_ SG_ 385 rsvd1 "reserved 1";
CM_ SG_ 385 rsvd "reserved";
CM_ SG_ 385 CMC__Bit6__TorqueTimeOut_100ms_E "Set Torque command to 0 if no new external torque command input within 100 ms is registered";
CM_ SG_ 385 I_DC_Limit_is_Acv "Motor Current Limiting Activated because of DC Current lmiting";
CM_ SG_ 385 Ecode_Bit6__FLTHS148 "Ecode - Bit 6 - FLTHS";
CM_ SG_ 385 Ecode_Bit6__FLTHS99 "Ecode - Bit 6 - FLTHS";
CM_ SG_ 385 TNLim82 "Speed-limited torque mode active";
CM_ SG_ 385 KM_N_CLIP "Kern Mode State Bit -";
CM_ SG_ 385 Err_MotorTemp "Motor temperature too high";
CM_ SG_ 385 TNLim64 "Speed-limited torque mode active";
CM_ SG_ 385 No_UESP_BTB "BTB nicht mit Powervoltage Ãœberwachung verknÃ¼pft";
CM_ SG_ 385 Out_4 "Output Signal - Out 4";
CM_ SG_ 385 RFE152 "Input Signal - RFE";
CM_ SG_ 385 CMC__Bit5__Reset_NRamp_AtNZero "Speed Ramp Reset to 0 if actual speed crosses 0 rpm";
CM_ SG_ 385 Recup_is_Acv "Recuperation is active";
CM_ SG_ 385 MO_Feedback_2 "Motor Options - Feedback 2 Type";
CM_ SG_ 385 Ecode_Bit5__N_FAIL148 "Ecode - Bit 5 - N FAIL";
CM_ SG_ 385 Ecode_Bit5__N_FAIL99 "Ecode - Bit 5 - N FAIL";
CM_ SG_ 385 Icns82 "Current is limited to the continuous current level";
CM_ SG_ 385 KM_I_LIMIT "Kern Mode State Bit -";
CM_ SG_ 385 RFE216 "Rotating Field Enable";
CM_ SG_ 385 Err_PowerVoltage_Low "Power voltage missing";
CM_ SG_ 385 Icns64 "Current is limited to the continuous current level";
CM_ SG_ 385 Out_3 "Output Signal - Out 3";
CM_ SG_ 385 Run152 "Input Signal - Run (FRG)";
CM_ SG_ 385 CMC__Bit4__Dig_M_RcpRamp_Ena "Enable the use of Recuperation Ramps during Torque Mode";
CM_ SG_ 385 Compare_Var219 "Arrangement Variable Selection List for digital Output 4";
CM_ SG_ 385 Compare_Var218 "Arrangement Variable Selection List for digital Output 3";
CM_ SG_ 385 Compare_Var195 "Arrangement Variable Selection List for digital Output 2";
CM_ SG_ 385 Compare_Var194 "Arrangement Variable Selection List for digital Output 1";
CM_ SG_ 385 Ecode_Bit4__RDY3148 "Ecode - Bit 4 - RDY3";
CM_ SG_ 385 Ecode_Bit4__RDY399 "Ecode - Bit 4 - RDY3";
CM_ SG_ 385 OK82 "Drive ok (no uncontrolled control-voltage reset seen)";
CM_ SG_ 385 KM_TX_TOG_STAT "Kern Mode State Bit -";
CM_ SG_ 385 CS_Ain_1_Mode "Command Source Mask - Analog 1 Mode Bits";
CM_ SG_ 385 FRGRUN "Hardware enable active";
CM_ SG_ 385 Err_FeedbackSignal "Encoder signal faulty or missing";
CM_ SG_ 385 OK64 "Drive ok (no uncontrolled control-voltage reset seen)";
CM_ SG_ 385 I_ist_Inverse "Current Measurement Inverse";
CM_ SG_ 385 Go155 "Output Signal - Go";
CM_ SG_ 385 In_1 "Input Signal - Input 1";
CM_ SG_ 385 CMC__Bit3__TorqueVal_Init_Ena "Enable Init as Torque Mode after Enable (Run)";
CM_ SG_ 385 Ecode_Bit3__Free148 "Ecode - Bit 3 - Free (NOT INUSE)";
CM_ SG_ 385 Ecode_Bit3__Free99 "Ecode - Bit 3 - Free (NOT INUSE)";
CM_ SG_ 385 Lim_minus82 "Limit switch minus assigned";
CM_ SG_ 385 KM_CAL_OFF "Kern Mode State Bit -";
CM_ SG_ 385 IN1 "Digital input Din 1 active";
CM_ SG_ 385 Err_BusTimeout "CAN TimeOut time exceeded";
CM_ SG_ 385 Lim_minus64 "Limit switch minus assigned";
CM_ SG_ 385 CoastStop "Coast Stop Activation";
CM_ SG_ 385 Rdy155 "Output Signal - Rdy";
CM_ SG_ 385 In_2 "Input Signal - Input 2";
CM_ SG_ 385 CMC__Bit2__Pdc_Limit_Usage "Use the DC current Limitiation Calculation depending on the DC Power limits";
CM_ SG_ 385 Op_Mode_Quadrant "Present Operation Quadrant Mode";
CM_ SG_ 385 Ecode_Bit2__HW0_State148 "Ecode - Bit 2 - HW 0 Coding State";
CM_ SG_ 385 Ecode_Bit2__HW0_State99 "Ecode - Bit 2 - HW 0 Coding State";
CM_ SG_ 385 Lim_plus82 "Limit switch plus assigned";
CM_ SG_ 385 KM_FRG_OFF "Kern Mode State Bit -";
CM_ SG_ 385 CS_Ain_2_Format "Command Source Mask - Analog 2 Format Bits";
CM_ SG_ 385 IN2 "Digital input Din 2 active";
CM_ SG_ 385 Err_RFE_Fault "Safety circuit faulty (only active with RUN)";
CM_ SG_ 385 Lim_plus64 "Limit switch plus assigned";
CM_ SG_ 385 FB_Special "Feedback Speciality";
CM_ SG_ 385 Out_2 "Output Signal - Out 2";
CM_ SG_ 385 Lmt_2 "Input Signal - Limit 2";
CM_ SG_ 385 CMC__Bit1__Idc_Limit_Ena "Enable the Limitiation Calculation depending on the DC Current limits";
CM_ SG_ 385 DC_I_SensEna_Set "DC current Sensor (if present) Activated";
CM_ SG_ 385 Ecode_Bit1__HW1_State148 "Ecode - Bit 1 - HW 1 Coding State";
CM_ SG_ 385 Ecode_Bit1__HW1_State99 "Ecode - Bit 1 - HW 1 Coding State";
CM_ SG_ 385 NcR082 "Speed command value = 0 (drive stopped)";
CM_ SG_ 385 KM_SPEED_0 "Kern Mode State Bit -";
CM_ SG_ 385 LMT2 "Digital input limit 2 active";
CM_ SG_ 385 Err_PowerFault "Hardware error";
CM_ SG_ 385 NcR064 "Speed command value = 0 (drive stopped)";
CM_ SG_ 385 Ballast_Ext "Ballast-R extern";
CM_ SG_ 385 SubVersion_Nr "Firmware Subversion Number";
CM_ SG_ 385 Out_1 "Output Signal - Out 1";
CM_ SG_ 385 Lmt_1 "Input Signal - Limit 1";
CM_ SG_ 385 M_cmd_ramp "Digital numerical Iq-Current Command - internal ramped";
CM_ SG_ 385 Vdc_Bus "DC-Bus Voltage";
CM_ SG_ 385 Pos_Ref_Start "Start Park Cycle";
CM_ SG_ 385 Oszi_Read_cmd "NDrive Oszillloscop - Read Command";
CM_ SG_ 385 Oszi_Run_cmd "NDrive Oszillloscop - Run Command";
CM_ SG_ 385 Oszi_Skip "NDrive Oszillloscop - Capture Skip";
CM_ SG_ 385 Oszi_Source "NDrive Oszillloscop - Capture Source";
CM_ SG_ 385 Trig_Source "NDrive Oszillloscop - Capture Trigger Source";
CM_ SG_ 385 Trig_Edge "NDrive Oszillloscop - Capture Trigger Level";
CM_ SG_ 385 Trig_Level "NDrive Oszillloscop - Capture Trigger Edge";
CM_ SG_ 385 Capture_Channel "NDrive Oszillloscop - Capture Channel";
CM_ SG_ 385 Extra__Start "FU Extra - Start";
CM_ SG_ 385 Work "Inverter Output AC Work (DO NOT USE!!)";
CM_ SG_ 385 Power "Inverter Output AC Power (DO NOT USE!!)";
CM_ SG_ 385 Brake_Delay "Mechanical Brake Delay Time (e.g. Relay)";
CM_ SG_ 385 T_peak "Allowed Timing for Peak Current";
CM_ SG_ 385 No_HW_Fault "No HW_Fault detected";
CM_ SG_ 385 FB_LossOfSignal "Feedback Loss of Signal";
CM_ SG_ 385 DUP__Bit7_0__DAC_Source_Channel "DAC Configuration of the RegID Source Channel as Output";
CM_ SG_ 385 Var_4 "Comparison Variable 4";
CM_ SG_ 385 Var_3 "Comparison Variable 3";
CM_ SG_ 385 Var_2 "Comparison Variable 2";
CM_ SG_ 385 Can_RxTimeout "CAN Timeout time settings";
CM_ SG_ 385 Var_1 "Comparison Variable 1";
CM_ SG_ 385 N_Rpm_MaxInt "Max possible Rotation Speed internal";
CM_ SG_ 385 CMC__Bit0__DC_Current_Sens_Ena "Enable the use of the DC current Sensor (if present)";
CM_ SG_ 385 DC_Current_Sens_Ena_Set "DC Current Sesnor is set to enabled";
CM_ SG_ 385 PID_I__Kf__Iq "Feedforward - Proportional Gain Iq-Current Controller";
CM_ SG_ 385 Bat_Opr_Limit__Mot "Idc or Pdc Limit during Motor operation";
CM_ SG_ 385 PID_I__xKp__Iq "Proportional Gain Iq-Current Controller if actual current is above I Limit Inuse Current - perc is depending on Kp value";
CM_ SG_ 385 Operand219 "Selection List Operant for digital Output OUT 4";
CM_ SG_ 385 Operand218 "Selection List Operant for digital Output OUT 3";
CM_ SG_ 385 Operand195 "Selection List Operant for digital Output OUT 2";
CM_ SG_ 385 Ain_in_2_scaled252 "Analog Input Signal 2 - Scaled";
CM_ SG_ 385 Ain_in_1_scaled251 "Analog Input Signal 1 - Scaled";
CM_ SG_ 385 Signal_PosTolerance "Digital Output Signal - Actual Position is within tolerance window";
CM_ SG_ 385 Signal_LessN0 "Digital Output Signal - Actual speed less than 0.1 %";
CM_ SG_ 385 Signal_Icns "Digital Output Signal - The current limit is reduced to continuous current";
CM_ SG_ 385 Signal_Brake "Digital Output Signal - mechanical Brake Activated";
CM_ SG_ 385 Signal_GO "Digital Output Signal - internal GO is set (no errors)";
CM_ SG_ 385 I_Max_Inuse "Maximum possible allowed current";
CM_ SG_ 385 Operand194 "Selection List Operant for digital Output OUT 1";
CM_ SG_ 385 def_DIN_2 "Definition - Function attribution of the Digital Input - DIN 2";
CM_ SG_ 385 def_DIN_1 "Definition - Function attribution of the Digital Input - DIN 1";
CM_ SG_ 385 def_END_2 "Definition - Function attribution of the Digital Input - END 2 (Limit 2)";
CM_ SG_ 385 def_END_1 "Definition - Function attribution of the Digital Input - END 1 (Limit 1)";
CM_ SG_ 385 Motor_Ts "Stator Time Contant of the Motor";
CM_ SG_ 385 Motor_Rs "Motor - Stator Resistance Value";
CM_ SG_ 385 Motor_Tr "Rotor Time Contant of the Motor";
CM_ SG_ 385 Id_Min "Minimum Magnetising d-Current value as perc of nominal current";
CM_ SG_ 385 Motor_Rr "Motor - Rotor Resistance Value";
CM_ SG_ 385 Motor_Lm "Motor - Magnetizing Inductance - L";
CM_ SG_ 385 Id_Nom "Nominal Magnetising d-Current value as perc of nominal current";
CM_ SG_ 385 Motor_Lsd "Motor Leakage Inductance ph-ph - Lsd";
CM_ SG_ 385 Motor_Lsq "Motor - Stator Leakage Inductance - Lsq";
CM_ SG_ 385 timer_delta "PWM Configuration value of timer delta";
CM_ SG_ 385 PWM_3 "PWM 3 (1/2) clock open time";
CM_ SG_ 385 PWM_2 "PWM 2 (3/4) clock open time";
CM_ SG_ 385 PWM_1 "PWM 1 (5/6) clock open time";
CM_ SG_ 385 Logic_Freq "Foreground Cycle Frequency";
CM_ SG_ 385 FB_Pole "Feedback Pole number";
CM_ SG_ 385 FB_Incr_Mot "Feedback System Increments per rotation";
CM_ SG_ 385 DC_Bus_Min_Lim "DC Bus Min Value Superpision Limit";
CM_ SG_ 385 MO_Feedback_1 "Motor Options - Feedback 1 Type";
CM_ SG_ 385 M_Temp "Motor Temperature Limit for Inverter Error shutdown";
CM_ SG_ 385 Ballastcount "Internal Ballast Count Value";
CM_ SG_ 385 Info_Timer_Diff "Info Interrupt time";
CM_ SG_ 385 CAN_Error_CRC_Check151 "CAN Bus Error counter - Error Status Bit from CAN Module";
CM_ SG_ 385 CAN_Error_CRC_Check150 "CAN Bus Error counter - CRC_Check";
CM_ SG_ 385 CAN_Error_No_Ack "CAN Bus Error counter - No Ack";
CM_ SG_ 385 Ecode_Bit0_FirstErrorDtcd148 "Ecode - Bit 0 - First Error Detected";
CM_ SG_ 385 CAN_Error_WriteTime "CAN Bus Error counter - Write Time";
CM_ SG_ 385 CAN_Error_BusOff "CAN Bus Error counter - Bus Off";
CM_ SG_ 385 Pos_cmd "Numeric Position Command Value";
CM_ SG_ 385 Clear_Errors "Clear Error and Warning List";
CM_ SG_ 385 PID_n__Ti "Integral Action Time (Integral Part) Speed Controller";
CM_ SG_ 385 V_Kp "Proportional Gain Voltage Controller (0.0001 * Ti equals 1.0)";
CM_ SG_ 385 V_Ref "Voltage Controller Reference value in perc of Vout (V_Red - Start of Field Reduction)";
CM_ SG_ 385 CAN_ID_2_Tx "CAN Identiciation ID - 2 - for Transmit - Tx";
CM_ SG_ 385 CAN_ID_2_Rx "CAN Identiciation ID - 2 - for Receive - Rx";
CM_ SG_ 385 Fun_Special "Special Functions for automatic logics or calculations";
CM_ SG_ 385 Fun_Para_Write "Special Function For Parameter Write command to Eeprom sector";
CM_ SG_ 385 Fun_Para_Read "Special Function For Parameter Read command from Eeprom sector";
CM_ SG_ 385 Pos_Diff_Slack "Position Difference Slack Value";
CM_ SG_ 385 Pos_Offset_Slack "Position Offset Slack Value";
CM_ SG_ 385 FB2_Scale_Ext "Feedback 2 - External Scale Factor";
CM_ SG_ 385 Pos_ND_Offset "NDrive Position Display Offset Factor";
CM_ SG_ 385 Pos_ND_Scale "NDrive Position Display Scale Factor";
CM_ SG_ 385 Pos_Zero_Offset "User Zero Offset Position Value";
CM_ SG_ 385 Pos_Preset_Val "Numeric Preset Position Value (Set actual Position to Preset Position)";
CM_ SG_ 385 Pos_Tol_Win "Tolerance Window for Destination Position";
CM_ SG_ 385 Speed_2 "Position Reference Speed 1 (Slow) + Phasing electrical Rotation Speed";
CM_ SG_ 385 Speed_1 "Position Reference Speed 1 (Fast)";
CM_ SG_ 385 Ref_Reso_Edge "Resolver Position at Reference Switch (Rsw)";
CM_ SG_ 385 Pos_Zero_Capture "Position Zero Capture";
CM_ SG_ 385 CAN_NBT "CAN BaudRate Configuration Setting";
CM_ SG_ 385 Pos_OffsRef "Numeric Position Zero Offset Value";
CM_ SG_ 385 Pos_TiM "Position Control Integral Maximum Output Range";
CM_ SG_ 385 Pos_Error "Numeric Error Position Value";
CM_ SG_ 385 Pos_Actual_2 "Numeric Actual Position 2 (Alternative) Value";
CM_ SG_ 385 Pos_Dest "Numeric Destination Position Value";
CM_ SG_ 385 Pos_Actual "Numeric Actual Position Value";
CM_ SG_ 385 Pos_Td "Derative Action Time (Derative Part) Position Controller";
CM_ SG_ 385 Pos_Ti "Integral Action Time (Integral Part) Position Controller";
CM_ SG_ 385 Pos_Kp "Proportional Gain Position Controller";
CM_ SG_ 385 CAN_ID_Tx "CAN Identiciation ID for Transmit - Tx";
CM_ SG_ 385 CAN_ID_Rx "CAN Identiciation ID for Receive - Rx";
CM_ SG_ 385 Regen_P "Regenerative Resistor Power Value";
CM_ SG_ 385 Device_Mains "Device Mains Supply Voltage Value";
CM_ SG_ 385 Ecode_Bit0_FirstErrorDtcd99 "Ecode - Bit 0 - First Error Detected";
CM_ SG_ 385 Ixt_Monitor "Monitor Value for Regen I x t calculation";
CM_ SG_ 385 Ain_in_1_Filter "Analog Input Signal 1 - Filter Value Setting";
CM_ SG_ 385 Speed_Filter "Additional Filter Adjustment of the Rotation Speed Measurement";
CM_ SG_ 385 Rotor_Signals "Digital Hall Sensor Position Rotor Signals Value";
CM_ SG_ 385 PID_n__Kacc "Speed Control Acceleration Feed Foreward Gain";
CM_ SG_ 385 n_Nom "Motor Nominal Rotation Speed";
CM_ SG_ 385 I_Limit_Inuse_ramp "Actual Reduced Current Limit ramped";
CM_ SG_ 385 Ain_in_2_Cutoff "Analog Input Signal 2 - Cutoff Value Setting";
CM_ SG_ 385 Ena82 "Enable drive";
CM_ SG_ 385 KM_rsvd_0 "Kern Mode State Bit - rsvd_0";
CM_ SG_ 385 ActiveControlMode "Active Control Mode Mask";
CM_ SG_ 385 Ain_in_1_Cutoff "Analog Input Signal 1 - Cutoff Value Setting";
CM_ SG_ 385 Motor_Pole "Motor Pole Number";
CM_ SG_ 385 It_Rg_Monitor "Bleeder Resistor Ixt  Monitor";
CM_ SG_ 385 FB_Offset "FeedBack Offset Angle Value";
CM_ SG_ 385 MotorPos_Elec "Actual Electrical Angle Position of the Motor";
CM_ SG_ 385 MotorPos_Mech "Actual Mechanical Angle Position of the Motor";
CM_ SG_ 385 Incr_Delta "Delta diff of the feedback Signal per measuring point";
CM_ SG_ 385 N_Lim_minus "Speed n Limit minus - Percentage as 15 Bit entry format (-32767 equal -100perc)";
CM_ SG_ 385 N_Lim_plus "Speed n Limit plus - Percentage as 15 Bit entry format (32767 equal 100perc)";
CM_ SG_ 385 PID_n__TiM "Speed Control Integral Maximum Output Range";
CM_ SG_ 385 DZR_Seq "SpeedControl Loop (DZR) Sequencer Configuration (PWM Freq dependent)";
CM_ SG_ 385 Ain_in_2_OffsetVal "Analog Input Signal 2 - Offset Value Setting";
CM_ SG_ 385 Ain_in_1_OffsetVal "Analog Input Signal 1 - Offset Value Setting";
CM_ SG_ 385 PID_n__Td "Derative Action Time (Derative Part) Speed Controller";
CM_ SG_ 385 V_Ti "Integral Action Time (Integral Part) Voltage Controller (0.0001 x Ti equals 1.0)";
CM_ SG_ 385 PID_n__Kp "Proportional Gain Speed Controller";
CM_ SG_ 385 PID_I__TiM__Iq "Iq-Current Control Integral Maximum Output Range";
CM_ SG_ 385 I_Delta_Ramp "Final Current Ramp Step setting";
CM_ SG_ 385 I3_Offset "I3 Offset value measured at Enable";
CM_ SG_ 385 Cutoffdig "Digital Cutoff area of incomming digital commands";
CM_ SG_ 385 PID_I__Ti__Iq "Integral Action Time (Integral Part) Iq-Current Controller";
CM_ SG_ 385 PID_I__Kp__Iq "Proportional Gain Iq-Current Controller - A entry 33 equals 1.0 normalized";
CM_ SG_ 385 Calib_Ref_Value "Entry for the Reference Value used for various Calibrations";
CM_ SG_ 385 PWM_Enum "Value for PWM Frequency configuration (Internal)";
CM_ SG_ 385 Cos_Phi "Motor Power Factor";
CM_ SG_ 385 F_corner__Start "Frequency at max output voltage - Start";
CM_ SG_ 385 V_corner__Start "Voltage (percentage of DC-Bus) at max. Frequency";
CM_ SG_ 385 F_min__Start "Minimum Frequency (FU operation) at Start";
CM_ SG_ 385 V_min__Start "Minimum Voltage (FU operation) at Start";
CM_ SG_ 385 V_dc__Start "DC Voltage for Pre-Magnitization - Start";
CM_ SG_ 385 T_dc__Start "Time For DC Pre-Charge-Magnitising - Start";
CM_ SG_ 385 Motor_V_N "Nominal Motor Voltage";
CM_ SG_ 385 Motor_F_N "Nominal Motor Frequency";
CM_ SG_ 385 Temp_DEBUG "Debugger Pointer Temp";
CM_ SG_ 385 Ptr_2_DEBUG "Debugger Pointer 2";
CM_ SG_ 385 Ptr_1_DEBUG "Debugger Pointer 1";
CM_ SG_ 385 M_outdig__Iq "Digital numerical Iq-Current Output - input";
CM_ SG_ 385 Id_Ref "Set (Reference) numerical Id-Current - internal";
CM_ SG_ 385 CS_Ain_1_Format "Command Source Mask - Analog 1 Format Bits";
CM_ SG_ 385 I_red_TM "Current reduction by motor temperature";
CM_ SG_ 385 I_red_TE "Stop of current reduction by power stage temperature";
CM_ SG_ 385 I_red_TD "Start of current reduction by power stage temperature";
CM_ SG_ 385 I_red_N "Current reduction by rotation speed - Percentage as 15 Bit entry format (32767 equal 100perc)";
CM_ SG_ 385 I_lim_dig "Derating Reduction to percentage Value - Trigger is Dig Input - Percentage as 15 Bit entry format (32767 equal 100perc)";
CM_ SG_ 385 DOUT_4 "Digital Output - DOUT 4";
CM_ SG_ 385 I_Fault "Hardware Error Signal I_Fault";
CM_ SG_ 385 Rdy_BTB "Digital Output - Rdy_BTB";
CM_ SG_ 385 DOUT_3 "Digital Output - DOUT 3";
CM_ SG_ 385 DOUT_2 "Digital Output - DOUT 2";
CM_ SG_ 385 DOUT_1 "Digital Output - DOUT 1";
CM_ SG_ 385 RUN232 "Digital Input - RUN";
CM_ SG_ 385 DIN_2 "Digital Input - DIN 2";
CM_ SG_ 385 END_2 "Digital Input - END 2";
CM_ SG_ 385 DIN_1 "Digital Input - DIN 1";
CM_ SG_ 385 END_1 "Digital Input - END 1";
CM_ SG_ 385 Vdc_Bus_Filt "DC-Bus Voltage";
CM_ SG_ 385 T_Air "Temperature Air (inside) as ADC value";
CM_ SG_ 385 T_Igbt "Temperature Igbt as ADC value";
CM_ SG_ 385 T_Motor "Temperature Motor as ADC value";
CM_ SG_ 385 Vout "Voltage Output Vq and Vd total";
CM_ SG_ 385 Vd "D - Value Voltage Output";
CM_ SG_ 385 Vq "Q - Value Voltage Output";
CM_ SG_ 385 I2_ADC "Measured ADC Value of the I2-current Shunt";
CM_ SG_ 385 I3_ADC "Measured ADC Value of the I3-current Shunt";
CM_ SG_ 385 I3_Actual "Measured numerical I3-Current - internal";
CM_ SG_ 385 I2_Actual "Measured numerical I2-Current - internal";
CM_ SG_ 385 I1_Actual "Measured numerical I1-Current - internal";
CM_ SG_ 385 Id_Error "Error of the numerical Id-Current - internal";
CM_ SG_ 385 Iq_Error "Error of the numerical Iq-Current - internal";
CM_ SG_ 385 Id_Actual "Measured numerical Id-Current - internal";
CM_ SG_ 385 Iq_Actual "Measured numerical Iq-Current - internal";
CM_ SG_ 385 I_Actual_Filt "Measured numerical Current Filtered - internal";
CM_ SG_ 385 I_Actual "Measured numerical Current - internal";
CM_ SG_ 385 I_cmd_ramp "Digital numerical Current Command - internal ramped";
CM_ SG_ 385 I_cmd "Digital numerical Current Command - internal";
CM_ SG_ 385 I_Limit_Inuse "Actual Reduced Current Limit";
CM_ SG_ 385 I_nom_eff "Motor Nominal Effective Current";
CM_ SG_ 385 I_max_eff "Motor Maximum Effective Peak Current";
CM_ SG_ 385 I_con_eff "Continuous Device Current (Arms) settings via percentage entry - Percentage as 13 Bit entry format (16383 is equal 100perc)";
CM_ SG_ 385 I_max_pk "Max. Device Current (A) settings via percentage entry - Percentage as 13 Bit entry format (16383 equal 100perc)";
CM_ SG_ 385 ID_setdig__Id "Digital numerical Id-Current Command - input";
CM_ SG_ 385 M_setdig__Iq "Digital numerical Iq-Current Command - input";
CM_ SG_ 385 N_Error "Speed n Error difference";
CM_ SG_ 385 N_Lim "Speed n Limit - Percentage as 15 Bit entry format (32767 equal 100perc)";
CM_ SG_ 385 N_cmd_ramp "Digital numerical Speed Command - internal ramped";
CM_ SG_ 385 N_cmd "Digital numerical Speed Command - internal";
CM_ SG_ 385 N_setdig "Digital numerical Speed Command - input";
CM_ SG_ 385 Nmax100perc "Maximum Speed Value for Resolution of 16Bit";
CM_ SG_ 385 Ain_in_2_raw "Analog Input Signal 2 - Raw";
CM_ SG_ 385 Ain_in_1_raw "Analog Input Signal 1 - Raw";
CM_ SG_ 385 LMT1 "Digital input limit 1 active";
CM_ SG_ 385 Err_BadParas "Damaged parameter";
CM_ SG_ 385 Ena64 "Enable drive";
CM_ SG_ 385 DC_BUS_comp "Analoge Zwischenkreismessung geht in Uout ein";
CM_ SG_ 385 I_200perc "Internal Current value at 200% nominal device current";
CM_ SG_ 385 V_Shunt "Current Sensor rated voltage";
CM_ SG_ 385 I_device "Set device define for continuous current";
CM_ SG_ 385 Axis "Inverter 4 Letter Name define";
CM_ SG_ 385 SNr "Device Serial Number";
CM_ SG_ 385 DeviceType "Coding Signal defining various device types";
CM_ SG_ 385 Firmware "Firmware Number";
CM_ SG_ 385 N_Actual_Filt "Actual Motor Roations Speed Filtered";
CM_ SG_ 385 N_R_Lim "Emergency Stopping Ramp Time [0..1000 ms]";
CM_ SG_ 385 N_R_Dec "Speed Ramp Dec Time [0..30000 ms]";
CM_ SG_ 385 N_Actual "Actual Motor Roations Speed";
CM_ SG_ 385 Rcv_Mux "Actual Motor Roations Speed";
BA_DEF_  "BusType" STRING ;
BA_DEF_ SG_  "GenSigStartValue" FLOAT -3.4E+38 3.4E+38;
BA_DEF_ SG_  "SigType" ENUM  "Default","Range","RangeSigned","ASCII","Discrete","Control","ReferencePGN","DTC","StringDelimiter","StringLength","StringLengthControl","MessageCounter","MessageChecksum";
BA_DEF_DEF_  "BusType" "CAN";
BA_DEF_DEF_  "GenSigStartValue" 0;
BA_DEF_DEF_  "SigType" "Default";
BA_ "GenSigStartValue" SG_ 513 PID_I__Ti__Id 300;
BA_ "SigType" SG_ 513 Axis 3;
BA_ "GenSigStartValue" SG_ 513 Clear_Errors 1;
BA_ "GenSigStartValue" SG_ 513 Regen_P 25;
BA_ "GenSigStartValue" SG_ 513 n_Nom 60;
BA_ "GenSigStartValue" SG_ 513 Motor_Pole 2;
BA_ "GenSigStartValue" SG_ 513 PID_I__Ti__Iq 300;
BA_ "GenSigStartValue" SG_ 385 PID_I__Ti__Id 300;
BA_ "GenSigStartValue" SG_ 385 Regen_P 25;
BA_ "GenSigStartValue" SG_ 385 n_Nom 60;
BA_ "GenSigStartValue" SG_ 385 Motor_Pole 2;
BA_ "GenSigStartValue" SG_ 385 PID_I__Ti__Iq 300;
BA_ "SigType" SG_ 385 Axis 3;
VAL_ 513 PWM_Freq 0 "8_kHz" 1 "24_kHz" 2 "20_kHz" 3 "16_kHz" 4 "12_kHz" 5 "8_kHz_i16" 6 "6_kHz_i12" 7 "4_kHz_i12" ;
VAL_ 513 Active193 0 "Low" 1 "High" ;
VAL_ 513 Active192 0 "Low" 1 "High" ;
VAL_ 513 Active191 0 "Low" 1 "High" ;
VAL_ 513 Active190 0 "Low" 1 "High" ;
VAL_ 513 MO_sc2_reso 1 "14_bit" 2 "12_bit" 3 "10_bit" ;
VAL_ 513 MotorType 0 "EC_Servo" 1 "ACI_V_f" 2 "ACI_Servo" 3 "DC" ;
VAL_ 513 CS_CMD_Type 0 "Digital_Commands" 1 "Dig_Ana_Speed" 2 "Analog_Speed" 3 "Analog_Torque" ;
VAL_ 513 Source_ID219 93 "5Dh_N_cmd_int_" 50 "32h_N_cmd_ramp_" 48 "30h_N_Actual" 168 "A8h_N_Actual_Filt" 51 "33h_N_Error" 38 "26h_I_cmd" 34 "22h_I_cmd_ramp_" 32 "20h_I_Actual" 95 "5Fh_I_Actual_Filt" 110 "6Eh_Pos_Destination" 145 "91h_Pos_cmd" 109 "6Dh_Pos_Actual" 112 "70h_Pos_Error" 116 "74h_Pos_ZeroCapture" 228 "E4h_DigInput_END_1" 229 "E5h_DigInput_END_2" 230 "E6h_DigInput_DIN_1" 231 "E7h_DigInput_DIN_2" 232 "E8h_DigInput_RUN" 224 "E0h_DigOutput_DOUT_1" 225 "E1h_DigOutput_DOUT_2" 222 "DEh_DigOutput_DOUT_3" 223 "DFh_DigOutput_DOUT_4" 226 "E2h_DigOutput_Rdy_BTB" 233 "E9h_Error_I_Fault" 234 "EAh_I_Ballast_Act" 36 "24h_I_Max_Inuse" 236 "ECh_FB_LossOfSignal" 0 "_Off_" 227 "E3h_DigSignal_GO" 242 "F2h_DigSignal_Brake" 243 "F3h_DigSignal_Icns" 245 "F5h_DigSignal_LessN0" 244 "F4h_DigSignal_PosToler_Set" 92 "5Ch_Rotor_Signals" 209 "D1h_Var_1" 210 "D2h_Var_2" 211 "D3h_Var_3" 212 "D4h_Var_4" 213 "D5h_Ain_In_1" 214 "D6h_Ain_In_2" 66 "42h_MotorPos_Mech" 67 "43h_MotorPos_Elec" 169 "A9h_I3_Adc_Value" 170 "AAh_I2_Adc_Value" 84 "54h_I1_Actual" 85 "55h_I2_Actual" 86 "56h_I3_Actual" 39 "27h_Iq_Actual" 40 "28h_Id_Actual" 56 "38h_Iq_Error" 57 "39h_Id_Error" 35 "23h_Id_Ref" 181 "B5h_Id_Min" 97 "61h_Ixt_Monitor" 72 "48h_I_Limit_Inuse" 87 "57h_I_Limit_Inuse_ramp_" 251 "FBh_Ain_1_Calc" 252 "FCh_Ain_2_Calc" 41 "29h_Vq_Output" 42 "2Ah_Vd_Output" 138 "8Ah_V_Output" 139 "8Bh_V_Red_Ref_" 140 "8Ch_V_Control_Kp" 141 "8Dh_V_Control_Ti" 172 "ACh_PWM_1_5_6_" 173 "ADh_PWM_2_3_4_" 174 "AEh_PWM_3_1_2_" 73 "49h_T_Motor" 74 "4Ah_T_Igbt" 75 "4Bh_T_Air_Inside" 69 "45h_It_Rg_Monitor" 154 "9Ah_Temp_DEBUG" 171 "ABh_Logic_Freq" 184 "B8h_Ptr_1_DEBUG" 186 "BAh_Ptr_2_DEBUG" 143 "8Fh_ErrorWarning_Map" 64 "40h_Status_Map" 65 "41h_Incr_Delta" 52 "34h_N_Lim" 99 "63h_FPGA_Status" 49 "31h_N_set_dig_" 144 "90h_M_set_dig_" 160 "A0h_M_out_dig_" 111 "6Fh_Pos_Actual_2" 152 "98h_Logic_O_Block" 155 "9Bh_Logic_I_Block" 2 "02h_SC_Info" 235 "EBh_Vdc_Bus" 102 "66h_Vdc_Bus_Filt" 153 "99h_Info_Timer_Diff" 161 "A1h_Ballast_cntr" 81 "51_Kern_Mode_State" 17 "11h_Control_Status" ;
VAL_ 513 Source_ID218 93 "5Dh_N_cmd_int_" 50 "32h_N_cmd_ramp_" 48 "30h_N_Actual" 168 "A8h_N_Actual_Filt" 51 "33h_N_Error" 38 "26h_I_cmd" 34 "22h_I_cmd_ramp_" 32 "20h_I_Actual" 95 "5Fh_I_Actual_Filt" 110 "6Eh_Pos_Destination" 145 "91h_Pos_cmd" 109 "6Dh_Pos_Actual" 112 "70h_Pos_Error" 116 "74h_Pos_ZeroCapture" 228 "E4h_DigInput_END_1" 229 "E5h_DigInput_END_2" 230 "E6h_DigInput_DIN_1" 231 "E7h_DigInput_DIN_2" 232 "E8h_DigInput_RUN" 224 "E0h_DigOutput_DOUT_1" 225 "E1h_DigOutput_DOUT_2" 222 "DEh_DigOutput_DOUT_3" 223 "DFh_DigOutput_DOUT_4" 226 "E2h_DigOutput_Rdy_BTB" 233 "E9h_Error_I_Fault" 234 "EAh_I_Ballast_Act" 36 "24h_I_Max_Inuse" 236 "ECh_FB_LossOfSignal" 0 "_Off_" 227 "E3h_DigSignal_GO" 242 "F2h_DigSignal_Brake" 243 "F3h_DigSignal_Icns" 245 "F5h_DigSignal_LessN0" 244 "F4h_DigSignal_PosToler_Set" 92 "5Ch_Rotor_Signals" 209 "D1h_Var_1" 210 "D2h_Var_2" 211 "D3h_Var_3" 212 "D4h_Var_4" 213 "D5h_Ain_In_1" 214 "D6h_Ain_In_2" 66 "42h_MotorPos_Mech" 67 "43h_MotorPos_Elec" 169 "A9h_I3_Adc_Value" 170 "AAh_I2_Adc_Value" 84 "54h_I1_Actual" 85 "55h_I2_Actual" 86 "56h_I3_Actual" 39 "27h_Iq_Actual" 40 "28h_Id_Actual" 56 "38h_Iq_Error" 57 "39h_Id_Error" 35 "23h_Id_Ref" 181 "B5h_Id_Min" 97 "61h_Ixt_Monitor" 72 "48h_I_Limit_Inuse" 87 "57h_I_Limit_Inuse_ramp_" 251 "FBh_Ain_1_Calc" 252 "FCh_Ain_2_Calc" 41 "29h_Vq_Output" 42 "2Ah_Vd_Output" 138 "8Ah_V_Output" 139 "8Bh_V_Red_Ref_" 140 "8Ch_V_Control_Kp" 141 "8Dh_V_Control_Ti" 172 "ACh_PWM_1_5_6_" 173 "ADh_PWM_2_3_4_" 174 "AEh_PWM_3_1_2_" 73 "49h_T_Motor" 74 "4Ah_T_Igbt" 75 "4Bh_T_Air_Inside" 69 "45h_It_Rg_Monitor" 154 "9Ah_Temp_DEBUG" 171 "ABh_Logic_Freq" 184 "B8h_Ptr_1_DEBUG" 186 "BAh_Ptr_2_DEBUG" 143 "8Fh_ErrorWarning_Map" 64 "40h_Status_Map" 65 "41h_Incr_Delta" 52 "34h_N_Lim" 99 "63h_FPGA_Status" 49 "31h_N_set_dig_" 144 "90h_M_set_dig_" 160 "A0h_M_out_dig_" 111 "6Fh_Pos_Actual_2" 152 "98h_Logic_O_Block" 155 "9Bh_Logic_I_Block" 2 "02h_SC_Info" 235 "EBh_Vdc_Bus" 102 "66h_Vdc_Bus_Filt" 153 "99h_Info_Timer_Diff" 161 "A1h_Ballast_cntr" 81 "51_Kern_Mode_State" 17 "11h_Control_Status" ;
VAL_ 513 Source_ID195 93 "5Dh_N_cmd_int_" 50 "32h_N_cmd_ramp_" 48 "30h_N_Actual" 168 "A8h_N_Actual_Filt" 51 "33h_N_Error" 38 "26h_I_cmd" 34 "22h_I_cmd_ramp_" 32 "20h_I_Actual" 95 "5Fh_I_Actual_Filt" 110 "6Eh_Pos_Destination" 145 "91h_Pos_cmd" 109 "6Dh_Pos_Actual" 112 "70h_Pos_Error" 116 "74h_Pos_ZeroCapture" 228 "E4h_DigInput_END_1" 229 "E5h_DigInput_END_2" 230 "E6h_DigInput_DIN_1" 231 "E7h_DigInput_DIN_2" 232 "E8h_DigInput_RUN" 224 "E0h_DigOutput_DOUT_1" 225 "E1h_DigOutput_DOUT_2" 222 "DEh_DigOutput_DOUT_3" 223 "DFh_DigOutput_DOUT_4" 226 "E2h_DigOutput_Rdy_BTB" 233 "E9h_Error_I_Fault" 234 "EAh_I_Ballast_Act" 36 "24h_I_Max_Inuse" 236 "ECh_FB_LossOfSignal" 0 "_Off_" 227 "E3h_DigSignal_GO" 242 "F2h_DigSignal_Brake" 243 "F3h_DigSignal_Icns" 245 "F5h_DigSignal_LessN0" 244 "F4h_DigSignal_PosToler_Set" 92 "5Ch_Rotor_Signals" 209 "D1h_Var_1" 210 "D2h_Var_2" 211 "D3h_Var_3" 212 "D4h_Var_4" 213 "D5h_Ain_In_1" 214 "D6h_Ain_In_2" 66 "42h_MotorPos_Mech" 67 "43h_MotorPos_Elec" 169 "A9h_I3_Adc_Value" 170 "AAh_I2_Adc_Value" 84 "54h_I1_Actual" 85 "55h_I2_Actual" 86 "56h_I3_Actual" 39 "27h_Iq_Actual" 40 "28h_Id_Actual" 56 "38h_Iq_Error" 57 "39h_Id_Error" 35 "23h_Id_Ref" 181 "B5h_Id_Min" 97 "61h_Ixt_Monitor" 72 "48h_I_Limit_Inuse" 87 "57h_I_Limit_Inuse_ramp_" 251 "FBh_Ain_1_Calc" 252 "FCh_Ain_2_Calc" 41 "29h_Vq_Output" 42 "2Ah_Vd_Output" 138 "8Ah_V_Output" 139 "8Bh_V_Red_Ref_" 140 "8Ch_V_Control_Kp" 141 "8Dh_V_Control_Ti" 172 "ACh_PWM_1_5_6_" 173 "ADh_PWM_2_3_4_" 174 "AEh_PWM_3_1_2_" 73 "49h_T_Motor" 74 "4Ah_T_Igbt" 75 "4Bh_T_Air_Inside" 69 "45h_It_Rg_Monitor" 154 "9Ah_Temp_DEBUG" 171 "ABh_Logic_Freq" 184 "B8h_Ptr_1_DEBUG" 186 "BAh_Ptr_2_DEBUG" 143 "8Fh_ErrorWarning_Map" 64 "40h_Status_Map" 65 "41h_Incr_Delta" 52 "34h_N_Lim" 99 "63h_FPGA_Status" 49 "31h_N_set_dig_" 144 "90h_M_set_dig_" 160 "A0h_M_out_dig_" 111 "6Fh_Pos_Actual_2" 152 "98h_Logic_O_Block" 155 "9Bh_Logic_I_Block" 2 "02h_SC_Info" 235 "EBh_Vdc_Bus" 102 "66h_Vdc_Bus_Filt" 153 "99h_Info_Timer_Diff" 161 "A1h_Ballast_cntr" 81 "51_Kern_Mode_State" 17 "11h_Control_Status" ;
VAL_ 513 Source_ID194 93 "5Dh_N_cmd_int_" 50 "32h_N_cmd_ramp_" 48 "30h_N_Actual" 168 "A8h_N_Actual_Filt" 51 "33h_N_Error" 38 "26h_I_cmd" 34 "22h_I_cmd_ramp_" 32 "20h_I_Actual" 95 "5Fh_I_Actual_Filt" 110 "6Eh_Pos_Destination" 145 "91h_Pos_cmd" 109 "6Dh_Pos_Actual" 112 "70h_Pos_Error" 116 "74h_Pos_ZeroCapture" 228 "E4h_DigInput_END_1" 229 "E5h_DigInput_END_2" 230 "E6h_DigInput_DIN_1" 231 "E7h_DigInput_DIN_2" 232 "E8h_DigInput_RUN" 224 "E0h_DigOutput_DOUT_1" 225 "E1h_DigOutput_DOUT_2" 222 "DEh_DigOutput_DOUT_3" 223 "DFh_DigOutput_DOUT_4" 226 "E2h_DigOutput_Rdy_BTB" 233 "E9h_Error_I_Fault" 234 "EAh_I_Ballast_Act" 36 "24h_I_Max_Inuse" 236 "ECh_FB_LossOfSignal" 0 "_Off_" 227 "E3h_DigSignal_GO" 242 "F2h_DigSignal_Brake" 243 "F3h_DigSignal_Icns" 245 "F5h_DigSignal_LessN0" 244 "F4h_DigSignal_PosToler_Set" 92 "5Ch_Rotor_Signals" 209 "D1h_Var_1" 210 "D2h_Var_2" 211 "D3h_Var_3" 212 "D4h_Var_4" 213 "D5h_Ain_In_1" 214 "D6h_Ain_In_2" 66 "42h_MotorPos_Mech" 67 "43h_MotorPos_Elec" 169 "A9h_I3_Adc_Value" 170 "AAh_I2_Adc_Value" 84 "54h_I1_Actual" 85 "55h_I2_Actual" 86 "56h_I3_Actual" 39 "27h_Iq_Actual" 40 "28h_Id_Actual" 56 "38h_Iq_Error" 57 "39h_Id_Error" 35 "23h_Id_Ref" 181 "B5h_Id_Min" 97 "61h_Ixt_Monitor" 72 "48h_I_Limit_Inuse" 87 "57h_I_Limit_Inuse_ramp_" 251 "FBh_Ain_1_Calc" 252 "FCh_Ain_2_Calc" 41 "29h_Vq_Output" 42 "2Ah_Vd_Output" 138 "8Ah_V_Output" 139 "8Bh_V_Red_Ref_" 140 "8Ch_V_Control_Kp" 141 "8Dh_V_Control_Ti" 172 "ACh_PWM_1_5_6_" 173 "ADh_PWM_2_3_4_" 174 "AEh_PWM_3_1_2_" 73 "49h_T_Motor" 74 "4Ah_T_Igbt" 75 "4Bh_T_Air_Inside" 69 "45h_It_Rg_Monitor" 154 "9Ah_Temp_DEBUG" 171 "ABh_Logic_Freq" 184 "B8h_Ptr_1_DEBUG" 186 "BAh_Ptr_2_DEBUG" 143 "8Fh_ErrorWarning_Map" 64 "40h_Status_Map" 65 "41h_Incr_Delta" 52 "34h_N_Lim" 99 "63h_FPGA_Status" 49 "31h_N_set_dig_" 144 "90h_M_set_dig_" 160 "A0h_M_out_dig_" 111 "6Fh_Pos_Actual_2" 152 "98h_Logic_O_Block" 155 "9Bh_Logic_I_Block" 2 "02h_SC_Info" 235 "EBh_Vdc_Bus" 102 "66h_Vdc_Bus_Filt" 153 "99h_Info_Timer_Diff" 161 "A1h_Ballast_cntr" 81 "51_Kern_Mode_State" 17 "11h_Control_Status" ;
VAL_ 513 MO_sc1_reso 1 "14_bit" 2 "12_bit" 3 "10_bit" ;
VAL_ 513 Ret_Interval 255 "Stop" 0 "Single" ;
VAL_ 513 CS_Ain_2_Mode 0 "_10_10V_" 1 "_0_10V_" 2 "_4_20mA_" 3 "_1_9V_" ;
VAL_ 513 MO_Feedback_2 0 "_" 1 "Enc_Position" 2 "Enc_Info" 3 "Enc_Hand_" 4 "SSI" ;
VAL_ 513 Compare_Var219 0 "_0_" 1 "_1_" 2 "_Var_1_" 3 "_Var_2_" 4 "_Var_3_" 5 "_Var_4_" 6 "_Ain_1_" 7 "_Ain_2_" ;
VAL_ 513 Compare_Var218 0 "_0_" 1 "_1_" 2 "_Var_1_" 3 "_Var_2_" 4 "_Var_3_" 5 "_Var_4_" 6 "_Ain_1_" 7 "_Ain_2_" ;
VAL_ 513 Compare_Var195 0 "_0_" 1 "_1_" 2 "_Var_1_" 3 "_Var_2_" 4 "_Var_3_" 5 "_Var_4_" 6 "_Ain_1_" 7 "_Ain_2_" ;
VAL_ 513 Compare_Var194 0 "_0_" 1 "_1_" 2 "_Var_1_" 3 "_Var_2_" 4 "_Var_3_" 5 "_Var_4_" 6 "_Ain_1_" 7 "_Ain_2_" ;
VAL_ 513 CS_Ain_1_Mode 0 "_10_10V_" 1 "_0_10V_" 2 "_4_20mA_" 3 "_1_9V_" ;
VAL_ 513 CS_Ain_2_Format 0 "Off" 1 "_Cmd" 2 "_Cmd" 3 "_Cmd" ;
VAL_ 513 Operand219 0 "Off" 1 "On" 2 "1_Hz" 3 "_" 4 "_" 5 "_>_" 6 "_<_" 7 "_abs_>_" 8 "_abs_<_" 9 "_tol_>_" 10 "_tol_<_" 11 "_>_" 12 "_<_" 13 "_hyst_>_" 14 "_hyst_<_" 15 "_window_" ;
VAL_ 513 Operand218 0 "Off" 1 "On" 2 "1_Hz" 3 "_" 4 "_" 5 "_>_" 6 "_<_" 7 "_abs_>_" 8 "_abs_<_" 9 "_tol_>_" 10 "_tol_<_" 11 "_>_" 12 "_<_" 13 "_hyst_>_" 14 "_hyst_<_" 15 "_window_" ;
VAL_ 513 Operand195 0 "Off" 1 "On" 2 "1_Hz" 3 "_" 4 "_" 5 "_>_" 6 "_<_" 7 "_abs_>_" 8 "_abs_<_" 9 "_tol_>_" 10 "_tol_<_" 11 "_>_" 12 "_<_" 13 "_hyst_>_" 14 "_hyst_<_" 15 "_window_" ;
VAL_ 513 Operand194 0 "Off" 1 "On" 2 "1_Hz" 3 "_" 4 "_" 5 "_>_" 6 "_<_" 7 "_abs_>_" 8 "_abs_<_" 9 "_tol_>_" 10 "_tol_<_" 11 "_>_" 12 "_<_" 13 "_hyst_>_" 14 "_hyst_<_" 15 "_window_" ;
VAL_ 513 def_DIN_2 0 "_Off_" 1 "Ref_and_Limit_Plus" 2 "Ref_and_Limit_Minus" 3 "Ref_Plus" 4 "Limit_Plus" 5 "Limit_Minus" 6 "Limit_Plus_and_Minus" 7 "Cancel_Error_s_" 8 "_Start_Ref_Drive" 9 "Speed_Ramp_0" 10 "_Start_Dest_Var_1" 11 "_Start_Dest_Var_2" 12 "N_cmd_Reverse" 13 "_Preset_Pos_Var_3" 14 "_Capture_Var_3_Pos" 15 "_Capture_Var_4_Pos" 16 "_Switch_Spd_Ain1_Ain2" 17 "_Switch_Spd_Var1_Var2" 18 "I_limit_dig_" 19 "N_clip_neg_pos_" 20 "_Switch_Cmd_Dig_Ana" 21 "Speed_Ramp_0_Pos" 22 "Handwheel" 23 "Brake_Car" 24 "Recup_Disabled" 25 "Rising_Bank_1,_Falling_Bank_0" 26 "_Start_Dest_Var_1,_2,_3,_4" 27 "_Start_CW_Var_1,_2,_3,_4" 28 "Brake_Car_Nr2" ;
VAL_ 513 def_DIN_1 0 "_Off_" 1 "Ref_and_Limit_Plus" 2 "Ref_and_Limit_Minus" 3 "Ref_Plus" 4 "Limit_Plus" 5 "Limit_Minus" 6 "Limit_Plus_and_Minus" 7 "Cancel_Error_s_" 8 "_Start_Ref_Drive" 9 "Speed_Ramp_0" 10 "_Start_Dest_Var_1" 11 "_Start_Dest_Var_2" 12 "N_cmd_Reverse" 13 "_Preset_Pos_Var_3" 14 "_Capture_Var_3_Pos" 15 "_Capture_Var_4_Pos" 16 "_Switch_Spd_Ain1_Ain2" 17 "_Switch_Spd_Var1_Var2" 18 "I_limit_dig_" 19 "N_clip_neg_pos_" 20 "_Switch_Cmd_Dig_Ana" 21 "Speed_Ramp_0_Pos" 22 "Handwheel" 23 "Brake_Car" 24 "Recup_Disabled" 25 "Rising_Bank_1,_Falling_Bank_0" 26 "_Start_Dest_Var_1,_2,_3,_4" 27 "_Start_CW_Var_1,_2,_3,_4" 28 "Brake_Car_Nr2" ;
VAL_ 513 def_END_2 0 "_Off_" 1 "Ref_and_Limit_Plus" 2 "Ref_and_Limit_Minus" 3 "Ref_Plus" 4 "Limit_Plus" 5 "Limit_Minus" 6 "Limit_Plus_and_Minus" 7 "Cancel_Error_s_" 8 "_Start_Ref_Drive" 9 "Speed_Ramp_0" 10 "_Start_Dest_Var_1" 11 "_Start_Dest_Var_2" 12 "N_cmd_Reverse" 13 "_Preset_Pos_Var_3" 14 "_Capture_Var_3_Pos" 15 "_Capture_Var_4_Pos" 16 "_Switch_Spd_Ain1_Ain2" 17 "_Switch_Spd_Var1_Var2" 18 "I_limit_dig_" 19 "N_clip_neg_pos_" 20 "_Switch_Cmd_Dig_Ana" 21 "Speed_Ramp_0_Pos" 22 "Handwheel" 23 "Brake_Car" 24 "Recup_Disabled" 25 "Rising_Bank_1,_Falling_Bank_0" 26 "_Start_Dest_Var_1,_2,_3,_4" 27 "_Start_CW_Var_1,_2,_3,_4" 28 "Brake_Car_Nr2" ;
VAL_ 513 def_END_1 0 "_Off_" 1 "Ref_and_Limit_Plus" 2 "Ref_and_Limit_Minus" 3 "Ref_Plus" 4 "Limit_Plus" 5 "Limit_Minus" 6 "Limit_Plus_and_Minus" 7 "Cancel_Error_s_" 8 "_Start_Ref_Drive" 9 "Speed_Ramp_0" 10 "_Start_Dest_Var_1" 11 "_Start_Dest_Var_2" 12 "N_cmd_Reverse" 13 "_Preset_Pos_Var_3" 14 "_Capture_Var_3_Pos" 15 "_Capture_Var_4_Pos" 16 "_Switch_Spd_Ain1_Ain2" 17 "_Switch_Spd_Var1_Var2" 18 "I_limit_dig_" 19 "N_clip_neg_pos_" 20 "_Switch_Cmd_Dig_Ana" 21 "Speed_Ramp_0_Pos" 22 "Handwheel" 23 "Brake_Car" 24 "Recup_Disabled" 25 "Rising_Bank_1,_Falling_Bank_0" 26 "_Start_Dest_Var_1,_2,_3,_4" 27 "_Start_CW_Var_1,_2,_3,_4" 28 "Brake_Car_Nr2" ;
VAL_ 513 MO_Feedback_1 0 "Rot_Enc_TTL" 1 "Resolver" 2 "Abs_Enc_SC" 3 "Rot_Tacho" 4 "Rot" 5 "DC_Tacho" 6 "DC_Arm" 7 "BL_Arm" 8 "Enc_TTL" 9 "Enc_SC" 10 "Abs_SC" 11 "DC_Arm_Vir" 12 "SLS" 13 "SLS_SMO" 14 "SLS_Usens" 15 "AnaIn1_calc" 16 "AnaIn2_calc" 17 "Panasonic" 18 "DC_Bus" ;
VAL_ 513 Eprom132 0 "Sector_0" 1 "Sector_1" 2 "Sector_2" ;
VAL_ 513 Eprom131 0 "Sector_0" 1 "Sector_1" 2 "Sector_2" ;
VAL_ 513 CAN_NBT 16386 "1000_kbps" 16421 "500_kbps" 16404 "625_kbps" 16476 "250_kbps" 17445 "100_kbps" ;
VAL_ 513 DeviceType 0 "Homemade" 14 "DS205_2ph_230V" 15 "DS403_2ph_400V" 16 "DS205_neu_230V" 17 "DS403_neu_400V" 19 "DS405" 21 "DS412" 23 "DS420" 25 "DS450" 27 "DS475" 29 "DS4100" 48 "DS4820" 49 "DS451" 51 "DS476" 56 "DS8020" 60 "DPC440" 65 "DPC460" 67 "DPC460_DC1Q_3P" 81 "BAMO_160_60" 83 "BAMO_160_120" 85 "BAMO_160_180" 87 "BAMO_360_60" 89 "BAMO_360_120" 91 "BAMO_360_180" 93 "BAMO_360_240" 112 "BAMOBIL_D3_3_62_80" 113 "BAMOBIL_D3_2_62_80" 114 "BAMOBIL_D3_3_62_120" 115 "BAMOBIL_D3_2_62_120" 116 "BAMOBIL_D3_3_62_250" 117 "BAMOBIL_D3_2_62_250" 118 "BAMOBIL_D3_3_62_350" 119 "BAMOBIL_D3_2_62_350" 120 "BAMOBIL_D3_3_62_450" 121 "BAMOBIL_D3_2_62_450" 122 "BAMOBIL_D3_3_160_50" 123 "BAMOBIL_D3_2_160_50" 124 "BAMOBIL_D3_3_160_100" 125 "BAMOBIL_D3_2_160_100" 126 "BAMOBIL_D3_3_160_200" 127 "BAMOBIL_D3_2_160_200" 192 "Bamocar_700_160" 193 "Bamocar_700_100" 194 "Bamocar_700_900" 203 "Bamocar_700_200_DC" 204 "Bamocar_400_400" 205 "Bamocar_700_400" 206 "Bamocar_400_250" 240 "Koepfer_V1_700_400" 241 "Koepfer_V2_700_400" ;
VAL_ 513 Read_ID 5 "05h_Motor_F_nom" 6 "06h_Motor_V_nom" 7 "07h_FU_T_dc" 8 "08h_FU_V_dc" 9 "09h_FU_Special" 10 "0Ah_FU_U_min" 11 "0Bh_FU_F_min" 12 "0Ch_FU_V_corner" 13 "0Dh_FU_F_corner" 14 "0Eh_Motor_Cos_Phi" 15 "0Fh_FU_Extra" 16 "10h_Oszi_Channel" 17 "11h_Control_Status" 18 "12h_Oszi_Triger_Level" 19 "13h_Oszi_Triger_Edge" 20 "14h_Oszi_Triger_Source" 21 "15h_Oszi_Source" 22 "16h_Oszi_Skip" 23 "17h_Oszi_Read_cmd" 24 "18h_Oszi_Run_cmd" 25 "19h_PWM_Enum" 26 "1Ah_Calib_Ref_Value" 27 "1Bh_FW_Nr" 28 "1Ch_I_Kp" 29 "1Dh_I_Ti" 30 "1Eh_Cutoffdig" 31 "1Fh_I3_Offset" 32 "20h_I_Actual" 33 "21h_Id_setdig" 34 "22h_I_cmd_ramp" 35 "23h_Id_Ref" 36 "24h_I_Max_Inuse" 37 "25h_I_Delta_Ramp" 38 "26h_I_cmd" 39 "27h_Iq_Actual" 40 "28h_Id_Actual" 41 "29h_Vq_Output" 42 "2Ah_Vd_Output" 43 "2Bh_I_TiM" 44 "2Ch_n_Kp" 45 "2Dh_n_Ti" 46 "2Eh_n_Td" 47 "2Fh_Ain_in_1_OffsScale" 48 "30h_N_Actual" 49 "31h_N_setdig" 50 "32h_N_cmd_ramp" 51 "33h_N_Error" 52 "34h_N_Lim" 53 "35h_Acc_Ramps" 54 "36h_CommandSource" 55 "37h_DZR_Sequencer_Value" 56 "38h_Iq_Error" 57 "39h_Id_Error" 59 "3Bh_n_TiM" 60 "3Ch_I_Derating_N_perc" 62 "3Eh_N_Lim_minus" 63 "3Fh_N_Lim_plus" 64 "40h_Status_Map" 65 "41h_Incr_Delta" 66 "42h_MotorPosition_Mech" 67 "43h_MotorPosition_Elec" 68 "44h_FeedBack_Offset_Angle" 69 "45h_Ixt_and_RegenE_Monitor" 70 "46h_I_lim_dig_perc" 72 "48h_I_Limit_Inuse" 73 "49h_T_Motor" 74 "4Ah_T_Igbt" 75 "4Bh_T_Air_Inside" 76 "4Ch_I_Derating_TE" 77 "4Dh_Motor_I_max_eff" 78 "4Eh_Motor_I_nom_eff" 79 "4Fh_Motor_Pole" 80 "50h_Ain_in_1_Cutoff" 81 "51h_Kern_Mode_State" 82 "52h_Status_Mask" 83 "53h_Ain_in_2_Cutoff" 84 "54h_I1_Actual" 85 "55h_I2_Actual" 86 "56h_I3_Actual" 87 "57h_I_Limit_Inuse_ramp" 88 "58h_I_Derating_TD" 89 "59h_Motor_Nom" 90 "5Ah_Device_Options" 91 "5Bh_SpeedControl_Kacc" 92 "5Ch_Rotor_Signals" 93 "5Dh_N_cmd" 94 "5Eh_Speed_Filter" 95 "5Fh_I_Actual_Filt" 96 "60h_Ain_in_X_Filter" 97 "61h_Ixt_Monitor" 98 "62h_SerialNumber" 99 "63h_FPGA_Status" 100 "64h_Device_Mains" 101 "65h_Regen_P_R" 103 "67h_Device_Type" 104 "68h_CAN_ID_Rx" 105 "69h_CAN_ID_Tx" 106 "6Ah_Pos_Kp" 107 "6Bh_Pos_Ti" 108 "6Ch_Pos_Td" 109 "6Dh_Pos_Actual" 110 "6Eh_Pos_Dest" 111 "6Fh_Pos_Actual_2" 112 "70h_Pos_Err" 113 "71h_Pos_TiM" 114 "72h_Pos_OffsetRef" 115 "73h_CAN_NBT" 116 "74h_Pos_Zero_Capture" 117 "75h_Pos_Ref_Reso_Edge" 118 "76h_Pos_Speed_1" 119 "77h_Pos_Speed_2" 120 "78h_Pos_Ref_Start" 121 "79h_Pos_Tol_Win" 122 "7Ah_Pos_Preset" 123 "7Bh_Pos_Zero_Offset" 124 "7Ch_Pos_ND_Scale" 125 "7Dh_Pos_ND_Offset" 126 "7Eh_Pos_FB2_Scale_Fac_Ext" 127 "7Fh_Pos_Offset_Slack" 128 "80h_Pos_Diff_Slack" 131 "83h_Func_Para_Read" 132 "84h_Func_Para_Write" 133 "85h_Func_Special" 136 "88h_CAN_ID_2_Rx" 137 "89h_CAN_ID_2_Tx" 138 "8Ah_Vout" 139 "8Bh_V_Ref" 140 "8Ch_V_Kp" 141 "8Dh_V_Ti" 142 "8Eh_Clear_Error_List" 143 "8Fh_ErrorWarning_Map" 144 "90h_M_setdig" 145 "91h_Pos_cmd_int" 146 "92h_CAN_Error_BusOff_cntr" 147 "93h_CAN_Error_WriteTime_cntr" 148 "94h_CAN_Error_RxMsgLost_cntr" 149 "95h_CAN_Error_NoAck_cntr" 150 "96h_CAN_Error_CRC_Check_cntr" 151 "97h_CAN_Error_Bit_cntr" 153 "99h_Info_Timer_Diff" 154 "9Ah_Temp_DEBUG" 160 "A0h_Mout" 161 "A1h_Ballast_cntr" 162 "A2h_I_Derating_TM" 163 "A3h_M_Temp" 164 "A4h_Motor_Options" 165 "A5h_DC_Bus_MinMax_Lim" 166 "A6h_FB_IncPerRot" 167 "A7h_FB_Pole" 168 "A8h_N_Actual_Filt" 169 "A9h_I3_ADC" 170 "AAh_I2_ADC" 171 "ABh_Logic_Freq" 172 "ACh_PWM_1_56" 173 "ADh_PWM_2_34" 174 "AEh_PWM_3_12" 175 "AFh_Timer_Delta" 177 "B1h_Motor_Lsq" 178 "B2h_Id_Nom" 179 "B3h_Motor_Lm" 180 "B4h_Motor_Rr" 181 "B5h_Id_Min" 182 "B6h_Motor_Tr" 184 "B8h_Ptr_1_DEBUG" 186 "BAh_Ptr_2_DEBUG" 187 "BBh_Motor_Lsd" 188 "BCh_Motor_Rs" 189 "BDh_Motor_Ts" 190 "BEh_def_END_1" 191 "BFh_def_END_2" 192 "C0h_def_DIN_1" 193 "C1h_def_DIN_2" 194 "C2h_def_OUT_1" 195 "C3h_def_OUT_2" 196 "C4h_I_max_pk" 197 "C5h_I_con_eff" 198 "C6h_I_device" 199 "C7h_RLim_MRcp_Ramp" 200 "C8h_Nmax100perc" 201 "C9h_I_xKp" 202 "CAh_Bat_Opr_Limits" 203 "CBh_I_Kf" 204 "CCh_Car_Mode_Status" 205 "CDh_Car_Mode_Config" 206 "CEh_N_Rpm_MaxInt" 208 "D0h_CAN_Timeout" 209 "D1h_Var_1" 210 "D2h_Var_2" 211 "D3h_Var_3" 212 "D4h_Var_4" 213 "D5h_Ain_in_1" 214 "D6h_Ain_in_2" 215 "D7h_Ain_in_2_OffsScale" 216 "D8h_LogicReadBitsIN_OUT" 217 "D9h_I_200perc" 218 "DAh_def_OUT_3" 219 "DBh_def_OUT_4" 220 "DCh_DAC_Source_ID" 222 "DEh_DS_DOUT_3" 223 "DFh_DS_DOUT_4" 224 "E0h_DS_DOUT_1" 225 "E1h_DS_DOUT_2" 226 "E2h_DS_Rdy_BTB" 227 "E3h_DS_GO" 228 "E4h_DS_END_1" 229 "E5h_DS_END_2" 230 "E6h_DS_DIN_1" 231 "E7h_DS_DIN_2" 232 "E8h_DS_RUN" 233 "E9h_DS_I_Fault" 235 "EBh_Vdc_Bus" 236 "ECh_DS_FB_LossOfSignal" 237 "EDh_Dec_Ramps" 238 "EEh_V_Shunt" 239 "EFh_DS_NoHWFault" 240 "F0h_T_peak" 241 "F1h_Brake_Delay" 242 "F2h_DS_Brake" 243 "F3h_DS_Icns" 244 "F4h_DS_PosTolerance" 245 "F5h_DS_LessN0" 246 "F6h_Inverter_Power" 247 "F7h_Inverter_Work" 248 "F8h_Axis" 251 "FBh_Ain_in_1_Calc" 252 "FCh_Ain_in_2_Calc" 102 "66h_DC_Bus_Voltage" 58 "3Ah_M_cmd_ramp" 254 "FEh_Subv_SVNRev_Nr" ;
VAL_ 513 CS_Ain_1_Format 0 "Off" 1 "_Cmd" 2 "_Cmd" 3 "sq_Cmd_" ;
VAL_ 513 Send_Mux 4 "ID_04_USER_Key" 5 "ID_05_Motor_F_nom" 7 "ID_07_FU_T_dc" 8 "ID_08_FU_V_dc" 9 "ID_09_FU_Special" 10 "ID_0A_FU_U_min" 11 "ID_0B_FU_F_min" 12 "ID_0C_FU_V_corner" 13 "ID_0D_FU_F_corner" 14 "ID_0E_Motor_Cos_Phi" 15 "ID_0F_FU_Extra" 16 "ID_10_Oszi_Channel" 18 "ID_12_Oszi_Triger_Level" 19 "ID_13_Oszi_Triger_Edge" 20 "ID_14_Oszi_Triger_Source" 21 "ID_15_Oszi_Source" 22 "ID_16_Oszi_Skip" 23 "ID_17_Oszi_Read_cmd" 24 "ID_18_Oszi_Run_cmd" 26 "ID_1A_Calib_Ref_Value" 28 "ID_1C_PID_I_Kp" 29 "ID_1D_PID_I_Ti" 30 "ID_1E_Cutoffdig" 33 "ID_21_Id_setdig" 37 "ID_25_I_Delta_Ramp" 43 "ID_2B_PID_I_TiM" 44 "ID_2C_PID_n_Kp" 45 "ID_2D_PID_n_Ti" 46 "ID_2E_PID_n_Td" 47 "ID_2F_Ain_in_1_OffsScale" 49 "ID_31_N_setdig" 52 "ID_34_N_Lim" 53 "ID_35_Acc_Ramps" 54 "ID_36_CommandSource" 59 "ID_3B_PID_n_TiM" 60 "ID_3C_I_Derating_N_perc" 62 "ID_3E_N_Lim_minus" 63 "ID_3F_N_Lim_plus" 68 "ID_44_FeedBack_Offset_Angle" 61 "ID_3D_Read_Cmd" 70 "ID_46_I_lim_dig_perc" 76 "ID_4C_I_Derating_TE" 77 "ID_4D_Motor_I_max_eff_Arms" 78 "ID_4E_Motor_I_nom_eff_Arms" 79 "ID_4F_Motor_Pole_Number" 80 "ID_50_Ain_in_1_Cutoff" 81 "ID_51_Kern_Mode_State" 83 "ID_53_Ain_in_2_Cutoff" 88 "ID_58_I_Derating_TD" 89 "ID_59_Motor_Nominal_Speed" 90 "ID_5A_Device_Options" 91 "ID_5B_PID_n_Kacc" 94 "ID_5E_Speed_Filter" 96 "ID_60_Ain_in_X_Filter" 98 "ID_62_SerialNumber" 100 "ID_64_Device_Mains_Supply_V" 101 "ID_65_Regen_Resistor_P_and_R" 103 "ID_67_Device_Type" 104 "ID_68_CAN_ID_Rx" 105 "ID_69_CAN_ID_Tx" 106 "ID_6A_Pos_PID_Kp" 107 "ID_6B_Pos_PID_Ti" 108 "ID_6C_Pos_PID_Td" 110 "ID_6E_Pos_Destination" 113 "ID_71_Pos_PID_TiM" 114 "ID_72_Pos_OffsetReference" 115 "ID_73_CAN_NBT" 117 "ID_75_Pos_Ref_Reso_Edge" 118 "ID_76_Pos_Calib_Speed_1" 119 "ID_77_Pos_Calib_Speed_2" 121 "ID_79_Pos_Tol_Window" 122 "ID_7A_Pos_Preset_Value" 124 "ID_7C_Pos_NDrive_Scale" 125 "ID_7D_Pos_NDrive_Offset" 126 "ID_7E_Pos_FB2_Scale_Fac_Ext" 127 "ID_7F_Pos_Offset_Slack" 128 "ID_80_Pos_Diff_Slack" 131 "ID_83_Function_Parameter_Read" 132 "ID_84_Function_Parameter_Write" 133 "ID_85_Function_Special" 136 "ID_88_CAN_ID_2_Rx" 137 "ID_89_CAN_ID_2_Tx" 139 "ID_8B_VoltageControl_Ref" 140 "ID_8C_VoltageControl_Kp" 141 "ID_8D_VoltageControl_Ti" 142 "ID_8E_Clear_Error_List" 144 "ID_90_M_setdig" 162 "ID_A2_I_Derating_TM" 163 "ID_A3_Motor_Temp_Error_Lim" 164 "ID_A4_Motor_Options" 165 "ID_A5_Device_DC_Bus_MinMax_Lim" 166 "ID_A6_FB_IncrementsPerRot" 167 "ID_A7_FB_Pole_Number" 177 "ID_B1_Motor_L_Sigma_Q" 178 "ID_B2_Id_Nominal" 179 "ID_B3_Motor_Magn_Inductance" 180 "ID_B4_Motor_Rotor_Resistance" 181 "ID_B5_Id_Minimum" 182 "ID_B6_Time_Constant_Rotor" 187 "ID_BB_Motor_L_Sigma_D" 188 "ID_BC_Motor_Stator_Resistance" 189 "ID_BD_Time_Constant_Stator" 190 "ID_BE_LogicDefine_of_END_1" 191 "ID_BF_LogicDefine_of_END_2" 192 "ID_C0_LogicDefine_of_DIN_1" 193 "ID_C1_LogicDefine_of_DIN_2" 194 "ID_C2_LogicDefine_of_OUT_1" 195 "ID_C3_LogicDefine_of_OUT_2" 218 "ID_DA_LogicDefine_of_OUT_3" 219 "ID_DB_LogicDefine_of_OUT_4" 196 "ID_C4_I_max_pk_perc" 197 "ID_C5_I_con_eff_perc" 198 "ID_C6_I_device" 199 "ID_C7_RLim_MRcp_Ramp" 200 "ID_C8_Nmax100perc" 201 "ID_C9_CurrentControl_xKp" 202 "ID_CA_Bat_Opr_Limits" 203 "ID_CB_PID_I_Kf" 205 "ID_CD_Car_Mode_Config" 208 "ID_D0_CAN_Timeout" 209 "ID_D1_Var_1" 210 "ID_D2_Var_2" 211 "ID_D3_Var_3" 212 "ID_D4_Var_4" 215 "ID_D7_Ain_in_2_OffsScale" 220 "ID_DC_DAC_Source_ID" 237 "ID_ED_Dec_Ramps" 238 "ID_EE_V_Shunt" 240 "ID_F0_Time_I_Peak" 241 "ID_F1_Brake_Delay" 248 "ID_F8_Axis_Label" ;
VAL_ 385 PWM_Freq 0 "8_kHz" 1 "24_kHz" 2 "20_kHz" 3 "16_kHz" 4 "12_kHz" 5 "8_kHz_i16" 6 "6_kHz_i12" 7 "4_kHz_i12" ;
VAL_ 385 Active193 0 "Low" 1 "High" ;
VAL_ 385 Active192 0 "Low" 1 "High" ;
VAL_ 385 Active191 0 "Low" 1 "High" ;
VAL_ 385 Active190 0 "Low" 1 "High" ;
VAL_ 385 MO_sc2_reso 1 "14_bit" 2 "12_bit" 3 "10_bit" ;
VAL_ 385 CurrentMode 0 "PWM_FIX" 1 "BOTTOM_W" 2 "BOTTOM_V" 3 "BOTTOM_U" 4 "DEFINE_CMD" 5 "CURRENT_RAMP" ;
VAL_ 385 CS_CMD_Type 0 "Digital_Commands" 1 "Dig_Ana_Speed" 2 "Analog_Speed" 3 "Analog_Torque" ;
VAL_ 385 MotorType 0 "EC_Servo" 1 "ACI_V_f" 2 "ACI_Servo" 3 "DC" ;
VAL_ 385 Source_ID219 93 "5Dh_N_cmd_int_" 50 "32h_N_cmd_ramp_" 48 "30h_N_Actual" 168 "A8h_N_Actual_Filt" 51 "33h_N_Error" 38 "26h_I_cmd" 34 "22h_I_cmd_ramp_" 32 "20h_I_Actual" 95 "5Fh_I_Actual_Filt" 110 "6Eh_Pos_Destination" 145 "91h_Pos_cmd" 109 "6Dh_Pos_Actual" 112 "70h_Pos_Error" 116 "74h_Pos_ZeroCapture" 228 "E4h_DigInput_END_1" 229 "E5h_DigInput_END_2" 230 "E6h_DigInput_DIN_1" 231 "E7h_DigInput_DIN_2" 232 "E8h_DigInput_RUN" 224 "E0h_DigOutput_DOUT_1" 225 "E1h_DigOutput_DOUT_2" 222 "DEh_DigOutput_DOUT_3" 223 "DFh_DigOutput_DOUT_4" 226 "E2h_DigOutput_Rdy_BTB" 233 "E9h_Error_I_Fault" 234 "EAh_I_Ballast_Act" 36 "24h_I_Max_Inuse" 236 "ECh_FB_LossOfSignal" 0 "_Off_" 227 "E3h_DigSignal_GO" 242 "F2h_DigSignal_Brake" 243 "F3h_DigSignal_Icns" 245 "F5h_DigSignal_LessN0" 244 "F4h_DigSignal_PosToler_Set" 92 "5Ch_Rotor_Signals" 209 "D1h_Var_1" 210 "D2h_Var_2" 211 "D3h_Var_3" 212 "D4h_Var_4" 213 "D5h_Ain_In_1" 214 "D6h_Ain_In_2" 66 "42h_MotorPos_Mech" 67 "43h_MotorPos_Elec" 169 "A9h_I3_Adc_Value" 170 "AAh_I2_Adc_Value" 84 "54h_I1_Actual" 85 "55h_I2_Actual" 86 "56h_I3_Actual" 39 "27h_Iq_Actual" 40 "28h_Id_Actual" 56 "38h_Iq_Error" 57 "39h_Id_Error" 35 "23h_Id_Ref" 181 "B5h_Id_Min" 97 "61h_Ixt_Monitor" 72 "48h_I_Limit_Inuse" 87 "57h_I_Limit_Inuse_ramp_" 251 "FBh_Ain_1_Calc" 252 "FCh_Ain_2_Calc" 41 "29h_Vq_Output" 42 "2Ah_Vd_Output" 138 "8Ah_V_Output" 139 "8Bh_V_Red_Ref_" 140 "8Ch_V_Control_Kp" 141 "8Dh_V_Control_Ti" 172 "ACh_PWM_1_5_6_" 173 "ADh_PWM_2_3_4_" 174 "AEh_PWM_3_1_2_" 73 "49h_T_Motor" 74 "4Ah_T_Igbt" 75 "4Bh_T_Air_Inside" 69 "45h_It_Rg_Monitor" 154 "9Ah_Temp_DEBUG" 171 "ABh_Logic_Freq" 184 "B8h_Ptr_1_DEBUG" 186 "BAh_Ptr_2_DEBUG" 143 "8Fh_ErrorWarning_Map" 64 "40h_Status_Map" 65 "41h_Incr_Delta" 52 "34h_N_Lim" 99 "63h_FPGA_Status" 49 "31h_N_set_dig_" 144 "90h_M_set_dig_" 160 "A0h_M_out_dig_" 111 "6Fh_Pos_Actual_2" 152 "98h_Logic_O_Block" 155 "9Bh_Logic_I_Block" 2 "02h_SC_Info" 235 "EBh_Vdc_Bus" 102 "66h_Vdc_Bus_Filt" 153 "99h_Info_Timer_Diff" 161 "A1h_Ballast_cntr" 81 "51_Kern_Mode_State" 17 "11h_Control_Status" ;
VAL_ 385 Source_ID218 93 "5Dh_N_cmd_int_" 50 "32h_N_cmd_ramp_" 48 "30h_N_Actual" 168 "A8h_N_Actual_Filt" 51 "33h_N_Error" 38 "26h_I_cmd" 34 "22h_I_cmd_ramp_" 32 "20h_I_Actual" 95 "5Fh_I_Actual_Filt" 110 "6Eh_Pos_Destination" 145 "91h_Pos_cmd" 109 "6Dh_Pos_Actual" 112 "70h_Pos_Error" 116 "74h_Pos_ZeroCapture" 228 "E4h_DigInput_END_1" 229 "E5h_DigInput_END_2" 230 "E6h_DigInput_DIN_1" 231 "E7h_DigInput_DIN_2" 232 "E8h_DigInput_RUN" 224 "E0h_DigOutput_DOUT_1" 225 "E1h_DigOutput_DOUT_2" 222 "DEh_DigOutput_DOUT_3" 223 "DFh_DigOutput_DOUT_4" 226 "E2h_DigOutput_Rdy_BTB" 233 "E9h_Error_I_Fault" 234 "EAh_I_Ballast_Act" 36 "24h_I_Max_Inuse" 236 "ECh_FB_LossOfSignal" 0 "_Off_" 227 "E3h_DigSignal_GO" 242 "F2h_DigSignal_Brake" 243 "F3h_DigSignal_Icns" 245 "F5h_DigSignal_LessN0" 244 "F4h_DigSignal_PosToler_Set" 92 "5Ch_Rotor_Signals" 209 "D1h_Var_1" 210 "D2h_Var_2" 211 "D3h_Var_3" 212 "D4h_Var_4" 213 "D5h_Ain_In_1" 214 "D6h_Ain_In_2" 66 "42h_MotorPos_Mech" 67 "43h_MotorPos_Elec" 169 "A9h_I3_Adc_Value" 170 "AAh_I2_Adc_Value" 84 "54h_I1_Actual" 85 "55h_I2_Actual" 86 "56h_I3_Actual" 39 "27h_Iq_Actual" 40 "28h_Id_Actual" 56 "38h_Iq_Error" 57 "39h_Id_Error" 35 "23h_Id_Ref" 181 "B5h_Id_Min" 97 "61h_Ixt_Monitor" 72 "48h_I_Limit_Inuse" 87 "57h_I_Limit_Inuse_ramp_" 251 "FBh_Ain_1_Calc" 252 "FCh_Ain_2_Calc" 41 "29h_Vq_Output" 42 "2Ah_Vd_Output" 138 "8Ah_V_Output" 139 "8Bh_V_Red_Ref_" 140 "8Ch_V_Control_Kp" 141 "8Dh_V_Control_Ti" 172 "ACh_PWM_1_5_6_" 173 "ADh_PWM_2_3_4_" 174 "AEh_PWM_3_1_2_" 73 "49h_T_Motor" 74 "4Ah_T_Igbt" 75 "4Bh_T_Air_Inside" 69 "45h_It_Rg_Monitor" 154 "9Ah_Temp_DEBUG" 171 "ABh_Logic_Freq" 184 "B8h_Ptr_1_DEBUG" 186 "BAh_Ptr_2_DEBUG" 143 "8Fh_ErrorWarning_Map" 64 "40h_Status_Map" 65 "41h_Incr_Delta" 52 "34h_N_Lim" 99 "63h_FPGA_Status" 49 "31h_N_set_dig_" 144 "90h_M_set_dig_" 160 "A0h_M_out_dig_" 111 "6Fh_Pos_Actual_2" 152 "98h_Logic_O_Block" 155 "9Bh_Logic_I_Block" 2 "02h_SC_Info" 235 "EBh_Vdc_Bus" 102 "66h_Vdc_Bus_Filt" 153 "99h_Info_Timer_Diff" 161 "A1h_Ballast_cntr" 81 "51_Kern_Mode_State" 17 "11h_Control_Status" ;
VAL_ 385 Source_ID195 93 "5Dh_N_cmd_int_" 50 "32h_N_cmd_ramp_" 48 "30h_N_Actual" 168 "A8h_N_Actual_Filt" 51 "33h_N_Error" 38 "26h_I_cmd" 34 "22h_I_cmd_ramp_" 32 "20h_I_Actual" 95 "5Fh_I_Actual_Filt" 110 "6Eh_Pos_Destination" 145 "91h_Pos_cmd" 109 "6Dh_Pos_Actual" 112 "70h_Pos_Error" 116 "74h_Pos_ZeroCapture" 228 "E4h_DigInput_END_1" 229 "E5h_DigInput_END_2" 230 "E6h_DigInput_DIN_1" 231 "E7h_DigInput_DIN_2" 232 "E8h_DigInput_RUN" 224 "E0h_DigOutput_DOUT_1" 225 "E1h_DigOutput_DOUT_2" 222 "DEh_DigOutput_DOUT_3" 223 "DFh_DigOutput_DOUT_4" 226 "E2h_DigOutput_Rdy_BTB" 233 "E9h_Error_I_Fault" 234 "EAh_I_Ballast_Act" 36 "24h_I_Max_Inuse" 236 "ECh_FB_LossOfSignal" 0 "_Off_" 227 "E3h_DigSignal_GO" 242 "F2h_DigSignal_Brake" 243 "F3h_DigSignal_Icns" 245 "F5h_DigSignal_LessN0" 244 "F4h_DigSignal_PosToler_Set" 92 "5Ch_Rotor_Signals" 209 "D1h_Var_1" 210 "D2h_Var_2" 211 "D3h_Var_3" 212 "D4h_Var_4" 213 "D5h_Ain_In_1" 214 "D6h_Ain_In_2" 66 "42h_MotorPos_Mech" 67 "43h_MotorPos_Elec" 169 "A9h_I3_Adc_Value" 170 "AAh_I2_Adc_Value" 84 "54h_I1_Actual" 85 "55h_I2_Actual" 86 "56h_I3_Actual" 39 "27h_Iq_Actual" 40 "28h_Id_Actual" 56 "38h_Iq_Error" 57 "39h_Id_Error" 35 "23h_Id_Ref" 181 "B5h_Id_Min" 97 "61h_Ixt_Monitor" 72 "48h_I_Limit_Inuse" 87 "57h_I_Limit_Inuse_ramp_" 251 "FBh_Ain_1_Calc" 252 "FCh_Ain_2_Calc" 41 "29h_Vq_Output" 42 "2Ah_Vd_Output" 138 "8Ah_V_Output" 139 "8Bh_V_Red_Ref_" 140 "8Ch_V_Control_Kp" 141 "8Dh_V_Control_Ti" 172 "ACh_PWM_1_5_6_" 173 "ADh_PWM_2_3_4_" 174 "AEh_PWM_3_1_2_" 73 "49h_T_Motor" 74 "4Ah_T_Igbt" 75 "4Bh_T_Air_Inside" 69 "45h_It_Rg_Monitor" 154 "9Ah_Temp_DEBUG" 171 "ABh_Logic_Freq" 184 "B8h_Ptr_1_DEBUG" 186 "BAh_Ptr_2_DEBUG" 143 "8Fh_ErrorWarning_Map" 64 "40h_Status_Map" 65 "41h_Incr_Delta" 52 "34h_N_Lim" 99 "63h_FPGA_Status" 49 "31h_N_set_dig_" 144 "90h_M_set_dig_" 160 "A0h_M_out_dig_" 111 "6Fh_Pos_Actual_2" 152 "98h_Logic_O_Block" 155 "9Bh_Logic_I_Block" 2 "02h_SC_Info" 235 "EBh_Vdc_Bus" 102 "66h_Vdc_Bus_Filt" 153 "99h_Info_Timer_Diff" 161 "A1h_Ballast_cntr" 81 "51_Kern_Mode_State" 17 "11h_Control_Status" ;
VAL_ 385 Source_ID194 93 "5Dh_N_cmd_int_" 50 "32h_N_cmd_ramp_" 48 "30h_N_Actual" 168 "A8h_N_Actual_Filt" 51 "33h_N_Error" 38 "26h_I_cmd" 34 "22h_I_cmd_ramp_" 32 "20h_I_Actual" 95 "5Fh_I_Actual_Filt" 110 "6Eh_Pos_Destination" 145 "91h_Pos_cmd" 109 "6Dh_Pos_Actual" 112 "70h_Pos_Error" 116 "74h_Pos_ZeroCapture" 228 "E4h_DigInput_END_1" 229 "E5h_DigInput_END_2" 230 "E6h_DigInput_DIN_1" 231 "E7h_DigInput_DIN_2" 232 "E8h_DigInput_RUN" 224 "E0h_DigOutput_DOUT_1" 225 "E1h_DigOutput_DOUT_2" 222 "DEh_DigOutput_DOUT_3" 223 "DFh_DigOutput_DOUT_4" 226 "E2h_DigOutput_Rdy_BTB" 233 "E9h_Error_I_Fault" 234 "EAh_I_Ballast_Act" 36 "24h_I_Max_Inuse" 236 "ECh_FB_LossOfSignal" 0 "_Off_" 227 "E3h_DigSignal_GO" 242 "F2h_DigSignal_Brake" 243 "F3h_DigSignal_Icns" 245 "F5h_DigSignal_LessN0" 244 "F4h_DigSignal_PosToler_Set" 92 "5Ch_Rotor_Signals" 209 "D1h_Var_1" 210 "D2h_Var_2" 211 "D3h_Var_3" 212 "D4h_Var_4" 213 "D5h_Ain_In_1" 214 "D6h_Ain_In_2" 66 "42h_MotorPos_Mech" 67 "43h_MotorPos_Elec" 169 "A9h_I3_Adc_Value" 170 "AAh_I2_Adc_Value" 84 "54h_I1_Actual" 85 "55h_I2_Actual" 86 "56h_I3_Actual" 39 "27h_Iq_Actual" 40 "28h_Id_Actual" 56 "38h_Iq_Error" 57 "39h_Id_Error" 35 "23h_Id_Ref" 181 "B5h_Id_Min" 97 "61h_Ixt_Monitor" 72 "48h_I_Limit_Inuse" 87 "57h_I_Limit_Inuse_ramp_" 251 "FBh_Ain_1_Calc" 252 "FCh_Ain_2_Calc" 41 "29h_Vq_Output" 42 "2Ah_Vd_Output" 138 "8Ah_V_Output" 139 "8Bh_V_Red_Ref_" 140 "8Ch_V_Control_Kp" 141 "8Dh_V_Control_Ti" 172 "ACh_PWM_1_5_6_" 173 "ADh_PWM_2_3_4_" 174 "AEh_PWM_3_1_2_" 73 "49h_T_Motor" 74 "4Ah_T_Igbt" 75 "4Bh_T_Air_Inside" 69 "45h_It_Rg_Monitor" 154 "9Ah_Temp_DEBUG" 171 "ABh_Logic_Freq" 184 "B8h_Ptr_1_DEBUG" 186 "BAh_Ptr_2_DEBUG" 143 "8Fh_ErrorWarning_Map" 64 "40h_Status_Map" 65 "41h_Incr_Delta" 52 "34h_N_Lim" 99 "63h_FPGA_Status" 49 "31h_N_set_dig_" 144 "90h_M_set_dig_" 160 "A0h_M_out_dig_" 111 "6Fh_Pos_Actual_2" 152 "98h_Logic_O_Block" 155 "9Bh_Logic_I_Block" 2 "02h_SC_Info" 235 "EBh_Vdc_Bus" 102 "66h_Vdc_Bus_Filt" 153 "99h_Info_Timer_Diff" 161 "A1h_Ballast_cntr" 81 "51_Kern_Mode_State" 17 "11h_Control_Status" ;
VAL_ 385 MO_sc1_reso 1 "14_bit" 2 "12_bit" 3 "10_bit" ;
VAL_ 385 CtrlSubMode 0 "UNASSIGNED" 1 "SPEED_NI" 2 "SPEED_PNI" 3 "POSITION_PNI" ;
VAL_ 385 CS_Ain_2_Mode 0 "_10_10V_" 1 "_0_10V_" 2 "_4_20mA_" 3 "_1_9V_" ;
VAL_ 385 MO_Feedback_2 0 "_" 1 "Enc_Position" 2 "Enc_Info" 3 "Enc_Hand_" 4 "SSI" ;
VAL_ 385 Compare_Var219 0 "_0_" 1 "_1_" 2 "_Var_1_" 3 "_Var_2_" 4 "_Var_3_" 5 "_Var_4_" 6 "_Ain_1_" 7 "_Ain_2_" ;
VAL_ 385 Compare_Var218 0 "_0_" 1 "_1_" 2 "_Var_1_" 3 "_Var_2_" 4 "_Var_3_" 5 "_Var_4_" 6 "_Ain_1_" 7 "_Ain_2_" ;
VAL_ 385 Compare_Var195 0 "_0_" 1 "_1_" 2 "_Var_1_" 3 "_Var_2_" 4 "_Var_3_" 5 "_Var_4_" 6 "_Ain_1_" 7 "_Ain_2_" ;
VAL_ 385 Compare_Var194 0 "_0_" 1 "_1_" 2 "_Var_1_" 3 "_Var_2_" 4 "_Var_3_" 5 "_Var_4_" 6 "_Ain_1_" 7 "_Ain_2_" ;
VAL_ 385 CS_Ain_1_Mode 0 "_10_10V_" 1 "_0_10V_" 2 "_4_20mA_" 3 "_1_9V_" ;
VAL_ 385 CS_Ain_2_Format 0 "Off" 1 "_Cmd_" 2 "_Cmd_" 3 "_Cmd" ;
VAL_ 385 Operand219 0 "Off" 1 "On" 2 "1_Hz" 3 "_" 4 "_" 5 "_>_" 6 "_<_" 7 "_abs_>_" 8 "_abs_<_" 9 "_tol_>_" 10 "_tol_<_" 11 "_>_" 12 "_<_" 13 "_hyst_>_" 14 "_hyst_<_" 15 "_window_" ;
VAL_ 385 Operand218 0 "Off" 1 "On" 2 "1_Hz" 3 "_" 4 "_" 5 "_>_" 6 "_<_" 7 "_abs_>_" 8 "_abs_<_" 9 "_tol_>_" 10 "_tol_<_" 11 "_>_" 12 "_<_" 13 "_hyst_>_" 14 "_hyst_<_" 15 "_window_" ;
VAL_ 385 Operand195 0 "Off" 1 "On" 2 "1_Hz" 3 "_" 4 "_" 5 "_>_" 6 "_<_" 7 "_abs_>_" 8 "_abs_<_" 9 "_tol_>_" 10 "_tol_<_" 11 "_>_" 12 "_<_" 13 "_hyst_>_" 14 "_hyst_<_" 15 "_window_" ;
VAL_ 385 Operand194 0 "Off" 1 "On" 2 "1_Hz" 3 "_" 4 "_" 5 "_>_" 6 "_<_" 7 "_abs_>_" 8 "_abs_<_" 9 "_tol_>_" 10 "_tol_<_" 11 "_>_" 12 "_<_" 13 "_hyst_>_" 14 "_hyst_<_" 15 "_window_" ;
VAL_ 385 def_DIN_2 0 "_Off_" 1 "Ref_and_Limit_Plus" 2 "Ref_and_Limit_Minus" 3 "Ref_Plus" 4 "Limit_Plus" 5 "Limit_Minus" 6 "Limit_Plus_and_Minus" 7 "Cancel_Error_s_" 8 "_Start_Ref_Drive" 9 "Speed_Ramp_0" 10 "_Start_Dest_Var_1" 11 "_Start_Dest_Var_2" 12 "N_cmd_Reverse" 13 "_Preset_Pos_Var_3" 14 "_Capture_Var_3_Pos" 15 "_Capture_Var_4_Pos" 16 "_Switch_Spd_Ain1_Ain2" 17 "_Switch_Spd_Var1_Var2" 18 "I_limit_dig_" 19 "N_clip_neg_pos_" 20 "_Switch_Cmd_Dig_Ana" 21 "Speed_Ramp_0_Pos" 22 "Handwheel" 23 "Brake_Car" 24 "Recup_Disabled" 25 "Rising_Bank_1,_Falling_Bank_0" 26 "_Start_Dest_Var_1,_2,_3,_4" 27 "_Start_CW_Var_1,_2,_3,_4" 28 "Brake_Car_Nr2" ;
VAL_ 385 def_DIN_1 0 "_Off_" 1 "Ref_and_Limit_Plus" 2 "Ref_and_Limit_Minus" 3 "Ref_Plus" 4 "Limit_Plus" 5 "Limit_Minus" 6 "Limit_Plus_and_Minus" 7 "Cancel_Error_s_" 8 "_Start_Ref_Drive" 9 "Speed_Ramp_0" 10 "_Start_Dest_Var_1" 11 "_Start_Dest_Var_2" 12 "N_cmd_Reverse" 13 "_Preset_Pos_Var_3" 14 "_Capture_Var_3_Pos" 15 "_Capture_Var_4_Pos" 16 "_Switch_Spd_Ain1_Ain2" 17 "_Switch_Spd_Var1_Var2" 18 "I_limit_dig_" 19 "N_clip_neg_pos_" 20 "_Switch_Cmd_Dig_Ana" 21 "Speed_Ramp_0_Pos" 22 "Handwheel" 23 "Brake_Car" 24 "Recup_Disabled" 25 "Rising_Bank_1,_Falling_Bank_0" 26 "_Start_Dest_Var_1,_2,_3,_4" 27 "_Start_CW_Var_1,_2,_3,_4" 28 "Brake_Car_Nr2" ;
VAL_ 385 def_END_2 0 "_Off_" 1 "Ref_and_Limit_Plus" 2 "Ref_and_Limit_Minus" 3 "Ref_Plus" 4 "Limit_Plus" 5 "Limit_Minus" 6 "Limit_Plus_and_Minus" 7 "Cancel_Error_s_" 8 "_Start_Ref_Drive" 9 "Speed_Ramp_0" 10 "_Start_Dest_Var_1" 11 "_Start_Dest_Var_2" 12 "N_cmd_Reverse" 13 "_Preset_Pos_Var_3" 14 "_Capture_Var_3_Pos" 15 "_Capture_Var_4_Pos" 16 "_Switch_Spd_Ain1_Ain2" 17 "_Switch_Spd_Var1_Var2" 18 "I_limit_dig_" 19 "N_clip_neg_pos_" 20 "_Switch_Cmd_Dig_Ana" 21 "Speed_Ramp_0_Pos" 22 "Handwheel" 23 "Brake_Car" 24 "Recup_Disabled" 25 "Rising_Bank_1,_Falling_Bank_0" 26 "_Start_Dest_Var_1,_2,_3,_4" 27 "_Start_CW_Var_1,_2,_3,_4" 28 "Brake_Car_Nr2" ;
VAL_ 385 def_END_1 0 "_Off_" 1 "Ref_and_Limit_Plus" 2 "Ref_and_Limit_Minus" 3 "Ref_Plus" 4 "Limit_Plus" 5 "Limit_Minus" 6 "Limit_Plus_and_Minus" 7 "Cancel_Error_s_" 8 "_Start_Ref_Drive" 9 "Speed_Ramp_0" 10 "_Start_Dest_Var_1" 11 "_Start_Dest_Var_2" 12 "N_cmd_Reverse" 13 "_Preset_Pos_Var_3" 14 "_Capture_Var_3_Pos" 15 "_Capture_Var_4_Pos" 16 "_Switch_Spd_Ain1_Ain2" 17 "_Switch_Spd_Var1_Var2" 18 "I_limit_dig_" 19 "N_clip_neg_pos_" 20 "_Switch_Cmd_Dig_Ana" 21 "Speed_Ramp_0_Pos" 22 "Handwheel" 23 "Brake_Car" 24 "Recup_Disabled" 25 "Rising_Bank_1,_Falling_Bank_0" 26 "_Start_Dest_Var_1,_2,_3,_4" 27 "_Start_CW_Var_1,_2,_3,_4" 28 "Brake_Car_Nr2" ;
VAL_ 385 MO_Feedback_1 0 "Rot_Enc_TTL" 1 "Resolver" 2 "Abs_Enc_SC" 3 "Rot_Tacho" 4 "Rot" 5 "DC_Tacho" 6 "DC_Arm" 7 "BL_Arm" 8 "Enc_TTL" 9 "Enc_SC" 10 "Abs_SC" 11 "DC_Arm_Vir" 12 "SLS" 13 "SLS_SMO" 14 "SLS_Usens" 15 "AnaIn1_calc" 16 "AnaIn2_calc" 17 "Panasonic" 18 "DC_Bus" ;
VAL_ 385 CAN_NBT 16386 "1000_kbps" 16421 "500_kbps" 16404 "625_kbps" 16476 "250_kbps" 17445 "100_kbps" ;
VAL_ 385 ActiveControlMode 0 "TURNED_OFF" 1 "CURRENT_DIGITAL" 2 "SPEED_ANALOG" 3 "SPEED_CALIBRATION" 4 "SPEED_DIGITAL" 5 "SPEED_MIXED" 6 "SPEED_HOLD" 7 "TORQUE_ANALOG" 8 "TORQUE_DIGITAL" 9 "POSITION_DIGITAL" 10 "POSITION_HANDWHEEL" 11 "RES2" 12 "TUNING1" 14 "PHASING" 15 "DC_INJ" 16 "TACHO_OFFS" 17 "CALC" 18 "MEASURE" 21 "WAIT" ;
VAL_ 385 CS_Ain_1_Format 0 "Off" 1 "_Cmd_" 2 "_Cmd_" 3 "sq_Cmd" ;
VAL_ 385 DeviceType 0 "Homemade" 14 "DS205_2ph_230V" 15 "DS403_2ph_400V" 16 "DS205_neu_230V" 17 "DS403_neu_400V" 19 "DS405" 21 "DS412" 23 "DS420" 25 "DS450" 27 "DS475" 29 "DS4100" 48 "DS4820" 49 "DS451" 51 "DS476" 56 "DS8020" 60 "DPC440" 65 "DPC460" 67 "DPC460_DC1Q_3P" 81 "BAMO_160_60" 83 "BAMO_160_120" 85 "BAMO_160_180" 87 "BAMO_360_60" 89 "BAMO_360_120" 91 "BAMO_360_180" 93 "BAMO_360_240" 112 "BAMOBIL_D3_3_62_80" 113 "BAMOBIL_D3_2_62_80" 114 "BAMOBIL_D3_3_62_120" 115 "BAMOBIL_D3_2_62_120" 116 "BAMOBIL_D3_3_62_250" 117 "BAMOBIL_D3_2_62_250" 118 "BAMOBIL_D3_3_62_350" 119 "BAMOBIL_D3_2_62_350" 120 "BAMOBIL_D3_3_62_450" 121 "BAMOBIL_D3_2_62_450" 122 "BAMOBIL_D3_3_160_50" 123 "BAMOBIL_D3_2_160_50" 124 "BAMOBIL_D3_3_160_100" 125 "BAMOBIL_D3_2_160_100" 126 "BAMOBIL_D3_3_160_200" 127 "BAMOBIL_D3_2_160_200" 192 "Bamocar_700_160" 193 "Bamocar_700_100" 194 "Bamocar_700_900" 203 "Bamocar_700_200_DC" 204 "Bamocar_400_400" 205 "Bamocar_700_400" 206 "Bamocar_400_250" 240 "Koepfer_V1_700_400" 241 "Koepfer_V2_700_400" ;
VAL_ 385 Rcv_Mux 48 "ID_30_N_Actual" 53 "ID_35_Acc_Ramps" 237 "ID_ED_Dec_Ramps" 199 "ID_C7_RLim_MRcp_Ramp" 168 "ID_A8_N_Actual_Filt" 27 "ID_1B_FW_Nr" 103 "ID_67_Device_Type" 98 "ID_62_SerialNumber" 248 "ID_F8_Axis_Label" 198 "ID_C6_I_device" 238 "ID_EE_V_Shunt" 217 "ID_D9_I_200perc" 90 "ID_5A_Device_Options" 64 "ID_40_Status_Map" 143 "ID_8F_ErrorWarning_Map" 216 "ID_D8_LogicReadBitsIN_OUT" 213 "ID_D5_Ain_in_1" 214 "ID_D6_Ain_in_2" 200 "ID_C8_Nmax100perc" 49 "ID_31_N_setdig" 93 "ID_5D_N_cmd" 50 "ID_32_N_cmd_ramp" 52 "ID_34_N_Lim" 51 "ID_33_N_Error" 144 "ID_90_M_setdig" 33 "ID_21_Id_setdig" 196 "ID_C4_I_max_pk_perc" 197 "ID_C5_I_con_eff_perc" 77 "ID_4D_Motor_I_max_eff_Arms" 78 "ID_4E_Motor_I_nom_eff_Arms" 72 "ID_48_I_Limit_Inuse" 38 "ID_26_I_cmd" 34 "ID_22_I_cmd_ramp" 32 "ID_20_I_Actual" 95 "ID_5F_I_Actual_Filt" 39 "ID_27_Iq_Actual" 40 "ID_28_Id_Actual" 56 "ID_38_Iq_Error" 57 "ID_39_Id_Error" 84 "ID_54_I1_Actual" 85 "ID_55_I2_Actual" 86 "ID_56_I3_Actual" 169 "ID_A9_I3_ADC_Value" 170 "ID_AA_I2_ADC_Value" 41 "ID_29_Vq_Output" 42 "ID_2A_Vd_Output" 138 "ID_8A_V_Output" 73 "ID_49_T_Motor" 74 "ID_4A_T_Igbt" 75 "ID_4B_T_Air_Inside" 235 "ID_EB_DC_Bus_Voltage_Filt" 228 "ID_E4_DigInput_END_1" 230 "ID_E6_DigInput_DIN_1" 229 "ID_E5_DigInput_END_2" 231 "ID_E7_DigInput_DIN_2" 232 "ID_E8_DigInput_RUN" 224 "ID_E0_DigOutput_DOUT_1" 225 "ID_E1_DigOutput_DOUT_2" 222 "ID_DE_DigOutput_DOUT_3" 226 "ID_E2_DigOutput_Rdy_BTB" 233 "ID_E9_Error_I_Fault" 223 "ID_DF_DigOutput_DOUT_4" 70 "ID_46_I_lim_dig_perc" 60 "ID_3C_I_Derating_N_perc" 88 "ID_58_I_Derating_TD" 76 "ID_4C_I_Derating_TE" 162 "ID_A2_I_Derating_TM" 54 "ID_36_CommandSource" 35 "ID_23_Id_Ref" 160 "ID_A0_M_outdig" 184 "ID_B8_Ptr_1_DEBUG" 186 "ID_BA_Ptr_2_DEBUG" 154 "ID_9A_Temp_DEBUG" 5 "ID_05_Motor_F_nom" 6 "ID_06_Motor_V_nom" 7 "ID_07_FU_T_dc" 8 "ID_08_FU_V_dc" 10 "ID_0A_FU_U_min" 11 "ID_0B_FU_F_min" 12 "ID_0C_FU_V_corner" 13 "ID_0D_FU_F_corner" 14 "ID_0E_Motor_Cos_Phi" 25 "ID_19_PWM_Enum" 26 "ID_1A_Calib_Ref_Value" 28 "ID_1C_PID_I_Kp" 29 "ID_1D_PID_I_Ti" 30 "ID_1E_Cutoffdig" 31 "ID_1F_I3_Offset" 37 "ID_25_I_Delta_Ramp" 43 "ID_2B_PID_I_TiM" 44 "ID_2C_PID_n_Kp" 141 "ID_8D_VoltageControl_Ti" 46 "ID_2E_PID_n_Td" 47 "ID_2F_Ain_in_1_OffsScale" 215 "ID_D7_Ain_in_2_OffsScale" 55 "ID_37_DZR_Sequencer_Value" 59 "ID_3B_PID_n_TiM" 63 "ID_3F_N_Lim_plus" 62 "ID_3E_N_Lim_minus" 65 "ID_41_Incr_Delta" 66 "ID_42_MotorPosition_Mech" 67 "ID_43_MotorPosition_Elec" 68 "ID_44_FeedBack_Offset_Angle" 69 "ID_45_Ixt_and_RegenE_Monitor" 79 "ID_4F_Motor_Pole_Number" 80 "ID_50_Ain_in_1_Cutoff" 17 "ID_11_Control_Status" 81 "ID_51_Kern_Mode_State" 82 "ID_52_Status_Mask" 83 "ID_53_Ain_in_2_Cutoff" 87 "ID_57_I_Limit_Inuse_ramp" 89 "ID_59_Motor_Nominal_Speed" 91 "ID_5B_SpeedControl_Kacc" 92 "ID_5C_Rotor_Signals" 94 "ID_5E_Speed_Filter" 96 "ID_60_Ain_in_X_Filter" 97 "ID_61_Ixt_Monitor" 99 "ID_63_ECODE_Status" 100 "ID_64_Device_Mains_Supply_V" 101 "ID_65_Regen_Resistor_P_and_R" 104 "ID_68_CAN_ID_Rx" 105 "ID_69_CAN_ID_Tx" 106 "ID_6A_Pos_PID_Kp" 107 "ID_6B_Pos_PID_Ti" 108 "ID_6C_Pos_PID_Td" 109 "ID_6D_Pos_Actual" 110 "ID_6E_Pos_Destination" 111 "ID_6F_Pos_Actual_2" 112 "ID_70_Pos_Error" 113 "ID_71_Pos_PID_TiM" 114 "ID_72_Pos_OffsetReference" 115 "ID_73_CAN_NBT" 116 "ID_74_Pos_Zero_Capture" 117 "ID_75_Pos_Ref_Reso_Edge" 118 "ID_76_Pos_Calib_Speed_1" 119 "ID_77_Pos_Calib_Speed_2" 121 "ID_79_Pos_Tol_Window" 122 "ID_7A_Pos_Preset_Value" 123 "ID_7B_Pos_Zero_Offset" 124 "ID_7C_Pos_NDrive_Scale" 125 "ID_7D_Pos_NDrive_Offset" 126 "ID_7E_Pos_FB2_Scale_Fac_Ext" 127 "ID_7F_Pos_Offset_Slack" 128 "ID_80_Pos_Diff_Slack" 131 "ID_83_Function_Parameter_Read" 132 "ID_84_Function_Parameter_Write" 133 "ID_85_Function_Special" 136 "ID_88_CAN_ID_2_Rx" 137 "ID_89_CAN_ID_2_Tx" 139 "ID_8B_VoltageControl_Ref" 140 "ID_8C_VoltageControl_Kp" 45 "ID_2D_PID_n_Ti" 142 "ID_8E_Clear_Error_List" 145 "ID_91_Pos_cmd_int" 146 "ID_92_CAN_Error_BusOff_cntr" 147 "ID_93_CAN_Error_WriteTime_cntr" 148 "ID_94_ECODE_1stError" 149 "ID_95_CAN_Error_NoAck_cntr" 150 "ID_96_CAN_Error_CRC_Check_cntr" 151 "ID_97_CAN_Error_Bit_cntr" 153 "ID_99_Info_Timer_Diff" 161 "ID_A1_Ballast_cntr" 163 "ID_A3_Motor_Temp_Error_Lim" 164 "ID_A4_Motor_Options" 165 "ID_A5_Device_DC_Bus_MinMax_Lim" 166 "ID_A6_FB_IncrementsPerRot" 167 "ID_A7_FB_Pole_Number" 171 "ID_AB_Logic_Frequency" 172 "ID_AC_PWM_1_56" 173 "ID_AD_PWM_2_34" 174 "ID_AE_PWM_3_12" 175 "ID_AF_Timer_Delta" 177 "ID_B1_Motor_L_Sigma_Q" 187 "ID_BB_Motor_L_Sigma_D" 178 "ID_B2_Id_Nominal" 179 "ID_B3_Motor_Magn_Inductance" 180 "ID_B4_Motor_Rotor_Resistance" 181 "ID_B5_Id_Minimum" 182 "ID_B6_Time_Constant_Rotor" 188 "ID_BC_Motor_Stator_Resistance" 189 "ID_BD_Time_Constant_Stator" 190 "ID_BE_LogicDefine_of_END_1" 191 "ID_BF_LogicDefine_of_END_2" 192 "ID_C0_LogicDefine_of_DIN_1" 193 "ID_C1_LogicDefine_of_DIN_2" 194 "ID_C2_LogicDefine_of_OUT_1" 36 "ID_24_I_Max_Inuse" 227 "ID_E3_DigSignal_GO" 242 "ID_F2_DigSignal_Brake" 243 "ID_F3_DigSignal_Icns" 245 "ID_F5_DigSignal_LessN0" 244 "ID_F4_DigSignal_Pos_Tolerance" 251 "ID_FB_Ain_in_1_Calc" 252 "ID_FC_Ain_in_2_Calc" 195 "ID_C3_LogicDefine_of_OUT_2" 218 "ID_DA_LogicDefine_of_OUT_3" 219 "ID_DB_LogicDefine_of_OUT_4" 201 "ID_C9_PID_I_xKp" 202 "ID_CA_Bat_Opr_Limits" 203 "ID_CB_PID_I_Kf" 204 "ID_CC_Car_Mode_Status" 205 "ID_CD_Car_Mode_Config" 206 "ID_CE_N_Rpm_MaxInt" 209 "ID_D1_Var_1" 208 "ID_D0_CAN_Timeout" 210 "ID_D2_Var_2" 211 "ID_D3_Var_3" 212 "ID_D4_Var_4" 220 "ID_DC_DAC_Source_ID" 236 "ID_EC_DigSignal_FB_LossOfSig" 239 "ID_EF_DigSignal_NoHWFault" 240 "ID_F0_Time_I_Peak" 241 "ID_F1_Brake_Delay" 246 "ID_F6_Inverter_Output_Power" 247 "ID_F7_Inverter_Output_Work" 9 "ID_0F_FU_Extra" 16 "ID_10_Oszi_Channel" 18 "ID_12_Oszi_Triger_Level" 19 "ID_13_Oszi_Triger_Edge" 20 "ID_14_Oszi_Triger_Source" 21 "ID_15_Oszi_Source" 22 "ID_16_Oszi_Skip" 24 "ID_18_Oszi_Run_cmd" 23 "ID_17_Oszi_Read_cmd" 120 "ID_78_Pos_Ref_Start" 102 "ID_66_DC_Bus_Voltage" 58 "ID_3A_M_cmd_ramp" 152 "ID_97_LogicOutBlock" 155 "ID_9B_LogicInBlock" 254 "ID_FE_FW_Subv_Revis_Nr" ;
